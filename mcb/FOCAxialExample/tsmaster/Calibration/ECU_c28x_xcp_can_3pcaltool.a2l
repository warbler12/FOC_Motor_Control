/******************************************************************************
* ASAP2 file: c28x_xcp_can_3pcaltool.a2l
* Academic License - for use in teaching, academic research, and meeting
* course requirements at degree granting institutions only. Not for
* government, commercial, or other organizational use.
* Code generation for model "c28x_xcp_can_3pcaltool".
* Model version : 6.1
* Simulink Coder version : 23.2 (R2023b) 01-Aug-2023
* C source code generated on : Thu Nov 06 17:20:05 2025
* Target selection: ert.tlc
* Embedded hardware selection: Texas Instruments->C2000
* Code generation objectives: Unspecified
* Validation result: Not run
* (add additional file header information here)
******************************************************************************/ ASAP2_VERSION 1 31
/* Version 1.31 */
/begin PROJECT ProjectName "Project Comment Goes Here"
/begin HEADER "Header Comments go here" /end HEADER
/begin MODULE ModuleName "Module Comment Goes Here"
/begin IF_DATA XCP
 /begin PROTOCOL_LAYER 0x0100 0x03E8 0x00C8 0x0000 0x0000 0x0000 0x0000 0x0000 0x08 0x0008 BYTE_ORDER_MSB_LAST ADDRESS_GRANULARITY_BYTE OPTIONAL_CMD ALLOC_ODT_ENTRY OPTIONAL_CMD ALLOC_ODT OPTIONAL_CMD ALLOC_DAQ OPTIONAL_CMD FREE_DAQ OPTIONAL_CMD GET_DAQ_RESOLUTION_INFO OPTIONAL_CMD GET_DAQ_PROCESSOR_INFO OPTIONAL_CMD START_STOP_SYNCH OPTIONAL_CMD START_STOP_DAQ_LIST OPTIONAL_CMD SET_DAQ_LIST_MODE OPTIONAL_CMD WRITE_DAQ OPTIONAL_CMD SET_DAQ_PTR OPTIONAL_CMD SHORT_DOWNLOAD OPTIONAL_CMD DOWNLOAD OPTIONAL_CMD SHORT_UPLOAD OPTIONAL_CMD UPLOAD OPTIONAL_CMD SET_MTA /end PROTOCOL_LAYER
 /begin DAQ DYNAMIC 0xFFFF 0x0080 0x00 OPTIMISATION_TYPE_DEFAULT ADDRESS_EXTENSION_FREE IDENTIFICATION_FIELD_TYPE_ABSOLUTE GRANULARITY_ODT_ENTRY_SIZE_DAQ_BYTE 0x07 NO_OVERLOAD_INDICATION /begin TIMESTAMP_SUPPORTED 0x0001 SIZE_DWORD UNIT_1US /end TIMESTAMP_SUPPORTED /begin EVENT "10 ms" "10 ms" 0x0000 DAQ 0xFF 0x01 0x07 0x00 /end EVENT /begin EVENT "50 ms" "50 ms" 0x0001 DAQ 0xFF 0x05 0x07 0x00 /end EVENT /end DAQ
 /begin XCP_ON_CAN 0x0100 CAN_ID_MASTER 0x00000002 CAN_ID_SLAVE 0x00000003 BAUDRATE 0x000F4240 SAMPLE_RATE SINGLE SJW 0x02 SYNC_EDGE SINGLE /end XCP_ON_CAN
/end IF_DATA
/begin MOD_PAR "MOD PAR Comment Goes Here" /end MOD_PAR
/begin MOD_COMMON "Mod Common Comment Here" BYTE_ORDER MSB_LAST ALIGNMENT_BYTE 1 ALIGNMENT_WORD 2 ALIGNMENT_LONG 4 ALIGNMENT_FLOAT32_IEEE 4 ALIGNMENT_FLOAT64_IEEE 4 /end MOD_COMMON
/begin CHARACTERISTIC COUNTER_INCR /* Long Identifier */ "" /* Type */ VALUE /* ECU Address */ 0x0001E502 /* Record Layout */ Record_UWORD /* Maximum Difference */ 0 /* Conversion Method */ c28x_xcp_can_3pcaltool_CM_uint16 /* Lower Limit */ 0 /* Upper Limit */ 65535 /end CHARACTERISTIC
/begin CHARACTERISTIC STEP_PARAM /* Long Identifier */ "" /* Type */ VALUE /* ECU Address */ 0x0001E500 /* Record Layout */ Record_SWORD /* Maximum Difference */ 0 /* Conversion Method */ c28x_xcp_can_3pcaltool_CM_int16 /* Lower Limit */ -32768 /* Upper Limit */ 32767 /end CHARACTERISTIC
/begin MEASUREMENT c28x_xcp_can_3pcaltool_B.Constant "" SWORD c28x_xcp_can_3pcaltool_CM_int16 0 0 -32768 32767 ECU_ADDRESS 0x0001E516
 /begin IF_DATA XCP
  /begin DAQ_EVENT VARIABLE /begin DEFAULT_EVENT_LIST EVENT 0x0000 /end DEFAULT_EVENT_LIST /end DAQ_EVENT
 /end IF_DATA
/end MEASUREMENT
/begin MEASUREMENT c28x_xcp_can_3pcaltool_B.Counter "" UWORD c28x_xcp_can_3pcaltool_CM_uint16 0 0 0 65535 ECU_ADDRESS 0x0001E514
 /begin IF_DATA XCP
  /begin DAQ_EVENT VARIABLE /begin DEFAULT_EVENT_LIST EVENT 0x0000 /end DEFAULT_EVENT_LIST /end DAQ_EVENT
 /end IF_DATA
/end MEASUREMENT
/begin MEASUREMENT c28x_xcp_can_3pcaltool_B.Pulse "" SLONG c28x_xcp_can_3pcaltool_CM_int32 0 0 -2147483648 2147483647 ECU_ADDRESS 0x0001E510
 /begin IF_DATA XCP
  /begin DAQ_EVENT VARIABLE /begin DEFAULT_EVENT_LIST EVENT 0x0001 /end DEFAULT_EVENT_LIST /end DAQ_EVENT
 /end IF_DATA
/end MEASUREMENT
/begin MEASUREMENT c28x_xcp_can_3pcaltool_B.Sine "" FLOAT32_IEEE c28x_xcp_can_3pcaltool_CM_single 0 0 -3.4E+38 3.4E+38 ECU_ADDRESS 0x0001E50C
 /begin IF_DATA XCP
  /begin DAQ_EVENT VARIABLE /begin DEFAULT_EVENT_LIST EVENT 0x0000 /end DEFAULT_EVENT_LIST /end DAQ_EVENT
 /end IF_DATA
/end MEASUREMENT
/begin MEASUREMENT c28x_xcp_can_3pcaltool_DW.Delay_DSTATE "" UWORD c28x_xcp_can_3pcaltool_CM_uint16 0 0 0 65535 ECU_ADDRESS 0x0001E528
 /begin IF_DATA XCP
  /begin DAQ_EVENT VARIABLE /begin DEFAULT_EVENT_LIST EVENT 0x0000 /end DEFAULT_EVENT_LIST /end DAQ_EVENT
 /end IF_DATA
/end MEASUREMENT
/begin MEASUREMENT c28x_xcp_can_3pcaltool_DW.clockTickCounter "" SLONG c28x_xcp_can_3pcaltool_CM_int32 0 0 -2147483648 2147483647 ECU_ADDRESS 0x0001E524
 /begin IF_DATA XCP
  /begin DAQ_EVENT VARIABLE /begin DEFAULT_EVENT_LIST EVENT 0x0001 /end DEFAULT_EVENT_LIST /end DAQ_EVENT
 /end IF_DATA
/end MEASUREMENT
/begin MEASUREMENT c28x_xcp_can_3pcaltool_DW.counter "" SLONG c28x_xcp_can_3pcaltool_CM_int32 0 0 -2147483648 2147483647 ECU_ADDRESS 0x0001E520
 /begin IF_DATA XCP
  /begin DAQ_EVENT VARIABLE /begin DEFAULT_EVENT_LIST EVENT 0x0000 /end DEFAULT_EVENT_LIST /end DAQ_EVENT
 /end IF_DATA
/end MEASUREMENT
/begin MEASUREMENT c28x_xcp_can_3pcaltool_Y.Out1 "" SLONG c28x_xcp_can_3pcaltool_CM_int32 0 0 -2147483648 2147483647 ECU_ADDRESS 0x0001E504
 /begin IF_DATA XCP
  /begin DAQ_EVENT VARIABLE /begin DEFAULT_EVENT_LIST EVENT 0x0001 /end DEFAULT_EVENT_LIST /end DAQ_EVENT
 /end IF_DATA
/end MEASUREMENT
/begin MEASUREMENT c28x_xcp_can_3pcaltool_Y.Out2 "" SWORD c28x_xcp_can_3pcaltool_CM_int16 0 0 -32768 32767 ECU_ADDRESS 0x0001E508
 /begin IF_DATA XCP
  /begin DAQ_EVENT VARIABLE /begin DEFAULT_EVENT_LIST EVENT 0x0000 /end DEFAULT_EVENT_LIST /end DAQ_EVENT
 /end IF_DATA
/end MEASUREMENT
/begin COMPU_METHOD c28x_xcp_can_3pcaltool_CM_int16 "Q = V" RAT_FUNC "%5.0" "" COEFFS 0 1 0 0 0 1 /end COMPU_METHOD
/begin COMPU_METHOD c28x_xcp_can_3pcaltool_CM_int32 "Q = V" RAT_FUNC "%10.0" "" COEFFS 0 1 0 0 0 1 /end COMPU_METHOD
/begin COMPU_METHOD c28x_xcp_can_3pcaltool_CM_single "Q = V" RAT_FUNC "%8.6" "" COEFFS 0 1 0 0 0 1 /end COMPU_METHOD
/begin COMPU_METHOD c28x_xcp_can_3pcaltool_CM_uint16 "Q = V" RAT_FUNC "%5.0" "" COEFFS 0 1 0 0 0 1 /end COMPU_METHOD
/begin RECORD_LAYOUT Record_FLOAT32_IEEE FNC_VALUES 1 FLOAT32_IEEE COLUMN_DIR DIRECT /end RECORD_LAYOUT
/begin RECORD_LAYOUT Record_SLONG FNC_VALUES 1 SLONG COLUMN_DIR DIRECT /end RECORD_LAYOUT
/begin RECORD_LAYOUT Record_SWORD FNC_VALUES 1 SWORD COLUMN_DIR DIRECT /end RECORD_LAYOUT
/begin RECORD_LAYOUT Record_UWORD FNC_VALUES 1 UWORD COLUMN_DIR DIRECT /end RECORD_LAYOUT
/begin GROUP c28x_xcp_can_3pcaltool "c28x_xcp_can_3pcaltool" /* Root */ ROOT /begin REF_CHARACTERISTIC COUNTER_INCR STEP_PARAM /end REF_CHARACTERISTIC
 /begin REF_MEASUREMENT c28x_xcp_can_3pcaltool_B.Constant c28x_xcp_can_3pcaltool_B.Counter c28x_xcp_can_3pcaltool_B.Pulse c28x_xcp_can_3pcaltool_B.Sine c28x_xcp_can_3pcaltool_DW.Delay_DSTATE c28x_xcp_can_3pcaltool_DW.clockTickCounter c28x_xcp_can_3pcaltool_DW.counter c28x_xcp_can_3pcaltool_Y.Out1 c28x_xcp_can_3pcaltool_Y.Out2 /end REF_MEASUREMENT
/end GROUP
/end MODULE
/end PROJECT
/* (add any file trailer comments here) */
/* EOF c28x_xcp_can_3pcaltool.a2l*/
