/******************************************************************************
* ASAP2 file: mcb_pmsm_foc_I2C_f28379d.a2l
* Academic License - for use in teaching, academic research, and meeting
* course requirements at degree granting institutions only. Not for
* government, commercial, or other organizational use.
* Code generation for model "mcb_pmsm_foc_I2C_f28379d".
* Model version : 7.6
* Simulink Coder version : 23.2 (R2023b) 01-Aug-2023
* C source code generated on : Thu Nov 06 22:35:22 2025
* Target selection: ert.tlc
* Embedded hardware selection: Texas Instruments->C2000
* Code generation objectives: Unspecified
* Validation result: Not run
* (add additional file header information here)
******************************************************************************/ ASAP2_VERSION 1 31
/* Version 1.31 */
/begin PROJECT ProjectName "Project Comment Goes Here"
/begin HEADER "Header Comments go here" /end HEADER
/begin MODULE ModuleName "Module Comment Goes Here"
/begin IF_DATA XCP
 /begin PROTOCOL_LAYER 0x0100 0x03E8 0x00C8 0x0000 0x0000 0x0000 0x0000 0x0000 0x08 0x0008 BYTE_ORDER_MSB_LAST ADDRESS_GRANULARITY_BYTE OPTIONAL_CMD ALLOC_ODT_ENTRY OPTIONAL_CMD ALLOC_ODT OPTIONAL_CMD ALLOC_DAQ OPTIONAL_CMD FREE_DAQ OPTIONAL_CMD GET_DAQ_RESOLUTION_INFO OPTIONAL_CMD GET_DAQ_PROCESSOR_INFO OPTIONAL_CMD START_STOP_SYNCH OPTIONAL_CMD START_STOP_DAQ_LIST OPTIONAL_CMD SET_DAQ_LIST_MODE OPTIONAL_CMD WRITE_DAQ OPTIONAL_CMD SET_DAQ_PTR OPTIONAL_CMD SHORT_DOWNLOAD OPTIONAL_CMD DOWNLOAD OPTIONAL_CMD SHORT_UPLOAD OPTIONAL_CMD UPLOAD OPTIONAL_CMD SET_MTA /end PROTOCOL_LAYER
 /begin DAQ DYNAMIC 0xFFFF 0x0080 0x00 OPTIMISATION_TYPE_DEFAULT ADDRESS_EXTENSION_FREE IDENTIFICATION_FIELD_TYPE_ABSOLUTE GRANULARITY_ODT_ENTRY_SIZE_DAQ_BYTE 0x07 NO_OVERLOAD_INDICATION /begin TIMESTAMP_SUPPORTED 0x0001 SIZE_DWORD UNIT_1US /end TIMESTAMP_SUPPORTED /begin EVENT "500 us" "500 us" 0x0000 DAQ 0xFF 0x05 0x05 0x00 /end EVENT /begin EVENT "1 ms" "1 ms" 0x0001 DAQ 0xFF 0x01 0x06 0x00 /end EVENT /begin EVENT "15 ms" "15 ms" 0x0002 DAQ 0xFF 0x0F 0x06 0x00 /end EVENT /begin EVENT "500 ms" "500 ms" 0x0003 DAQ 0xFF 0x05 0x08 0x00 /end EVENT /end DAQ
 /begin XCP_ON_CAN 0x0100 CAN_ID_MASTER 0x00000002 CAN_ID_SLAVE 0x00000003 BAUDRATE 0x000F4240 SAMPLE_RATE SINGLE SJW 0x02 SYNC_EDGE SINGLE /end XCP_ON_CAN
/end IF_DATA
/begin MOD_PAR "MOD PAR Comment Goes Here" /end MOD_PAR
/begin MOD_COMMON "Mod Common Comment Here" BYTE_ORDER MSB_LAST ALIGNMENT_BYTE 1 ALIGNMENT_WORD 2 ALIGNMENT_LONG 4 ALIGNMENT_FLOAT32_IEEE 4 ALIGNMENT_FLOAT64_IEEE 4 /end MOD_COMMON
/begin MEASUREMENT mcb_pmsm_foc_I2C_f28379d_B.ADC_A_IN0 "" UWORD mcb_pmsm_foc_I2C_f28379d_CM_uint16 0 0 0 65535 ECU_ADDRESS 0x0001E98C /end MEASUREMENT
/begin MEASUREMENT mcb_pmsm_foc_I2C_f28379d_B.ADC_B_IN0 "" UWORD mcb_pmsm_foc_I2C_f28379d_CM_uint16 0 0 0 65535 ECU_ADDRESS 0x0001E98E /end MEASUREMENT
/begin MEASUREMENT mcb_pmsm_foc_I2C_f28379d_B.ADC_B_IN2 "" UWORD mcb_pmsm_foc_I2C_f28379d_CM_uint16 0 0 0 65535 ECU_ADDRESS 0x0001E9AC /end MEASUREMENT
/begin MEASUREMENT mcb_pmsm_foc_I2C_f28379d_B.ADC_C_IN2 "" UWORD mcb_pmsm_foc_I2C_f28379d_CM_uint16 0 0 0 65535 ECU_ADDRESS 0x0001E9AA /end MEASUREMENT
/begin MEASUREMENT mcb_pmsm_foc_I2C_f28379d_B.AND3 "" UBYTE mcb_pmsm_foc_I2C_f28379d_CM_logical 0 0 0 1 ECU_ADDRESS 0x0001EA06 /end MEASUREMENT
/begin MEASUREMENT mcb_pmsm_foc_I2C_f28379d_B.AND3_n "" UBYTE mcb_pmsm_foc_I2C_f28379d_CM_logical 0 0 0 1 ECU_ADDRESS 0x0001EA10 /end MEASUREMENT
/begin MEASUREMENT mcb_pmsm_foc_I2C_f28379d_B.Add "" ULONG mcb_pmsm_foc_I2C_f28379d_CM_uint32 0 0 0 4294967295 ECU_ADDRESS 0x0001E6C4 /end MEASUREMENT
/begin MEASUREMENT mcb_pmsm_foc_I2C_f28379d_B.Add1 "" FLOAT32_IEEE mcb_pmsm_foc_I2C_f28379d_CM_single 0 0 -3.4E+38 3.4E+38 ECU_ADDRESS 0x0001E724 /end MEASUREMENT
/begin MEASUREMENT mcb_pmsm_foc_I2C_f28379d_B.Add1_d "" FLOAT32_IEEE mcb_pmsm_foc_I2C_f28379d_CM_single 0 0 -3.4E+38 3.4E+38 ECU_ADDRESS 0x0001E888 /end MEASUREMENT
/begin MEASUREMENT mcb_pmsm_foc_I2C_f28379d_B.Add2 "" FLOAT32_IEEE mcb_pmsm_foc_I2C_f28379d_CM_single 0 0 -3.4E+38 3.4E+38 ECU_ADDRESS 0x0001E88C /end MEASUREMENT
/begin MEASUREMENT mcb_pmsm_foc_I2C_f28379d_B.Add3 "" FLOAT32_IEEE mcb_pmsm_foc_I2C_f28379d_CM_single 0 0 -3.4E+38 3.4E+38 ECU_ADDRESS 0x0001E890 /end MEASUREMENT
/begin MEASUREMENT mcb_pmsm_foc_I2C_f28379d_B.Add_c "" FLOAT32_IEEE mcb_pmsm_foc_I2C_f28379d_CM_single 0 0 -3.4E+38 3.4E+38 ECU_ADDRESS 0x0001E758 /end MEASUREMENT
/begin MEASUREMENT mcb_pmsm_foc_I2C_f28379d_B.Add_e "" SLONG mcb_pmsm_foc_I2C_f28379d_CM_int32 0 0 -2147483648 2147483647 ARRAY_SIZE 2 ECU_ADDRESS 0x0001E97C /end MEASUREMENT
/begin MEASUREMENT mcb_pmsm_foc_I2C_f28379d_B.Add_n "" FLOAT32_IEEE mcb_pmsm_foc_I2C_f28379d_CM_single 0 0 -3.4E+38 3.4E+38 ECU_ADDRESS 0x0001E880 /end MEASUREMENT
/begin MEASUREMENT mcb_pmsm_foc_I2C_f28379d_B.BitwiseOperator "" UWORD mcb_pmsm_foc_I2C_f28379d_CM_uint16 0 0 0 65535 ECU_ADDRESS 0x0001E99A /end MEASUREMENT
/begin MEASUREMENT mcb_pmsm_foc_I2C_f28379d_B.BitwiseOperator1 "" UWORD mcb_pmsm_foc_I2C_f28379d_CM_uint16 0 0 0 65535 ECU_ADDRESS 0x0001E99C /end MEASUREMENT
/begin MEASUREMENT mcb_pmsm_foc_I2C_f28379d_B.BitwiseOperator2 "" UWORD mcb_pmsm_foc_I2C_f28379d_CM_uint16 0 0 0 65535 ECU_ADDRESS 0x0001E9A0 /end MEASUREMENT
/begin MEASUREMENT mcb_pmsm_foc_I2C_f28379d_B.BytePack "" ULONG mcb_pmsm_foc_I2C_f28379d_CM_uint32 0 0 0 4294967295 ARRAY_SIZE 2 ECU_ADDRESS 0x0001E698 /end MEASUREMENT
/begin MEASUREMENT mcb_pmsm_foc_I2C_f28379d_B.CastToSingle "" FLOAT32_IEEE mcb_pmsm_foc_I2C_f28379d_CM_single 0 0 -3.4E+38 3.4E+38 ECU_ADDRESS 0x0001E6EC
 /begin IF_DATA XCP
  /begin DAQ_EVENT VARIABLE /begin DEFAULT_EVENT_LIST EVENT 0x0001 /end DEFAULT_EVENT_LIST /end DAQ_EVENT
 /end IF_DATA
/end MEASUREMENT
/begin MEASUREMENT mcb_pmsm_foc_I2C_f28379d_B.Compare "" UBYTE mcb_pmsm_foc_I2C_f28379d_CM_logical 0 0 0 1 ECU_ADDRESS 0x0001E9F4 /end MEASUREMENT
/begin MEASUREMENT mcb_pmsm_foc_I2C_f28379d_B.Compare_f "" UBYTE mcb_pmsm_foc_I2C_f28379d_CM_logical 0 0 0 1 ECU_ADDRESS 0x0001EA12 /end MEASUREMENT
/begin MEASUREMENT mcb_pmsm_foc_I2C_f28379d_B.Compare_f0 "" UBYTE mcb_pmsm_foc_I2C_f28379d_CM_logical 0 0 0 1 ECU_ADDRESS 0x0001EA1A /end MEASUREMENT
/begin MEASUREMENT mcb_pmsm_foc_I2C_f28379d_B.Compare_k "" UBYTE mcb_pmsm_foc_I2C_f28379d_CM_logical 0 0 0 1 ECU_ADDRESS 0x0001EA18 /end MEASUREMENT
/begin MEASUREMENT mcb_pmsm_foc_I2C_f28379d_B.DTC "" FLOAT32_IEEE mcb_pmsm_foc_I2C_f28379d_CM_single 0 0 -3.4E+38 3.4E+38 ECU_ADDRESS 0x0001E710 /end MEASUREMENT
/begin MEASUREMENT mcb_pmsm_foc_I2C_f28379d_B.Data "" ULONG mcb_pmsm_foc_I2C_f28379d_CM_uint32 0 0 0 4294967295 ARRAY_SIZE 2 ECU_ADDRESS 0x0001E6C8 /end MEASUREMENT
/begin MEASUREMENT mcb_pmsm_foc_I2C_f28379d_B.DataStoreRead "" UWORD mcb_pmsm_foc_I2C_f28379d_CM_uint16 0 0 0 65535 ECU_ADDRESS 0x0001E9B2 /end MEASUREMENT
/begin MEASUREMENT mcb_pmsm_foc_I2C_f28379d_B.DataStoreRead1 "" FLOAT32_IEEE mcb_pmsm_foc_I2C_f28379d_CM_single 0 0 -3.4E+38 3.4E+38 ECU_ADDRESS 0x0001E794 /end MEASUREMENT
/begin MEASUREMENT mcb_pmsm_foc_I2C_f28379d_B.DataStoreRead1_b "" UBYTE mcb_pmsm_foc_I2C_f28379d_CM_logical 0 0 0 1 ECU_ADDRESS 0x0001E9F6 /end MEASUREMENT
/begin MEASUREMENT mcb_pmsm_foc_I2C_f28379d_B.DataStoreRead1_m "" UBYTE mcb_pmsm_foc_I2C_f28379d_CM_logical 0 0 0 1 ECU_ADDRESS 0x0001E9FA /end MEASUREMENT
/begin MEASUREMENT mcb_pmsm_foc_I2C_f28379d_B.DataStoreRead1_o "" UWORD mcb_pmsm_foc_I2C_f28379d_CM_uint16 0 0 0 65535 ECU_ADDRESS 0x0001E9A6 /end MEASUREMENT
/begin MEASUREMENT mcb_pmsm_foc_I2C_f28379d_B.DataStoreRead2 "" FLOAT32_IEEE mcb_pmsm_foc_I2C_f28379d_CM_single 0 0 -3.4E+38 3.4E+38 ECU_ADDRESS 0x0001E708 /end MEASUREMENT
/begin MEASUREMENT mcb_pmsm_foc_I2C_f28379d_B.DataStoreRead2_j "" UWORD mcb_pmsm_foc_I2C_f28379d_CM_uint16 0 0 0 65535 ECU_ADDRESS 0x0001E9A8 /end MEASUREMENT
/begin MEASUREMENT mcb_pmsm_foc_I2C_f28379d_B.DataStoreRead_g "" UBYTE mcb_pmsm_foc_I2C_f28379d_CM_logical 0 0 0 1 ECU_ADDRESS 0x0001E9E8
 /begin IF_DATA XCP
  /begin DAQ_EVENT VARIABLE /begin DEFAULT_EVENT_LIST EVENT 0x0000 /end DEFAULT_EVENT_LIST /end DAQ_EVENT
 /end IF_DATA
/end MEASUREMENT
/begin MEASUREMENT mcb_pmsm_foc_I2C_f28379d_B.DataTypeConversion "" FLOAT32_IEEE mcb_pmsm_foc_I2C_f28379d_CM_single 0 0 -3.4E+38 3.4E+38 ECU_ADDRESS 0x0001E8AC /end MEASUREMENT
/begin MEASUREMENT mcb_pmsm_foc_I2C_f28379d_B.DataTypeConversion1 "" FLOAT32_IEEE mcb_pmsm_foc_I2C_f28379d_CM_single 0 0 -3.4E+38 3.4E+38 ECU_ADDRESS 0x0001E778 /end MEASUREMENT
/begin MEASUREMENT mcb_pmsm_foc_I2C_f28379d_B.DataTypeConversion1_n "" FLOAT32_IEEE mcb_pmsm_foc_I2C_f28379d_CM_single 0 0 -3.4E+38 3.4E+38 ECU_ADDRESS 0x0001E838 /end MEASUREMENT
/begin MEASUREMENT mcb_pmsm_foc_I2C_f28379d_B.DataTypeConversion2 "" UWORD mcb_pmsm_foc_I2C_f28379d_CM_uint16 0 0 0 65535 ECU_ADDRESS 0x0001E998 /end MEASUREMENT
/begin MEASUREMENT mcb_pmsm_foc_I2C_f28379d_B.DataTypeConversion3 "" UBYTE mcb_pmsm_foc_I2C_f28379d_CM_logical 0 0 0 1 ECU_ADDRESS 0x0001E9F2 /end MEASUREMENT
/begin MEASUREMENT mcb_pmsm_foc_I2C_f28379d_B.DataTypeConversion_c "" SLONG mcb_pmsm_foc_I2C_f28379d_CM_int32 0 0 -2147483648 2147483647 ARRAY_SIZE 2 ECU_ADDRESS 0x0001E974 /end MEASUREMENT
/begin MEASUREMENT mcb_pmsm_foc_I2C_f28379d_B.DataTypeConversion_f "" UWORD mcb_pmsm_foc_I2C_f28379d_CM_uint16 0 0 0 65535 ECU_ADDRESS 0x0001E9CE /end MEASUREMENT
/begin MEASUREMENT mcb_pmsm_foc_I2C_f28379d_B.DataTypeConversion_fl "" UWORD mcb_pmsm_foc_I2C_f28379d_CM_uint16 0 0 0 65535 ECU_ADDRESS 0x0001E9D0 /end MEASUREMENT
/begin MEASUREMENT mcb_pmsm_foc_I2C_f28379d_B.DataTypeConversion_h "" UWORD mcb_pmsm_foc_I2C_f28379d_CM_uint16 0 0 0 65535 ECU_ADDRESS 0x0001E9BE /end MEASUREMENT
/begin MEASUREMENT mcb_pmsm_foc_I2C_f28379d_B.DataTypeConversion_i "" UWORD mcb_pmsm_foc_I2C_f28379d_CM_uint16 0 0 0 65535 ECU_ADDRESS 0x0001E9AE /end MEASUREMENT
/begin MEASUREMENT mcb_pmsm_foc_I2C_f28379d_B.Data_f "" ULONG mcb_pmsm_foc_I2C_f28379d_CM_uint32 0 0 0 4294967295 ARRAY_SIZE 2 ECU_ADDRESS 0x0001E6D0 /end MEASUREMENT
/begin MEASUREMENT mcb_pmsm_foc_I2C_f28379d_B.Data_fw "" ULONG mcb_pmsm_foc_I2C_f28379d_CM_uint32 0 0 0 4294967295 ARRAY_SIZE 2 ECU_ADDRESS 0x0001E6D8 /end MEASUREMENT
/begin MEASUREMENT mcb_pmsm_foc_I2C_f28379d_B.DeadZone "" FLOAT32_IEEE mcb_pmsm_foc_I2C_f28379d_CM_single 0 0 -3.4E+38 3.4E+38 ECU_ADDRESS 0x0001E818 /end MEASUREMENT
/begin MEASUREMENT mcb_pmsm_foc_I2C_f28379d_B.DeadZone_a "" FLOAT32_IEEE mcb_pmsm_foc_I2C_f28379d_CM_single 0 0 -3.4E+38 3.4E+38 ECU_ADDRESS 0x0001E824 /end MEASUREMENT
/begin MEASUREMENT mcb_pmsm_foc_I2C_f28379d_B.Delay "" ULONG mcb_pmsm_foc_I2C_f28379d_CM_uint32 0 0 0 4294967295 ECU_ADDRESS 0x0001E684 /end MEASUREMENT
/begin MEASUREMENT mcb_pmsm_foc_I2C_f28379d_B.Delay_c "" FLOAT32_IEEE mcb_pmsm_foc_I2C_f28379d_CM_single 0 0 -3.4E+38 3.4E+38 ECU_ADDRESS 0x0001E8A0 /end MEASUREMENT
/begin MEASUREMENT mcb_pmsm_foc_I2C_f28379d_B.Divide "" UWORD mcb_pmsm_foc_I2C_f28379d_CM_uint16 0 0 0 65535 ECU_ADDRESS 0x0001E986 /end MEASUREMENT
/begin MEASUREMENT mcb_pmsm_foc_I2C_f28379d_B.Divide1 "" UWORD mcb_pmsm_foc_I2C_f28379d_CM_uint16 0 0 0 65535 ECU_ADDRESS 0x0001E988 /end MEASUREMENT
/begin MEASUREMENT mcb_pmsm_foc_I2C_f28379d_B.Equal1 "" UBYTE mcb_pmsm_foc_I2C_f28379d_CM_logical 0 0 0 1 ECU_ADDRESS 0x0001EA04 /end MEASUREMENT
/begin MEASUREMENT mcb_pmsm_foc_I2C_f28379d_B.Equal1_i "" UBYTE mcb_pmsm_foc_I2C_f28379d_CM_logical 0 0 0 1 ECU_ADDRESS 0x0001EA0E /end MEASUREMENT
/begin MEASUREMENT mcb_pmsm_foc_I2C_f28379d_B.FixPtSum1 "" UWORD mcb_pmsm_foc_I2C_f28379d_CM_uint16 0 0 0 65535 ECU_ADDRESS 0x0001E9B8 /end MEASUREMENT
/begin MEASUREMENT mcb_pmsm_foc_I2C_f28379d_B.FixPtSwitch "" UWORD mcb_pmsm_foc_I2C_f28379d_CM_uint16 0 0 0 65535 ECU_ADDRESS 0x0001E9BA /end MEASUREMENT
/begin MEASUREMENT mcb_pmsm_foc_I2C_f28379d_B.Floor "" FLOAT32_IEEE mcb_pmsm_foc_I2C_f28379d_CM_single 0 0 -3.4E+38 3.4E+38 ECU_ADDRESS 0x0001E754 /end MEASUREMENT
/begin MEASUREMENT mcb_pmsm_foc_I2C_f28379d_B.ForIterator "" UWORD mcb_pmsm_foc_I2C_f28379d_CM_uint16 0 0 0 65535 ECU_ADDRESS 0x0001E98A /end MEASUREMENT
/begin MEASUREMENT mcb_pmsm_foc_I2C_f28379d_B.Gain "" FLOAT32_IEEE mcb_pmsm_foc_I2C_f28379d_CM_single 0 0 -3.4E+38 3.4E+38 ECU_ADDRESS 0x0001E6F0
 /begin IF_DATA XCP
  /begin DAQ_EVENT VARIABLE /begin DEFAULT_EVENT_LIST EVENT 0x0001 /end DEFAULT_EVENT_LIST /end DAQ_EVENT
 /end IF_DATA
/end MEASUREMENT
/begin MEASUREMENT mcb_pmsm_foc_I2C_f28379d_B.Gain_a "" FLOAT32_IEEE mcb_pmsm_foc_I2C_f28379d_CM_single 0 0 -3.4E+38 3.4E+38 ARRAY_SIZE 3 ECU_ADDRESS 0x0001E894 /end MEASUREMENT
/begin MEASUREMENT mcb_pmsm_foc_I2C_f28379d_B.Gain_b "" FLOAT32_IEEE mcb_pmsm_foc_I2C_f28379d_CM_single 0 0 -3.4E+38 3.4E+38 ECU_ADDRESS 0x0001E94C /end MEASUREMENT
/begin MEASUREMENT mcb_pmsm_foc_I2C_f28379d_B.Gain_l "" FLOAT32_IEEE mcb_pmsm_foc_I2C_f28379d_CM_single 0 0 -3.4E+38 3.4E+38 ECU_ADDRESS 0x0001E95C /end MEASUREMENT
/begin MEASUREMENT mcb_pmsm_foc_I2C_f28379d_B.GetADCVoltage "" FLOAT32_IEEE mcb_pmsm_foc_I2C_f28379d_CM_single 0 0 -3.4E+38 3.4E+38 ARRAY_SIZE 2 ECU_ADDRESS 0x0001E728 /end MEASUREMENT
/begin MEASUREMENT mcb_pmsm_foc_I2C_f28379d_B.GetCurrents "" FLOAT32_IEEE mcb_pmsm_foc_I2C_f28379d_CM_single 0 0 -3.4E+38 3.4E+38 ARRAY_SIZE 2 ECU_ADDRESS 0x0001E730 /end MEASUREMENT
/begin MEASUREMENT mcb_pmsm_foc_I2C_f28379d_B.Get_Integer "" UWORD mcb_pmsm_foc_I2C_f28379d_CM_uint16 0 0 0 65535 ECU_ADDRESS 0x0001E9B0 /end MEASUREMENT
/begin MEASUREMENT mcb_pmsm_foc_I2C_f28379d_B.Get_Integer_j "" UWORD mcb_pmsm_foc_I2C_f28379d_CM_uint16 0 0 0 65535 ECU_ADDRESS 0x0001E9C0 /end MEASUREMENT
/begin MEASUREMENT mcb_pmsm_foc_I2C_f28379d_B.I2CReceive_o1 "" UBYTE mcb_pmsm_foc_I2C_f28379d_CM_uint8 0 0 0 255 ARRAY_SIZE 2 ECU_ADDRESS 0x0001E9DC
 /begin IF_DATA XCP
  /begin DAQ_EVENT VARIABLE /begin DEFAULT_EVENT_LIST EVENT 0x0001 /end DEFAULT_EVENT_LIST /end DAQ_EVENT
 /end IF_DATA
/end MEASUREMENT
/begin MEASUREMENT mcb_pmsm_foc_I2C_f28379d_B.I2CReceive_o2 "" UWORD mcb_pmsm_foc_I2C_f28379d_CM_uint16 0 0 0 65535 ECU_ADDRESS 0x0001E9D6
 /begin IF_DATA XCP
  /begin DAQ_EVENT VARIABLE /begin DEFAULT_EVENT_LIST EVENT 0x0001 /end DEFAULT_EVENT_LIST /end DAQ_EVENT
 /end IF_DATA
/end MEASUREMENT
/begin MEASUREMENT mcb_pmsm_foc_I2C_f28379d_B.I2CTransmit "" UWORD mcb_pmsm_foc_I2C_f28379d_CM_uint16 0 0 0 65535 ECU_ADDRESS 0x0001E9D8
 /begin IF_DATA XCP
  /begin DAQ_EVENT VARIABLE /begin DEFAULT_EVENT_LIST EVENT 0x0001 /end DEFAULT_EVENT_LIST /end DAQ_EVENT
 /end IF_DATA
/end MEASUREMENT
/begin MEASUREMENT mcb_pmsm_foc_I2C_f28379d_B.I2CTransmit1 "" UWORD mcb_pmsm_foc_I2C_f28379d_CM_uint16 0 0 0 65535 ECU_ADDRESS 0x0001E9D2
 /begin IF_DATA XCP
  /begin DAQ_EVENT VARIABLE /begin DEFAULT_EVENT_LIST EVENT 0x0002 /end DEFAULT_EVENT_LIST /end DAQ_EVENT
 /end IF_DATA
/end MEASUREMENT
/begin MEASUREMENT mcb_pmsm_foc_I2C_f28379d_B.IProdOut "" FLOAT32_IEEE mcb_pmsm_foc_I2C_f28379d_CM_single 0 0 -3.4E+38 3.4E+38 ECU_ADDRESS 0x0001E81C /end MEASUREMENT
/begin MEASUREMENT mcb_pmsm_foc_I2C_f28379d_B.IProdOut_b "" FLOAT32_IEEE mcb_pmsm_foc_I2C_f28379d_CM_single 0 0 -3.4E+38 3.4E+38 ECU_ADDRESS 0x0001E828 /end MEASUREMENT
/begin MEASUREMENT mcb_pmsm_foc_I2C_f28379d_B.IfActionSubsystem.Convert_back "" FLOAT32_IEEE mcb_pmsm_foc_I2C_f28379d_CM_single 0 0 -3.4E+38 3.4E+38 ECU_ADDRESS 0x0001EA90 /end MEASUREMENT
/begin MEASUREMENT mcb_pmsm_foc_I2C_f28379d_B.IfActionSubsystem.Convert_uint16 "" SWORD mcb_pmsm_foc_I2C_f28379d_CM_int16 0 0 -32768 32767 ECU_ADDRESS 0x0001EA94 /end MEASUREMENT
/begin MEASUREMENT mcb_pmsm_foc_I2C_f28379d_B.IfActionSubsystem1.Convert_back "" FLOAT32_IEEE mcb_pmsm_foc_I2C_f28379d_CM_single 0 0 -3.4E+38 3.4E+38 ECU_ADDRESS 0x0001EA88 /end MEASUREMENT
/begin MEASUREMENT mcb_pmsm_foc_I2C_f28379d_B.IfActionSubsystem1.Convert_uint16 "" SWORD mcb_pmsm_foc_I2C_f28379d_CM_int16 0 0 -32768 32767 ECU_ADDRESS 0x0001EA8C /end MEASUREMENT
/begin MEASUREMENT mcb_pmsm_foc_I2C_f28379d_B.IfActionSubsystem1_k.Convert_back "" FLOAT32_IEEE mcb_pmsm_foc_I2C_f28379d_CM_single 0 0 -3.4E+38 3.4E+38 ECU_ADDRESS 0x0001EA78 /end MEASUREMENT
/begin MEASUREMENT mcb_pmsm_foc_I2C_f28379d_B.IfActionSubsystem1_k.Convert_uint16 "" SWORD mcb_pmsm_foc_I2C_f28379d_CM_int16 0 0 -32768 32767 ECU_ADDRESS 0x0001EA7C /end MEASUREMENT
/begin MEASUREMENT mcb_pmsm_foc_I2C_f28379d_B.IfActionSubsystem_e.Convert_back "" FLOAT32_IEEE mcb_pmsm_foc_I2C_f28379d_CM_single 0 0 -3.4E+38 3.4E+38 ECU_ADDRESS 0x0001EA80 /end MEASUREMENT
/begin MEASUREMENT mcb_pmsm_foc_I2C_f28379d_B.IfActionSubsystem_e.Convert_uint16 "" SWORD mcb_pmsm_foc_I2C_f28379d_CM_int16 0 0 -32768 32767 ECU_ADDRESS 0x0001EA84 /end MEASUREMENT
/begin MEASUREMENT mcb_pmsm_foc_I2C_f28379d_B.IndexVector "" ULONG mcb_pmsm_foc_I2C_f28379d_CM_uint32 0 0 0 4294967295 ECU_ADDRESS 0x0001E6C0 /end MEASUREMENT
/begin MEASUREMENT mcb_pmsm_foc_I2C_f28379d_B.Integrator "" FLOAT32_IEEE mcb_pmsm_foc_I2C_f28379d_CM_single 0 0 -3.4E+38 3.4E+38 ECU_ADDRESS 0x0001E7D8 /end MEASUREMENT
/begin MEASUREMENT mcb_pmsm_foc_I2C_f28379d_B.Integrator_f "" FLOAT32_IEEE mcb_pmsm_foc_I2C_f28379d_CM_single 0 0 -3.4E+38 3.4E+38 ECU_ADDRESS 0x0001E7F0 /end MEASUREMENT
/begin MEASUREMENT mcb_pmsm_foc_I2C_f28379d_B.InvertingNoninvertingCurrentmea "" FLOAT32_IEEE mcb_pmsm_foc_I2C_f28379d_CM_single 0 0 -3.4E+38 3.4E+38 ARRAY_SIZE 2 ECU_ADDRESS 0x0001E740 /end MEASUREMENT
/begin MEASUREMENT mcb_pmsm_foc_I2C_f28379d_B.Ki1 "" FLOAT32_IEEE mcb_pmsm_foc_I2C_f28379d_CM_single 0 0 -3.4E+38 3.4E+38 ECU_ADDRESS 0x0001E7EC /end MEASUREMENT
/begin MEASUREMENT mcb_pmsm_foc_I2C_f28379d_B.Kp1 "" FLOAT32_IEEE mcb_pmsm_foc_I2C_f28379d_CM_single 0 0 -3.4E+38 3.4E+38 ECU_ADDRESS 0x0001E7D4 /end MEASUREMENT
/begin MEASUREMENT mcb_pmsm_foc_I2C_f28379d_B.LogicalOperator "" UBYTE mcb_pmsm_foc_I2C_f28379d_CM_logical 0 0 0 1 ECU_ADDRESS 0x0001E9F8 /end MEASUREMENT
/begin MEASUREMENT mcb_pmsm_foc_I2C_f28379d_B.LogicalOperator2 "" UBYTE mcb_pmsm_foc_I2C_f28379d_CM_logical 0 0 0 1 ECU_ADDRESS 0x0001E9EE
 /begin IF_DATA XCP
  /begin DAQ_EVENT VARIABLE /begin DEFAULT_EVENT_LIST EVENT 0x0002 /end DEFAULT_EVENT_LIST /end DAQ_EVENT
 /end IF_DATA
/end MEASUREMENT
/begin MEASUREMENT mcb_pmsm_foc_I2C_f28379d_B.LogicalOperator_a "" UBYTE mcb_pmsm_foc_I2C_f28379d_CM_logical 0 0 0 1 ECU_ADDRESS 0x0001E9FC /end MEASUREMENT
/begin MEASUREMENT mcb_pmsm_foc_I2C_f28379d_B.Lookup "" FLOAT32_IEEE mcb_pmsm_foc_I2C_f28379d_CM_single 0 0 -3.4E+38 3.4E+38 ARRAY_SIZE 4 ECU_ADDRESS 0x0001E764 /end MEASUREMENT
/begin MEASUREMENT mcb_pmsm_foc_I2C_f28379d_B.Lookup_p "" FLOAT32_IEEE mcb_pmsm_foc_I2C_f28379d_CM_single 0 0 -3.4E+38 3.4E+38 ARRAY_SIZE 4 ECU_ADDRESS 0x0001E83C /end MEASUREMENT
/begin MEASUREMENT mcb_pmsm_foc_I2C_f28379d_B.LowerRelop1 "" UBYTE mcb_pmsm_foc_I2C_f28379d_CM_logical 0 0 0 1 ECU_ADDRESS 0x0001EA1C /end MEASUREMENT
/begin MEASUREMENT mcb_pmsm_foc_I2C_f28379d_B.Max "" FLOAT32_IEEE mcb_pmsm_foc_I2C_f28379d_CM_single 0 0 -3.4E+38 3.4E+38 ECU_ADDRESS 0x0001E878 /end MEASUREMENT
/begin MEASUREMENT mcb_pmsm_foc_I2C_f28379d_B.Memory "" UWORD mcb_pmsm_foc_I2C_f28379d_CM_uint16 0 0 0 65535 ECU_ADDRESS 0x0001E990 /end MEASUREMENT
/begin MEASUREMENT mcb_pmsm_foc_I2C_f28379d_B.Memory1 "" UWORD mcb_pmsm_foc_I2C_f28379d_CM_uint16 0 0 0 65535 ECU_ADDRESS 0x0001E994 /end MEASUREMENT
/begin MEASUREMENT mcb_pmsm_foc_I2C_f28379d_B.Merge "" FLOAT32_IEEE mcb_pmsm_foc_I2C_f28379d_CM_single 0 0 -3.4E+38 3.4E+38 ECU_ADDRESS 0x0001E74C /end MEASUREMENT
/begin MEASUREMENT mcb_pmsm_foc_I2C_f28379d_B.Merge_a "" FLOAT32_IEEE mcb_pmsm_foc_I2C_f28379d_CM_single 0 0 -3.4E+38 3.4E+38 ECU_ADDRESS 0x0001E830 /end MEASUREMENT
/begin MEASUREMENT mcb_pmsm_foc_I2C_f28379d_B.Merge_c "" FLOAT32_IEEE mcb_pmsm_foc_I2C_f28379d_CM_single 0 0 -3.4E+38 3.4E+38 ECU_ADDRESS 0x0001E8A8 /end MEASUREMENT
/begin MEASUREMENT mcb_pmsm_foc_I2C_f28379d_B.Merge_d "" FLOAT32_IEEE mcb_pmsm_foc_I2C_f28379d_CM_single 0 0 -3.4E+38 3.4E+38 ECU_ADDRESS 0x0001E948 /end MEASUREMENT
/begin MEASUREMENT mcb_pmsm_foc_I2C_f28379d_B.Merge_i "" FLOAT32_IEEE mcb_pmsm_foc_I2C_f28379d_CM_single 0 0 -3.4E+38 3.4E+38 ARRAY_SIZE 2 ECU_ADDRESS 0x0001E810 /end MEASUREMENT
/begin MEASUREMENT mcb_pmsm_foc_I2C_f28379d_B.Merge_o "" FLOAT32_IEEE mcb_pmsm_foc_I2C_f28379d_CM_single 0 0 -3.4E+38 3.4E+38 ECU_ADDRESS 0x0001E75C /end MEASUREMENT
/begin MEASUREMENT mcb_pmsm_foc_I2C_f28379d_B.Min "" FLOAT32_IEEE mcb_pmsm_foc_I2C_f28379d_CM_single 0 0 -3.4E+38 3.4E+38 ECU_ADDRESS 0x0001E87C /end MEASUREMENT
/begin MEASUREMENT mcb_pmsm_foc_I2C_f28379d_B.MultiportSwitch "" UWORD mcb_pmsm_foc_I2C_f28379d_CM_uint16 0 0 0 65535 ARRAY_SIZE 2 ECU_ADDRESS 0x0001E9B4 /end MEASUREMENT
/begin MEASUREMENT mcb_pmsm_foc_I2C_f28379d_B.NOT "" UBYTE mcb_pmsm_foc_I2C_f28379d_CM_logical 0 0 0 1 ECU_ADDRESS 0x0001E9F0 /end MEASUREMENT
/begin MEASUREMENT mcb_pmsm_foc_I2C_f28379d_B.Numberofpolepairs "" FLOAT32_IEEE mcb_pmsm_foc_I2C_f28379d_CM_single 0 0 -3.4E+38 3.4E+38 ECU_ADDRESS 0x0001E750 /end MEASUREMENT
/begin MEASUREMENT mcb_pmsm_foc_I2C_f28379d_B.One_by_Two "" FLOAT32_IEEE mcb_pmsm_foc_I2C_f28379d_CM_single 0 0 -3.4E+38 3.4E+38 ARRAY_SIZE 3 ECU_ADDRESS 0x0001E8B4 /end MEASUREMENT
/begin MEASUREMENT mcb_pmsm_foc_I2C_f28379d_B.Output "" UWORD mcb_pmsm_foc_I2C_f28379d_CM_uint16 0 0 0 65535 ECU_ADDRESS 0x0001E9A4 /end MEASUREMENT
/begin MEASUREMENT mcb_pmsm_foc_I2C_f28379d_B.PProdOut "" FLOAT32_IEEE mcb_pmsm_foc_I2C_f28379d_CM_single 0 0 -3.4E+38 3.4E+38 ECU_ADDRESS 0x0001E7D0 /end MEASUREMENT
/begin MEASUREMENT mcb_pmsm_foc_I2C_f28379d_B.PProdOut_g "" FLOAT32_IEEE mcb_pmsm_foc_I2C_f28379d_CM_single 0 0 -3.4E+38 3.4E+38 ECU_ADDRESS 0x0001E7E8 /end MEASUREMENT
/begin MEASUREMENT mcb_pmsm_foc_I2C_f28379d_B.PU_Conversion "" FLOAT32_IEEE mcb_pmsm_foc_I2C_f28379d_CM_single 0 0 -3.4E+38 3.4E+38 ARRAY_SIZE 2 ECU_ADDRESS 0x0001E738 /end MEASUREMENT
/begin MEASUREMENT mcb_pmsm_foc_I2C_f28379d_B.PWM_Duty_Cycles "" FLOAT32_IEEE mcb_pmsm_foc_I2C_f28379d_CM_single 0 0 -3.4E+38 3.4E+38 ARRAY_SIZE 3 ECU_ADDRESS 0x0001E8C0 /end MEASUREMENT
/begin MEASUREMENT mcb_pmsm_foc_I2C_f28379d_B.PWM_En "" UBYTE mcb_pmsm_foc_I2C_f28379d_CM_logical 0 0 0 1 ECU_ADDRESS 0x0001EA14 /end MEASUREMENT
/begin MEASUREMENT mcb_pmsm_foc_I2C_f28379d_B.PositionToCount "" ULONG mcb_pmsm_foc_I2C_f28379d_CM_uint32 0 0 0 4294967295 ECU_ADDRESS 0x0001E680 /end MEASUREMENT
/begin MEASUREMENT mcb_pmsm_foc_I2C_f28379d_B.Product "" FLOAT32_IEEE mcb_pmsm_foc_I2C_f28379d_CM_single 0 0 -3.4E+38 3.4E+38 ECU_ADDRESS 0x0001E718 /end MEASUREMENT
/begin MEASUREMENT mcb_pmsm_foc_I2C_f28379d_B.Product1 "" FLOAT32_IEEE mcb_pmsm_foc_I2C_f28379d_CM_single 0 0 -3.4E+38 3.4E+38 ECU_ADDRESS 0x0001E720 /end MEASUREMENT
/begin MEASUREMENT mcb_pmsm_foc_I2C_f28379d_B.Product1_b "" FLOAT32_IEEE mcb_pmsm_foc_I2C_f28379d_CM_single 0 0 -3.4E+38 3.4E+38 ECU_ADDRESS 0x0001E78C /end MEASUREMENT
/begin MEASUREMENT mcb_pmsm_foc_I2C_f28379d_B.Product1_d "" FLOAT32_IEEE mcb_pmsm_foc_I2C_f28379d_CM_single 0 0 -3.4E+38 3.4E+38 ECU_ADDRESS 0x0001E85C /end MEASUREMENT
/begin MEASUREMENT mcb_pmsm_foc_I2C_f28379d_B.Product1_g "" FLOAT32_IEEE mcb_pmsm_foc_I2C_f28379d_CM_single 0 0 -3.4E+38 3.4E+38 ECU_ADDRESS 0x0001E808 /end MEASUREMENT
/begin MEASUREMENT mcb_pmsm_foc_I2C_f28379d_B.Product2 "" FLOAT32_IEEE mcb_pmsm_foc_I2C_f28379d_CM_single 0 0 -3.4E+38 3.4E+38 ECU_ADDRESS 0x0001E944 /end MEASUREMENT
/begin MEASUREMENT mcb_pmsm_foc_I2C_f28379d_B.Product_b "" FLOAT32_IEEE mcb_pmsm_foc_I2C_f28379d_CM_single 0 0 -3.4E+38 3.4E+38 ECU_ADDRESS 0x0001E93C /end MEASUREMENT
/begin MEASUREMENT mcb_pmsm_foc_I2C_f28379d_B.Product_d "" FLOAT32_IEEE mcb_pmsm_foc_I2C_f28379d_CM_single 0 0 -3.4E+38 3.4E+38 ECU_ADDRESS 0x0001E854 /end MEASUREMENT
/begin MEASUREMENT mcb_pmsm_foc_I2C_f28379d_B.Product_f "" FLOAT32_IEEE mcb_pmsm_foc_I2C_f28379d_CM_single 0 0 -3.4E+38 3.4E+38 ECU_ADDRESS 0x0001E804 /end MEASUREMENT
/begin MEASUREMENT mcb_pmsm_foc_I2C_f28379d_B.Product_i "" FLOAT32_IEEE mcb_pmsm_foc_I2C_f28379d_CM_single 0 0 -3.4E+38 3.4E+38 ECU_ADDRESS 0x0001E780 /end MEASUREMENT
/begin MEASUREMENT mcb_pmsm_foc_I2C_f28379d_B.Product_j "" FLOAT32_IEEE mcb_pmsm_foc_I2C_f28379d_CM_single 0 0 -3.4E+38 3.4E+38 ECU_ADDRESS 0x0001E800 /end MEASUREMENT
/begin MEASUREMENT mcb_pmsm_foc_I2C_f28379d_B.Product_o "" FLOAT32_IEEE mcb_pmsm_foc_I2C_f28379d_CM_single 0 0 -3.4E+38 3.4E+38 ARRAY_SIZE 2 ECU_ADDRESS 0x0001E91C /end MEASUREMENT
/begin MEASUREMENT mcb_pmsm_foc_I2C_f28379d_B.RT1 "" FLOAT32_IEEE mcb_pmsm_foc_I2C_f28379d_CM_single 0 0 -3.4E+38 3.4E+38 ECU_ADDRESS 0x0001E6E0
 /begin IF_DATA XCP
  /begin DAQ_EVENT VARIABLE /begin DEFAULT_EVENT_LIST EVENT 0x0000 /end DEFAULT_EVENT_LIST /end DAQ_EVENT
 /end IF_DATA
/end MEASUREMENT
/begin MEASUREMENT mcb_pmsm_foc_I2C_f28379d_B.RT2 "" FLOAT32_IEEE mcb_pmsm_foc_I2C_f28379d_CM_single 0 0 -3.4E+38 3.4E+38 ARRAY_SIZE 2 ECU_ADDRESS 0x0001E6F4 /end MEASUREMENT
/begin MEASUREMENT mcb_pmsm_foc_I2C_f28379d_B.RT3 "" FLOAT32_IEEE mcb_pmsm_foc_I2C_f28379d_CM_single 0 0 -3.4E+38 3.4E+38 ECU_ADDRESS 0x0001E6E4
 /begin IF_DATA XCP
  /begin DAQ_EVENT VARIABLE /begin DEFAULT_EVENT_LIST EVENT 0x0000 /end DEFAULT_EVENT_LIST /end DAQ_EVENT
 /end IF_DATA
/end MEASUREMENT
/begin MEASUREMENT mcb_pmsm_foc_I2C_f28379d_B.RT4 "" FLOAT32_IEEE mcb_pmsm_foc_I2C_f28379d_CM_single 0 0 -3.4E+38 3.4E+38 ECU_ADDRESS 0x0001E6FC /end MEASUREMENT
/begin MEASUREMENT mcb_pmsm_foc_I2C_f28379d_B.RT4_h "" UBYTE mcb_pmsm_foc_I2C_f28379d_CM_logical 0 0 0 1 ECU_ADDRESS 0x0001E9EA
 /begin IF_DATA XCP
  /begin DAQ_EVENT VARIABLE /begin DEFAULT_EVENT_LIST EVENT 0x0001 /end DEFAULT_EVENT_LIST /end DAQ_EVENT
 /end IF_DATA
/end MEASUREMENT
/begin MEASUREMENT mcb_pmsm_foc_I2C_f28379d_B.RT7 "" FLOAT32_IEEE mcb_pmsm_foc_I2C_f28379d_CM_single 0 0 -3.4E+38 3.4E+38 ECU_ADDRESS 0x0001E6E8
 /begin IF_DATA XCP
  /begin DAQ_EVENT VARIABLE /begin DEFAULT_EVENT_LIST EVENT 0x0000 /end DEFAULT_EVENT_LIST /end DAQ_EVENT
 /end IF_DATA
/end MEASUREMENT
/begin MEASUREMENT mcb_pmsm_foc_I2C_f28379d_B.Reciprocal "" FLOAT32_IEEE mcb_pmsm_foc_I2C_f28379d_CM_single 0 0 -3.4E+38 3.4E+38 ECU_ADDRESS 0x0001E92C /end MEASUREMENT
/begin MEASUREMENT mcb_pmsm_foc_I2C_f28379d_B.RelationalOperator "" UBYTE mcb_pmsm_foc_I2C_f28379d_CM_logical 0 0 0 1 ECU_ADDRESS 0x0001E9FE /end MEASUREMENT
/begin MEASUREMENT mcb_pmsm_foc_I2C_f28379d_B.RelationalOperator_e "" UBYTE mcb_pmsm_foc_I2C_f28379d_CM_logical 0 0 0 1 ECU_ADDRESS 0x0001EA08 /end MEASUREMENT
/begin MEASUREMENT mcb_pmsm_foc_I2C_f28379d_B.RelationalOperator_k "" UBYTE mcb_pmsm_foc_I2C_f28379d_CM_logical 0 0 0 1 ECU_ADDRESS 0x0001EA16 /end MEASUREMENT
/begin MEASUREMENT mcb_pmsm_foc_I2C_f28379d_B.RelationalOperator_l "" UBYTE mcb_pmsm_foc_I2C_f28379d_CM_logical 0 0 0 1 ECU_ADDRESS 0x0001EA1E /end MEASUREMENT
/begin MEASUREMENT mcb_pmsm_foc_I2C_f28379d_B.SCIReceive "" FLOAT32_IEEE mcb_pmsm_foc_I2C_f28379d_CM_single 0 0 -3.4E+38 3.4E+38 ARRAY_SIZE 2 ECU_ADDRESS 0x0001E700 /end MEASUREMENT
/begin MEASUREMENT mcb_pmsm_foc_I2C_f28379d_B.SCI_Tx_Data "" ULONG mcb_pmsm_foc_I2C_f28379d_CM_uint32 0 0 0 4294967295 ARRAY_SIZE 3 ECU_ADDRESS 0x0001E6A0 /end MEASUREMENT
/begin MEASUREMENT mcb_pmsm_foc_I2C_f28379d_B.SCI_Tx_Iteration "" ULONG mcb_pmsm_foc_I2C_f28379d_CM_uint32 0 0 0 4294967295 ECU_ADDRESS 0x0001E6AC /end MEASUREMENT
/begin MEASUREMENT mcb_pmsm_foc_I2C_f28379d_B.SPIMasterTransfer.SPIMasterTransfer "" UWORD mcb_pmsm_foc_I2C_f28379d_CM_uint16 0 0 0 65535 ARRAY_SIZE 1 ECU_ADDRESS 0x0001EA76 /end MEASUREMENT
/begin MEASUREMENT mcb_pmsm_foc_I2C_f28379d_B.SPIMasterTransfer1.SPIMasterTransfer "" UWORD mcb_pmsm_foc_I2C_f28379d_CM_uint16 0 0 0 65535 ARRAY_SIZE 1 ECU_ADDRESS 0x0001EA74 /end MEASUREMENT
/begin MEASUREMENT mcb_pmsm_foc_I2C_f28379d_B.Saturation "" FLOAT32_IEEE mcb_pmsm_foc_I2C_f28379d_CM_single 0 0 -3.4E+38 3.4E+38 ECU_ADDRESS 0x0001E7E0 /end MEASUREMENT
/begin MEASUREMENT mcb_pmsm_foc_I2C_f28379d_B.Saturation_f "" FLOAT32_IEEE mcb_pmsm_foc_I2C_f28379d_CM_single 0 0 -3.4E+38 3.4E+38 ECU_ADDRESS 0x0001E7F8 /end MEASUREMENT
/begin MEASUREMENT mcb_pmsm_foc_I2C_f28379d_B.Scale_to_PWM_Counter_PRD "" UWORD mcb_pmsm_foc_I2C_f28379d_CM_uint16 0 0 0 65535 ARRAY_SIZE 3 ECU_ADDRESS 0x0001E9C8 /end MEASUREMENT
/begin MEASUREMENT mcb_pmsm_foc_I2C_f28379d_B.Selector "" FLOAT32_IEEE mcb_pmsm_foc_I2C_f28379d_CM_single 0 0 -3.4E+38 3.4E+38 ARRAY_SIZE 2 ECU_ADDRESS 0x0001E7C4 /end MEASUREMENT
/begin MEASUREMENT mcb_pmsm_foc_I2C_f28379d_B.ShiftArithmetic1 "" UWORD mcb_pmsm_foc_I2C_f28379d_CM_uint16 0 0 0 65535 ECU_ADDRESS 0x0001E99E /end MEASUREMENT
/begin MEASUREMENT mcb_pmsm_foc_I2C_f28379d_B.ShiftArithmetic2 "" UWORD mcb_pmsm_foc_I2C_f28379d_CM_uint16 0 0 0 65535 ECU_ADDRESS 0x0001E9A2 /end MEASUREMENT
/begin MEASUREMENT mcb_pmsm_foc_I2C_f28379d_B.SpeedControl.AND3 "" UBYTE mcb_pmsm_foc_I2C_f28379d_CM_logical 0 0 0 1 ECU_ADDRESS 0x0001EA72
 /begin IF_DATA XCP
  /begin DAQ_EVENT VARIABLE /begin DEFAULT_EVENT_LIST EVENT 0x0000 /end DEFAULT_EVENT_LIST /end DAQ_EVENT
 /end IF_DATA
/end MEASUREMENT
/begin MEASUREMENT mcb_pmsm_foc_I2C_f28379d_B.SpeedControl.Add1 "" FLOAT32_IEEE mcb_pmsm_foc_I2C_f28379d_CM_single 0 0 -3.4E+38 3.4E+38 ECU_ADDRESS 0x0001EA38
 /begin IF_DATA XCP
  /begin DAQ_EVENT VARIABLE /begin DEFAULT_EVENT_LIST EVENT 0x0000 /end DEFAULT_EVENT_LIST /end DAQ_EVENT
 /end IF_DATA
/end MEASUREMENT
/begin MEASUREMENT mcb_pmsm_foc_I2C_f28379d_B.SpeedControl.DataStoreRead1 "" UBYTE mcb_pmsm_foc_I2C_f28379d_CM_logical 0 0 0 1 ECU_ADDRESS 0x0001EA64
 /begin IF_DATA XCP
  /begin DAQ_EVENT VARIABLE /begin DEFAULT_EVENT_LIST EVENT 0x0000 /end DEFAULT_EVENT_LIST /end DAQ_EVENT
 /end IF_DATA
/end MEASUREMENT
/begin MEASUREMENT mcb_pmsm_foc_I2C_f28379d_B.SpeedControl.DataStoreRead1_d "" UBYTE mcb_pmsm_foc_I2C_f28379d_CM_logical 0 0 0 1 ECU_ADDRESS 0x0001EA66
 /begin IF_DATA XCP
  /begin DAQ_EVENT VARIABLE /begin DEFAULT_EVENT_LIST EVENT 0x0000 /end DEFAULT_EVENT_LIST /end DAQ_EVENT
 /end IF_DATA
/end MEASUREMENT
/begin MEASUREMENT mcb_pmsm_foc_I2C_f28379d_B.SpeedControl.DeadZone "" FLOAT32_IEEE mcb_pmsm_foc_I2C_f28379d_CM_single 0 0 -3.4E+38 3.4E+38 ECU_ADDRESS 0x0001EA50
 /begin IF_DATA XCP
  /begin DAQ_EVENT VARIABLE /begin DEFAULT_EVENT_LIST EVENT 0x0000 /end DEFAULT_EVENT_LIST /end DAQ_EVENT
 /end IF_DATA
/end MEASUREMENT
/begin MEASUREMENT mcb_pmsm_foc_I2C_f28379d_B.SpeedControl.Equal1 "" UBYTE mcb_pmsm_foc_I2C_f28379d_CM_logical 0 0 0 1 ECU_ADDRESS 0x0001EA70
 /begin IF_DATA XCP
  /begin DAQ_EVENT VARIABLE /begin DEFAULT_EVENT_LIST EVENT 0x0000 /end DEFAULT_EVENT_LIST /end DAQ_EVENT
 /end IF_DATA
/end MEASUREMENT
/begin MEASUREMENT mcb_pmsm_foc_I2C_f28379d_B.SpeedControl.IProdOut "" FLOAT32_IEEE mcb_pmsm_foc_I2C_f28379d_CM_single 0 0 -3.4E+38 3.4E+38 ECU_ADDRESS 0x0001EA54
 /begin IF_DATA XCP
  /begin DAQ_EVENT VARIABLE /begin DEFAULT_EVENT_LIST EVENT 0x0000 /end DEFAULT_EVENT_LIST /end DAQ_EVENT
 /end IF_DATA
/end MEASUREMENT
/begin MEASUREMENT mcb_pmsm_foc_I2C_f28379d_B.SpeedControl.Id_ref "" FLOAT32_IEEE mcb_pmsm_foc_I2C_f28379d_CM_single 0 0 -3.4E+38 3.4E+38 ECU_ADDRESS 0x0001EA28
 /begin IF_DATA XCP
  /begin DAQ_EVENT VARIABLE /begin DEFAULT_EVENT_LIST EVENT 0x0000 /end DEFAULT_EVENT_LIST /end DAQ_EVENT
 /end IF_DATA
/end MEASUREMENT
/begin MEASUREMENT mcb_pmsm_foc_I2C_f28379d_B.SpeedControl.Integrator "" FLOAT32_IEEE mcb_pmsm_foc_I2C_f28379d_CM_single 0 0 -3.4E+38 3.4E+38 ECU_ADDRESS 0x0001EA48
 /begin IF_DATA XCP
  /begin DAQ_EVENT VARIABLE /begin DEFAULT_EVENT_LIST EVENT 0x0000 /end DEFAULT_EVENT_LIST /end DAQ_EVENT
 /end IF_DATA
/end MEASUREMENT
/begin MEASUREMENT mcb_pmsm_foc_I2C_f28379d_B.SpeedControl.Ki2 "" FLOAT32_IEEE mcb_pmsm_foc_I2C_f28379d_CM_single 0 0 -3.4E+38 3.4E+38 ECU_ADDRESS 0x0001EA44
 /begin IF_DATA XCP
  /begin DAQ_EVENT VARIABLE /begin DEFAULT_EVENT_LIST EVENT 0x0000 /end DEFAULT_EVENT_LIST /end DAQ_EVENT
 /end IF_DATA
/end MEASUREMENT
/begin MEASUREMENT mcb_pmsm_foc_I2C_f28379d_B.SpeedControl.LogicalOperator "" UBYTE mcb_pmsm_foc_I2C_f28379d_CM_logical 0 0 0 1 ECU_ADDRESS 0x0001EA68
 /begin IF_DATA XCP
  /begin DAQ_EVENT VARIABLE /begin DEFAULT_EVENT_LIST EVENT 0x0000 /end DEFAULT_EVENT_LIST /end DAQ_EVENT
 /end IF_DATA
/end MEASUREMENT
/begin MEASUREMENT mcb_pmsm_foc_I2C_f28379d_B.SpeedControl.PProdOut "" FLOAT32_IEEE mcb_pmsm_foc_I2C_f28379d_CM_single 0 0 -3.4E+38 3.4E+38 ECU_ADDRESS 0x0001EA40
 /begin IF_DATA XCP
  /begin DAQ_EVENT VARIABLE /begin DEFAULT_EVENT_LIST EVENT 0x0000 /end DEFAULT_EVENT_LIST /end DAQ_EVENT
 /end IF_DATA
/end MEASUREMENT
/begin MEASUREMENT mcb_pmsm_foc_I2C_f28379d_B.SpeedControl.Product "" FLOAT32_IEEE mcb_pmsm_foc_I2C_f28379d_CM_single 0 0 -3.4E+38 3.4E+38 ECU_ADDRESS 0x0001EA2C
 /begin IF_DATA XCP
  /begin DAQ_EVENT VARIABLE /begin DEFAULT_EVENT_LIST EVENT 0x0000 /end DEFAULT_EVENT_LIST /end DAQ_EVENT
 /end IF_DATA
/end MEASUREMENT
/begin MEASUREMENT mcb_pmsm_foc_I2C_f28379d_B.SpeedControl.Product1 "" FLOAT32_IEEE mcb_pmsm_foc_I2C_f28379d_CM_single 0 0 -3.4E+38 3.4E+38 ECU_ADDRESS 0x0001EA34
 /begin IF_DATA XCP
  /begin DAQ_EVENT VARIABLE /begin DEFAULT_EVENT_LIST EVENT 0x0000 /end DEFAULT_EVENT_LIST /end DAQ_EVENT
 /end IF_DATA
/end MEASUREMENT
/begin MEASUREMENT mcb_pmsm_foc_I2C_f28379d_B.SpeedControl.RelationalOperator "" UBYTE mcb_pmsm_foc_I2C_f28379d_CM_logical 0 0 0 1 ECU_ADDRESS 0x0001EA6A
 /begin IF_DATA XCP
  /begin DAQ_EVENT VARIABLE /begin DEFAULT_EVENT_LIST EVENT 0x0000 /end DEFAULT_EVENT_LIST /end DAQ_EVENT
 /end IF_DATA
/end MEASUREMENT
/begin MEASUREMENT mcb_pmsm_foc_I2C_f28379d_B.SpeedControl.Saturation "" FLOAT32_IEEE mcb_pmsm_foc_I2C_f28379d_CM_single 0 0 -3.4E+38 3.4E+38 ECU_ADDRESS 0x0001EA5C
 /begin IF_DATA XCP
  /begin DAQ_EVENT VARIABLE /begin DEFAULT_EVENT_LIST EVENT 0x0000 /end DEFAULT_EVENT_LIST /end DAQ_EVENT
 /end IF_DATA
/end MEASUREMENT
/begin MEASUREMENT mcb_pmsm_foc_I2C_f28379d_B.SpeedControl.Sum "" FLOAT32_IEEE mcb_pmsm_foc_I2C_f28379d_CM_single 0 0 -3.4E+38 3.4E+38 ECU_ADDRESS 0x0001EA3C
 /begin IF_DATA XCP
  /begin DAQ_EVENT VARIABLE /begin DEFAULT_EVENT_LIST EVENT 0x0000 /end DEFAULT_EVENT_LIST /end DAQ_EVENT
 /end IF_DATA
/end MEASUREMENT
/begin MEASUREMENT mcb_pmsm_foc_I2C_f28379d_B.SpeedControl.Sum_c "" FLOAT32_IEEE mcb_pmsm_foc_I2C_f28379d_CM_single 0 0 -3.4E+38 3.4E+38 ECU_ADDRESS 0x0001EA4C
 /begin IF_DATA XCP
  /begin DAQ_EVENT VARIABLE /begin DEFAULT_EVENT_LIST EVENT 0x0000 /end DEFAULT_EVENT_LIST /end DAQ_EVENT
 /end IF_DATA
/end MEASUREMENT
/begin MEASUREMENT mcb_pmsm_foc_I2C_f28379d_B.SpeedControl.Switch "" FLOAT32_IEEE mcb_pmsm_foc_I2C_f28379d_CM_single 0 0 -3.4E+38 3.4E+38 ECU_ADDRESS 0x0001EA24
 /begin IF_DATA XCP
  /begin DAQ_EVENT VARIABLE /begin DEFAULT_EVENT_LIST EVENT 0x0000 /end DEFAULT_EVENT_LIST /end DAQ_EVENT
 /end IF_DATA
/end MEASUREMENT
/begin MEASUREMENT mcb_pmsm_foc_I2C_f28379d_B.SpeedControl.Switch1 "" SBYTE mcb_pmsm_foc_I2C_f28379d_CM_int8 0 0 -128 127 ECU_ADDRESS 0x0001EA60
 /begin IF_DATA XCP
  /begin DAQ_EVENT VARIABLE /begin DEFAULT_EVENT_LIST EVENT 0x0000 /end DEFAULT_EVENT_LIST /end DAQ_EVENT
 /end IF_DATA
/end MEASUREMENT
/begin MEASUREMENT mcb_pmsm_foc_I2C_f28379d_B.SpeedControl.Switch2 "" SBYTE mcb_pmsm_foc_I2C_f28379d_CM_int8 0 0 -128 127 ECU_ADDRESS 0x0001EA62
 /begin IF_DATA XCP
  /begin DAQ_EVENT VARIABLE /begin DEFAULT_EVENT_LIST EVENT 0x0000 /end DEFAULT_EVENT_LIST /end DAQ_EVENT
 /end IF_DATA
/end MEASUREMENT
/begin MEASUREMENT mcb_pmsm_foc_I2C_f28379d_B.SpeedControl.Switch_d "" FLOAT32_IEEE mcb_pmsm_foc_I2C_f28379d_CM_single 0 0 -3.4E+38 3.4E+38 ECU_ADDRESS 0x0001EA58
 /begin IF_DATA XCP
  /begin DAQ_EVENT VARIABLE /begin DEFAULT_EVENT_LIST EVENT 0x0000 /end DEFAULT_EVENT_LIST /end DAQ_EVENT
 /end IF_DATA
/end MEASUREMENT
/begin MEASUREMENT mcb_pmsm_foc_I2C_f28379d_B.SpeedControl.UnitDelay "" FLOAT32_IEEE mcb_pmsm_foc_I2C_f28379d_CM_single 0 0 -3.4E+38 3.4E+38 ECU_ADDRESS 0x0001EA30
 /begin IF_DATA XCP
  /begin DAQ_EVENT VARIABLE /begin DEFAULT_EVENT_LIST EVENT 0x0000 /end DEFAULT_EVENT_LIST /end DAQ_EVENT
 /end IF_DATA
/end MEASUREMENT
/begin MEASUREMENT mcb_pmsm_foc_I2C_f28379d_B.SpeedControl.fixforDTpropagationissue "" UBYTE mcb_pmsm_foc_I2C_f28379d_CM_logical 0 0 0 1 ECU_ADDRESS 0x0001EA6C
 /begin IF_DATA XCP
  /begin DAQ_EVENT VARIABLE /begin DEFAULT_EVENT_LIST EVENT 0x0000 /end DEFAULT_EVENT_LIST /end DAQ_EVENT
 /end IF_DATA
/end MEASUREMENT
/begin MEASUREMENT mcb_pmsm_foc_I2C_f28379d_B.SpeedControl.fixforDTpropagationissue1 "" UBYTE mcb_pmsm_foc_I2C_f28379d_CM_logical 0 0 0 1 ECU_ADDRESS 0x0001EA6E
 /begin IF_DATA XCP
  /begin DAQ_EVENT VARIABLE /begin DEFAULT_EVENT_LIST EVENT 0x0000 /end DEFAULT_EVENT_LIST /end DAQ_EVENT
 /end IF_DATA
/end MEASUREMENT
/begin MEASUREMENT mcb_pmsm_foc_I2C_f28379d_B.SpeedCount "" SLONG mcb_pmsm_foc_I2C_f28379d_CM_int32 0 0 -2147483648 2147483647 ECU_ADDRESS 0x0001E970 /end MEASUREMENT
/begin MEASUREMENT mcb_pmsm_foc_I2C_f28379d_B.SpeedGain "" FLOAT32_IEEE mcb_pmsm_foc_I2C_f28379d_CM_single 0 0 -3.4E+38 3.4E+38 ECU_ADDRESS 0x0001E714 /end MEASUREMENT
/begin MEASUREMENT mcb_pmsm_foc_I2C_f28379d_B.Sqrt "" FLOAT32_IEEE mcb_pmsm_foc_I2C_f28379d_CM_single 0 0 -3.4E+38 3.4E+38 ECU_ADDRESS 0x0001E958 /end MEASUREMENT
/begin MEASUREMENT mcb_pmsm_foc_I2C_f28379d_B.SquareRoot "" FLOAT32_IEEE mcb_pmsm_foc_I2C_f28379d_CM_single 0 0 -3.4E+38 3.4E+38 ECU_ADDRESS 0x0001E924 /end MEASUREMENT
/begin MEASUREMENT mcb_pmsm_foc_I2C_f28379d_B.Sum "" ULONG mcb_pmsm_foc_I2C_f28379d_CM_uint32 0 0 0 4294967295 ARRAY_SIZE 4 ECU_ADDRESS 0x0001E688 /end MEASUREMENT
/begin MEASUREMENT mcb_pmsm_foc_I2C_f28379d_B.Sum1 "" FLOAT32_IEEE mcb_pmsm_foc_I2C_f28379d_CM_single 0 0 -3.4E+38 3.4E+38 ECU_ADDRESS 0x0001E80C /end MEASUREMENT
/begin MEASUREMENT mcb_pmsm_foc_I2C_f28379d_B.Sum1_j "" UWORD mcb_pmsm_foc_I2C_f28379d_CM_uint16 0 0 0 65535 ECU_ADDRESS 0x0001E996 /end MEASUREMENT
/begin MEASUREMENT mcb_pmsm_foc_I2C_f28379d_B.Sum2 "" FLOAT32_IEEE mcb_pmsm_foc_I2C_f28379d_CM_single 0 0 -3.4E+38 3.4E+38 ECU_ADDRESS 0x0001E77C /end MEASUREMENT
/begin MEASUREMENT mcb_pmsm_foc_I2C_f28379d_B.Sum2_p "" FLOAT32_IEEE mcb_pmsm_foc_I2C_f28379d_CM_single 0 0 -3.4E+38 3.4E+38 ECU_ADDRESS 0x0001E850 /end MEASUREMENT
/begin MEASUREMENT mcb_pmsm_foc_I2C_f28379d_B.Sum3 "" FLOAT32_IEEE mcb_pmsm_foc_I2C_f28379d_CM_single 0 0 -3.4E+38 3.4E+38 ECU_ADDRESS 0x0001E774 /end MEASUREMENT
/begin MEASUREMENT mcb_pmsm_foc_I2C_f28379d_B.Sum3_j "" FLOAT32_IEEE mcb_pmsm_foc_I2C_f28379d_CM_single 0 0 -3.4E+38 3.4E+38 ECU_ADDRESS 0x0001E84C /end MEASUREMENT
/begin MEASUREMENT mcb_pmsm_foc_I2C_f28379d_B.Sum4 "" FLOAT32_IEEE mcb_pmsm_foc_I2C_f28379d_CM_single 0 0 -3.4E+38 3.4E+38 ECU_ADDRESS 0x0001E784 /end MEASUREMENT
/begin MEASUREMENT mcb_pmsm_foc_I2C_f28379d_B.Sum4_h "" FLOAT32_IEEE mcb_pmsm_foc_I2C_f28379d_CM_single 0 0 -3.4E+38 3.4E+38 ECU_ADDRESS 0x0001E860 /end MEASUREMENT
/begin MEASUREMENT mcb_pmsm_foc_I2C_f28379d_B.Sum5 "" FLOAT32_IEEE mcb_pmsm_foc_I2C_f28379d_CM_single 0 0 -3.4E+38 3.4E+38 ECU_ADDRESS 0x0001E788 /end MEASUREMENT
/begin MEASUREMENT mcb_pmsm_foc_I2C_f28379d_B.Sum5_l "" FLOAT32_IEEE mcb_pmsm_foc_I2C_f28379d_CM_single 0 0 -3.4E+38 3.4E+38 ECU_ADDRESS 0x0001E858 /end MEASUREMENT
/begin MEASUREMENT mcb_pmsm_foc_I2C_f28379d_B.Sum6 "" FLOAT32_IEEE mcb_pmsm_foc_I2C_f28379d_CM_single 0 0 -3.4E+38 3.4E+38 ECU_ADDRESS 0x0001E790 /end MEASUREMENT
/begin MEASUREMENT mcb_pmsm_foc_I2C_f28379d_B.Sum6_h "" FLOAT32_IEEE mcb_pmsm_foc_I2C_f28379d_CM_single 0 0 -3.4E+38 3.4E+38 ECU_ADDRESS 0x0001E864 /end MEASUREMENT
/begin MEASUREMENT mcb_pmsm_foc_I2C_f28379d_B.Sum_a "" FLOAT32_IEEE mcb_pmsm_foc_I2C_f28379d_CM_single 0 0 -3.4E+38 3.4E+38 ECU_ADDRESS 0x0001E8A4 /end MEASUREMENT
/begin MEASUREMENT mcb_pmsm_foc_I2C_f28379d_B.Sum_g "" FLOAT32_IEEE mcb_pmsm_foc_I2C_f28379d_CM_single 0 0 -3.4E+38 3.4E+38 ECU_ADDRESS 0x0001E7F4 /end MEASUREMENT
/begin MEASUREMENT mcb_pmsm_foc_I2C_f28379d_B.Sum_h "" ULONG mcb_pmsm_foc_I2C_f28379d_CM_uint32 0 0 0 4294967295 ARRAY_SIZE 4 ECU_ADDRESS 0x0001E6B0 /end MEASUREMENT
/begin MEASUREMENT mcb_pmsm_foc_I2C_f28379d_B.Sum_hk "" UWORD mcb_pmsm_foc_I2C_f28379d_CM_uint16 0 0 0 65535 ECU_ADDRESS 0x0001E992 /end MEASUREMENT
/begin MEASUREMENT mcb_pmsm_foc_I2C_f28379d_B.Sum_j "" FLOAT32_IEEE mcb_pmsm_foc_I2C_f28379d_CM_single 0 0 -3.4E+38 3.4E+38 ECU_ADDRESS 0x0001E7E4 /end MEASUREMENT
/begin MEASUREMENT mcb_pmsm_foc_I2C_f28379d_B.Sum_jr "" FLOAT32_IEEE mcb_pmsm_foc_I2C_f28379d_CM_single 0 0 -3.4E+38 3.4E+38 ECU_ADDRESS 0x0001E940 /end MEASUREMENT
/begin MEASUREMENT mcb_pmsm_foc_I2C_f28379d_B.Sum_m "" FLOAT32_IEEE mcb_pmsm_foc_I2C_f28379d_CM_single 0 0 -3.4E+38 3.4E+38 ECU_ADDRESS 0x0001E7DC /end MEASUREMENT
/begin MEASUREMENT mcb_pmsm_foc_I2C_f28379d_B.Sum_o "" FLOAT32_IEEE mcb_pmsm_foc_I2C_f28379d_CM_single 0 0 -3.4E+38 3.4E+38 ECU_ADDRESS 0x0001E7CC /end MEASUREMENT
/begin MEASUREMENT mcb_pmsm_foc_I2C_f28379d_B.Switch "" FLOAT32_IEEE mcb_pmsm_foc_I2C_f28379d_CM_single 0 0 -3.4E+38 3.4E+38 ECU_ADDRESS 0x0001E748 /end MEASUREMENT
/begin MEASUREMENT mcb_pmsm_foc_I2C_f28379d_B.Switch1 "" FLOAT32_IEEE mcb_pmsm_foc_I2C_f28379d_CM_single 0 0 -3.4E+38 3.4E+38 ECU_ADDRESS 0x0001E954 /end MEASUREMENT
/begin MEASUREMENT mcb_pmsm_foc_I2C_f28379d_B.Switch1_h "" SBYTE mcb_pmsm_foc_I2C_f28379d_CM_int8 0 0 -128 127 ECU_ADDRESS 0x0001E9E0 /end MEASUREMENT
/begin MEASUREMENT mcb_pmsm_foc_I2C_f28379d_B.Switch1_j "" UWORD mcb_pmsm_foc_I2C_f28379d_CM_uint16 0 0 0 65535 ECU_ADDRESS 0x0001E9BC /end MEASUREMENT
/begin MEASUREMENT mcb_pmsm_foc_I2C_f28379d_B.Switch1_jv "" UWORD mcb_pmsm_foc_I2C_f28379d_CM_uint16 0 0 0 65535 ARRAY_SIZE 3 ECU_ADDRESS 0x0001E9C2 /end MEASUREMENT
/begin MEASUREMENT mcb_pmsm_foc_I2C_f28379d_B.Switch1_l "" SBYTE mcb_pmsm_foc_I2C_f28379d_CM_int8 0 0 -128 127 ECU_ADDRESS 0x0001E9E4 /end MEASUREMENT
/begin MEASUREMENT mcb_pmsm_foc_I2C_f28379d_B.Switch2 "" FLOAT32_IEEE mcb_pmsm_foc_I2C_f28379d_CM_single 0 0 -3.4E+38 3.4E+38 ECU_ADDRESS 0x0001E938 /end MEASUREMENT
/begin MEASUREMENT mcb_pmsm_foc_I2C_f28379d_B.Switch2_c "" SBYTE mcb_pmsm_foc_I2C_f28379d_CM_int8 0 0 -128 127 ECU_ADDRESS 0x0001E9E6 /end MEASUREMENT
/begin MEASUREMENT mcb_pmsm_foc_I2C_f28379d_B.Switch2_l "" SBYTE mcb_pmsm_foc_I2C_f28379d_CM_int8 0 0 -128 127 ECU_ADDRESS 0x0001E9E2 /end MEASUREMENT
/begin MEASUREMENT mcb_pmsm_foc_I2C_f28379d_B.Switch_a "" FLOAT32_IEEE mcb_pmsm_foc_I2C_f28379d_CM_single 0 0 -3.4E+38 3.4E+38 ECU_ADDRESS 0x0001E82C /end MEASUREMENT
/begin MEASUREMENT mcb_pmsm_foc_I2C_f28379d_B.Switch_as "" FLOAT32_IEEE mcb_pmsm_foc_I2C_f28379d_CM_single 0 0 -3.4E+38 3.4E+38 ECU_ADDRESS 0x0001E928 /end MEASUREMENT
/begin MEASUREMENT mcb_pmsm_foc_I2C_f28379d_B.Switch_b "" FLOAT32_IEEE mcb_pmsm_foc_I2C_f28379d_CM_single 0 0 -3.4E+38 3.4E+38 ARRAY_SIZE 2 ECU_ADDRESS 0x0001E90C /end MEASUREMENT
/begin MEASUREMENT mcb_pmsm_foc_I2C_f28379d_B.Switch_c "" UWORD mcb_pmsm_foc_I2C_f28379d_CM_uint16 0 0 0 65535 ECU_ADDRESS 0x0001E984 /end MEASUREMENT
/begin MEASUREMENT mcb_pmsm_foc_I2C_f28379d_B.Switch_f "" FLOAT32_IEEE mcb_pmsm_foc_I2C_f28379d_CM_single 0 0 -3.4E+38 3.4E+38 ECU_ADDRESS 0x0001E820 /end MEASUREMENT
/begin MEASUREMENT mcb_pmsm_foc_I2C_f28379d_B.Switch_g "" FLOAT32_IEEE mcb_pmsm_foc_I2C_f28379d_CM_single 0 0 -3.4E+38 3.4E+38 ECU_ADDRESS 0x0001E8B0 /end MEASUREMENT
/begin MEASUREMENT mcb_pmsm_foc_I2C_f28379d_B.Switch_h "" FLOAT32_IEEE mcb_pmsm_foc_I2C_f28379d_CM_single 0 0 -3.4E+38 3.4E+38 ARRAY_SIZE 2 ECU_ADDRESS 0x0001E8E4 /end MEASUREMENT
/begin MEASUREMENT mcb_pmsm_foc_I2C_f28379d_B.Switch_j "" FLOAT32_IEEE mcb_pmsm_foc_I2C_f28379d_CM_single 0 0 -3.4E+38 3.4E+38 ARRAY_SIZE 2 ECU_ADDRESS 0x0001E930 /end MEASUREMENT
/begin MEASUREMENT mcb_pmsm_foc_I2C_f28379d_B.Switch_m "" FLOAT32_IEEE mcb_pmsm_foc_I2C_f28379d_CM_single 0 0 -3.4E+38 3.4E+38 ECU_ADDRESS 0x0001E950 /end MEASUREMENT
/begin MEASUREMENT mcb_pmsm_foc_I2C_f28379d_B.Switch_n "" FLOAT32_IEEE mcb_pmsm_foc_I2C_f28379d_CM_single 0 0 -3.4E+38 3.4E+38 ECU_ADDRESS 0x0001E7FC /end MEASUREMENT
/begin MEASUREMENT mcb_pmsm_foc_I2C_f28379d_B.TmpSignalConversionAtSelectorIn "" FLOAT32_IEEE mcb_pmsm_foc_I2C_f28379d_CM_single 0 0 -3.4E+38 3.4E+38 ARRAY_SIZE 11 ECU_ADDRESS 0x0001E798 /end MEASUREMENT
/begin MEASUREMENT mcb_pmsm_foc_I2C_f28379d_B.UnitDelay "" FLOAT32_IEEE mcb_pmsm_foc_I2C_f28379d_CM_single 0 0 -3.4E+38 3.4E+38 ECU_ADDRESS 0x0001E71C /end MEASUREMENT
/begin MEASUREMENT mcb_pmsm_foc_I2C_f28379d_B.UnitDelay_l "" UBYTE mcb_pmsm_foc_I2C_f28379d_CM_logical 0 0 0 1 ECU_ADDRESS 0x0001E9EC
 /begin IF_DATA XCP
  /begin DAQ_EVENT VARIABLE /begin DEFAULT_EVENT_LIST EVENT 0x0002 /end DEFAULT_EVENT_LIST /end DAQ_EVENT
 /end IF_DATA
/end MEASUREMENT
/begin MEASUREMENT mcb_pmsm_foc_I2C_f28379d_B.Unwrap "" FLOAT32_IEEE mcb_pmsm_foc_I2C_f28379d_CM_single 0 0 -3.4E+38 3.4E+38 ECU_ADDRESS 0x0001E70C /end MEASUREMENT
/begin MEASUREMENT mcb_pmsm_foc_I2C_f28379d_B.UpperRelop "" UBYTE mcb_pmsm_foc_I2C_f28379d_CM_logical 0 0 0 1 ECU_ADDRESS 0x0001EA20 /end MEASUREMENT
/begin MEASUREMENT mcb_pmsm_foc_I2C_f28379d_B.WhileIterator "" SWORD mcb_pmsm_foc_I2C_f28379d_CM_int16 0 0 -32768 32767 ECU_ADDRESS 0x0001E9DA /end MEASUREMENT
/begin MEASUREMENT mcb_pmsm_foc_I2C_f28379d_B.a_plus_2b "" FLOAT32_IEEE mcb_pmsm_foc_I2C_f28379d_CM_single 0 0 -3.4E+38 3.4E+38 ECU_ADDRESS 0x0001E960 /end MEASUREMENT
/begin MEASUREMENT mcb_pmsm_foc_I2C_f28379d_B.acos_b "" FLOAT32_IEEE mcb_pmsm_foc_I2C_f28379d_CM_single 0 0 -3.4E+38 3.4E+38 ECU_ADDRESS 0x0001E8CC /end MEASUREMENT
/begin MEASUREMENT mcb_pmsm_foc_I2C_f28379d_B.add_b "" FLOAT32_IEEE mcb_pmsm_foc_I2C_f28379d_CM_single 0 0 -3.4E+38 3.4E+38 ECU_ADDRESS 0x0001E870 /end MEASUREMENT
/begin MEASUREMENT mcb_pmsm_foc_I2C_f28379d_B.add_c "" FLOAT32_IEEE mcb_pmsm_foc_I2C_f28379d_CM_single 0 0 -3.4E+38 3.4E+38 ECU_ADDRESS 0x0001E874 /end MEASUREMENT
/begin MEASUREMENT mcb_pmsm_foc_I2C_f28379d_B.algDD_o1 "" FLOAT32_IEEE mcb_pmsm_foc_I2C_f28379d_CM_single 0 0 -3.4E+38 3.4E+38 ECU_ADDRESS 0x0001E8EC /end MEASUREMENT
/begin MEASUREMENT mcb_pmsm_foc_I2C_f28379d_B.algDD_o1_e "" FLOAT32_IEEE mcb_pmsm_foc_I2C_f28379d_CM_single 0 0 -3.4E+38 3.4E+38 ECU_ADDRESS 0x0001E968 /end MEASUREMENT
/begin MEASUREMENT mcb_pmsm_foc_I2C_f28379d_B.algDD_o1_p "" FLOAT32_IEEE mcb_pmsm_foc_I2C_f28379d_CM_single 0 0 -3.4E+38 3.4E+38 ECU_ADDRESS 0x0001E914 /end MEASUREMENT
/begin MEASUREMENT mcb_pmsm_foc_I2C_f28379d_B.algDD_o2 "" FLOAT32_IEEE mcb_pmsm_foc_I2C_f28379d_CM_single 0 0 -3.4E+38 3.4E+38 ECU_ADDRESS 0x0001E8F0 /end MEASUREMENT
/begin MEASUREMENT mcb_pmsm_foc_I2C_f28379d_B.algDD_o2_h "" FLOAT32_IEEE mcb_pmsm_foc_I2C_f28379d_CM_single 0 0 -3.4E+38 3.4E+38 ECU_ADDRESS 0x0001E96C /end MEASUREMENT
/begin MEASUREMENT mcb_pmsm_foc_I2C_f28379d_B.algDD_o2_o "" FLOAT32_IEEE mcb_pmsm_foc_I2C_f28379d_CM_single 0 0 -3.4E+38 3.4E+38 ECU_ADDRESS 0x0001E918 /end MEASUREMENT
/begin MEASUREMENT mcb_pmsm_foc_I2C_f28379d_B.asin_o "" FLOAT32_IEEE mcb_pmsm_foc_I2C_f28379d_CM_single 0 0 -3.4E+38 3.4E+38 ECU_ADDRESS 0x0001E8DC /end MEASUREMENT
/begin MEASUREMENT mcb_pmsm_foc_I2C_f28379d_B.bcos "" FLOAT32_IEEE mcb_pmsm_foc_I2C_f28379d_CM_single 0 0 -3.4E+38 3.4E+38 ECU_ADDRESS 0x0001E8D8 /end MEASUREMENT
/begin MEASUREMENT mcb_pmsm_foc_I2C_f28379d_B.bsin "" FLOAT32_IEEE mcb_pmsm_foc_I2C_f28379d_CM_single 0 0 -3.4E+38 3.4E+38 ECU_ADDRESS 0x0001E8D0 /end MEASUREMENT
/begin MEASUREMENT mcb_pmsm_foc_I2C_f28379d_B.dcos "" FLOAT32_IEEE mcb_pmsm_foc_I2C_f28379d_CM_single 0 0 -3.4E+38 3.4E+38 ECU_ADDRESS 0x0001E900 /end MEASUREMENT
/begin MEASUREMENT mcb_pmsm_foc_I2C_f28379d_B.dsin "" FLOAT32_IEEE mcb_pmsm_foc_I2C_f28379d_CM_single 0 0 -3.4E+38 3.4E+38 ECU_ADDRESS 0x0001E8F8 /end MEASUREMENT
/begin MEASUREMENT mcb_pmsm_foc_I2C_f28379d_B.fixforDTpropagationissue "" UBYTE mcb_pmsm_foc_I2C_f28379d_CM_logical 0 0 0 1 ECU_ADDRESS 0x0001EA00 /end MEASUREMENT
/begin MEASUREMENT mcb_pmsm_foc_I2C_f28379d_B.fixforDTpropagationissue1 "" UBYTE mcb_pmsm_foc_I2C_f28379d_CM_logical 0 0 0 1 ECU_ADDRESS 0x0001EA02 /end MEASUREMENT
/begin MEASUREMENT mcb_pmsm_foc_I2C_f28379d_B.fixforDTpropagationissue1_o "" UBYTE mcb_pmsm_foc_I2C_f28379d_CM_logical 0 0 0 1 ECU_ADDRESS 0x0001EA0C /end MEASUREMENT
/begin MEASUREMENT mcb_pmsm_foc_I2C_f28379d_B.fixforDTpropagationissue_j "" UBYTE mcb_pmsm_foc_I2C_f28379d_CM_logical 0 0 0 1 ECU_ADDRESS 0x0001EA0A /end MEASUREMENT
/begin MEASUREMENT mcb_pmsm_foc_I2C_f28379d_B.indexing "" FLOAT32_IEEE mcb_pmsm_foc_I2C_f28379d_CM_single 0 0 -3.4E+38 3.4E+38 ECU_ADDRESS 0x0001E760 /end MEASUREMENT
/begin MEASUREMENT mcb_pmsm_foc_I2C_f28379d_B.indexing_d "" FLOAT32_IEEE mcb_pmsm_foc_I2C_f28379d_CM_single 0 0 -3.4E+38 3.4E+38 ECU_ADDRESS 0x0001E834 /end MEASUREMENT
/begin MEASUREMENT mcb_pmsm_foc_I2C_f28379d_B.one_by_sqrt3 "" FLOAT32_IEEE mcb_pmsm_foc_I2C_f28379d_CM_single 0 0 -3.4E+38 3.4E+38 ECU_ADDRESS 0x0001E964 /end MEASUREMENT
/begin MEASUREMENT mcb_pmsm_foc_I2C_f28379d_B.one_by_two "" FLOAT32_IEEE mcb_pmsm_foc_I2C_f28379d_CM_single 0 0 -3.4E+38 3.4E+38 ECU_ADDRESS 0x0001E868 /end MEASUREMENT
/begin MEASUREMENT mcb_pmsm_foc_I2C_f28379d_B.one_by_two_l "" FLOAT32_IEEE mcb_pmsm_foc_I2C_f28379d_CM_single 0 0 -3.4E+38 3.4E+38 ECU_ADDRESS 0x0001E884 /end MEASUREMENT
/begin MEASUREMENT mcb_pmsm_foc_I2C_f28379d_B.qcos "" FLOAT32_IEEE mcb_pmsm_foc_I2C_f28379d_CM_single 0 0 -3.4E+38 3.4E+38 ECU_ADDRESS 0x0001E8F4 /end MEASUREMENT
/begin MEASUREMENT mcb_pmsm_foc_I2C_f28379d_B.qsin "" FLOAT32_IEEE mcb_pmsm_foc_I2C_f28379d_CM_single 0 0 -3.4E+38 3.4E+38 ECU_ADDRESS 0x0001E904 /end MEASUREMENT
/begin MEASUREMENT mcb_pmsm_foc_I2C_f28379d_B.raw_angle "" UWORD mcb_pmsm_foc_I2C_f28379d_CM_uint16 0 0 0 65535 ECU_ADDRESS 0x0001E9D4
 /begin IF_DATA XCP
  /begin DAQ_EVENT VARIABLE /begin DEFAULT_EVENT_LIST EVENT 0x0001 /end DEFAULT_EVENT_LIST /end DAQ_EVENT
 /end IF_DATA
/end MEASUREMENT
/begin MEASUREMENT mcb_pmsm_foc_I2C_f28379d_B.sqrt3_by_two "" FLOAT32_IEEE mcb_pmsm_foc_I2C_f28379d_CM_single 0 0 -3.4E+38 3.4E+38 ECU_ADDRESS 0x0001E86C /end MEASUREMENT
/begin MEASUREMENT mcb_pmsm_foc_I2C_f28379d_B.sum_Ds "" FLOAT32_IEEE mcb_pmsm_foc_I2C_f28379d_CM_single 0 0 -3.4E+38 3.4E+38 ECU_ADDRESS 0x0001E8D4 /end MEASUREMENT
/begin MEASUREMENT mcb_pmsm_foc_I2C_f28379d_B.sum_Qs "" FLOAT32_IEEE mcb_pmsm_foc_I2C_f28379d_CM_single 0 0 -3.4E+38 3.4E+38 ECU_ADDRESS 0x0001E8E0 /end MEASUREMENT
/begin MEASUREMENT mcb_pmsm_foc_I2C_f28379d_B.sum_alpha "" FLOAT32_IEEE mcb_pmsm_foc_I2C_f28379d_CM_single 0 0 -3.4E+38 3.4E+38 ECU_ADDRESS 0x0001E908 /end MEASUREMENT
/begin MEASUREMENT mcb_pmsm_foc_I2C_f28379d_B.sum_beta "" FLOAT32_IEEE mcb_pmsm_foc_I2C_f28379d_CM_single 0 0 -3.4E+38 3.4E+38 ECU_ADDRESS 0x0001E8FC /end MEASUREMENT
/begin MEASUREMENT mcb_pmsm_foc_I2C_f28379d_DW.ADCGainsetting_SubsysRanBC "" SBYTE mcb_pmsm_foc_I2C_f28379d_CM_int8 0 0 -128 127 ECU_ADDRESS 0x0001E5E6 /end MEASUREMENT
/begin MEASUREMENT mcb_pmsm_foc_I2C_f28379d_DW.Add_DWORK1 "" SLONG mcb_pmsm_foc_I2C_f28379d_CM_int32 0 0 -2147483648 2147483647 ARRAY_SIZE 2 ECU_ADDRESS 0x0001E5A8 /end MEASUREMENT
/begin MEASUREMENT mcb_pmsm_foc_I2C_f28379d_DW.Add_DWORK1_n "" ULONG mcb_pmsm_foc_I2C_f28379d_CM_uint32 0 0 0 4294967295 ECU_ADDRESS 0x0001E5C8 /end MEASUREMENT
/begin MEASUREMENT mcb_pmsm_foc_I2C_f28379d_DW.AddressDataread_SubsysRanBC "" SBYTE mcb_pmsm_foc_I2C_f28379d_CM_int8 0 0 -128 127 ECU_ADDRESS 0x0001E61A
 /begin IF_DATA XCP
  /begin DAQ_EVENT VARIABLE /begin DEFAULT_EVENT_LIST EVENT 0x0002 /end DEFAULT_EVENT_LIST /end DAQ_EVENT
 /end IF_DATA
/end MEASUREMENT
/begin MEASUREMENT mcb_pmsm_foc_I2C_f28379d_DW.CalculateADCOffset_SubsysRanBC "" SBYTE mcb_pmsm_foc_I2C_f28379d_CM_int8 0 0 -128 127 ECU_ADDRESS 0x0001E5E8 /end MEASUREMENT
/begin MEASUREMENT mcb_pmsm_foc_I2C_f28379d_DW.CircBufIdx "" UWORD mcb_pmsm_foc_I2C_f28379d_CM_uint16 0 0 0 65535 ECU_ADDRESS 0x0001E5E0 /end MEASUREMENT
/begin MEASUREMENT mcb_pmsm_foc_I2C_f28379d_DW.Control_Mode "" UWORD mcb_pmsm_foc_I2C_f28379d_CM_uint16 0 0 0 65535 ECU_ADDRESS 0x0001E5DE /end MEASUREMENT
/begin MEASUREMENT mcb_pmsm_foc_I2C_f28379d_DW.CurrentControl_SubsysRanBC "" SBYTE mcb_pmsm_foc_I2C_f28379d_CM_int8 0 0 -128 127 ECU_ADDRESS 0x0001E5F6 /end MEASUREMENT
/begin MEASUREMENT mcb_pmsm_foc_I2C_f28379d_DW.DQAxisPriority_SubsysRanBC "" SBYTE mcb_pmsm_foc_I2C_f28379d_CM_int8 0 0 -128 127 ECU_ADDRESS 0x0001E612 /end MEASUREMENT
/begin MEASUREMENT mcb_pmsm_foc_I2C_f28379d_DW.DQEquivalence_SubsysRanBC "" SBYTE mcb_pmsm_foc_I2C_f28379d_CM_int8 0 0 -128 127 ECU_ADDRESS 0x0001E60C /end MEASUREMENT
/begin MEASUREMENT mcb_pmsm_foc_I2C_f28379d_DW.DRV830xEnable_FRAC_LEN "" SLONG mcb_pmsm_foc_I2C_f28379d_CM_int32 0 0 -2147483648 2147483647 ECU_ADDRESS 0x0001E5B0 /end MEASUREMENT
/begin MEASUREMENT mcb_pmsm_foc_I2C_f28379d_DW.DataRead_SubsysRanBC "" SBYTE mcb_pmsm_foc_I2C_f28379d_CM_int8 0 0 -128 127 ECU_ADDRESS 0x0001E61C
 /begin IF_DATA XCP
  /begin DAQ_EVENT VARIABLE /begin DEFAULT_EVENT_LIST EVENT 0x0001 /end DEFAULT_EVENT_LIST /end DAQ_EVENT
 /end IF_DATA
/end MEASUREMENT
/begin MEASUREMENT mcb_pmsm_foc_I2C_f28379d_DW.Data_SubsysRanBC "" SBYTE mcb_pmsm_foc_I2C_f28379d_CM_int8 0 0 -128 127 ECU_ADDRESS 0x0001E5FC /end MEASUREMENT
/begin MEASUREMENT mcb_pmsm_foc_I2C_f28379d_DW.Debug_signals "" UWORD mcb_pmsm_foc_I2C_f28379d_CM_uint16 0 0 0 65535 ECU_ADDRESS 0x0001E5DC
 /begin IF_DATA XCP
  /begin DAQ_EVENT VARIABLE /begin DEFAULT_EVENT_LIST EVENT 0x0000 /end DEFAULT_EVENT_LIST /end DAQ_EVENT
 /end IF_DATA
/end MEASUREMENT
/begin MEASUREMENT mcb_pmsm_foc_I2C_f28379d_DW.DefaultADCOffset_SubsysRanBC "" SBYTE mcb_pmsm_foc_I2C_f28379d_CM_int8 0 0 -128 127 ECU_ADDRESS 0x0001E5E4 /end MEASUREMENT
/begin MEASUREMENT mcb_pmsm_foc_I2C_f28379d_DW.Delay1ms.Delay1ms_SubsysRanBC "" SBYTE mcb_pmsm_foc_I2C_f28379d_CM_int8 0 0 -128 127 ECU_ADDRESS 0x0001E664
 /begin IF_DATA XCP
  /begin DAQ_EVENT VARIABLE /begin DEFAULT_EVENT_LIST EVENT 0x0002 /end DEFAULT_EVENT_LIST /end DAQ_EVENT
 /end IF_DATA
/end MEASUREMENT
/begin MEASUREMENT mcb_pmsm_foc_I2C_f28379d_DW.Delay_DSTATE "" FLOAT32_IEEE mcb_pmsm_foc_I2C_f28379d_CM_single 0 0 -3.4E+38 3.4E+38 ECU_ADDRESS 0x0001E50C /end MEASUREMENT
/begin MEASUREMENT mcb_pmsm_foc_I2C_f28379d_DW.Delay_DSTATE_p "" ULONG mcb_pmsm_foc_I2C_f28379d_CM_uint32 0 0 0 4294967295 ARRAY_SIZE 20 ECU_ADDRESS 0x0001E510 /end MEASUREMENT
/begin MEASUREMENT mcb_pmsm_foc_I2C_f28379d_DW.DigitalOutput1_FRAC_LEN "" SLONG mcb_pmsm_foc_I2C_f28379d_CM_int32 0 0 -2147483648 2147483647 ECU_ADDRESS 0x0001E5A0 /end MEASUREMENT
/begin MEASUREMENT mcb_pmsm_foc_I2C_f28379d_DW.DigitalOutput_FRAC_LEN "" SLONG mcb_pmsm_foc_I2C_f28379d_CM_int32 0 0 -2147483648 2147483647 ECU_ADDRESS 0x0001E598
 /begin IF_DATA XCP
  /begin DAQ_EVENT VARIABLE /begin DEFAULT_EVENT_LIST EVENT 0x0003 /end DEFAULT_EVENT_LIST /end DAQ_EVENT
 /end IF_DATA
/end MEASUREMENT
/begin MEASUREMENT mcb_pmsm_foc_I2C_f28379d_DW.DigitalOutput_FRAC_LEN_e "" SLONG mcb_pmsm_foc_I2C_f28379d_CM_int32 0 0 -2147483648 2147483647 ECU_ADDRESS 0x0001E59C /end MEASUREMENT
/begin MEASUREMENT mcb_pmsm_foc_I2C_f28379d_DW.Enable "" UBYTE mcb_pmsm_foc_I2C_f28379d_CM_logical 0 0 0 1 ECU_ADDRESS 0x0001E620
 /begin IF_DATA XCP
  /begin DAQ_EVENT VARIABLE /begin DEFAULT_EVENT_LIST EVENT 0x0000 /end DEFAULT_EVENT_LIST /end DAQ_EVENT
 /end IF_DATA
/end MEASUREMENT
/begin MEASUREMENT mcb_pmsm_foc_I2C_f28379d_DW.Enable_I2C "" UBYTE mcb_pmsm_foc_I2C_f28379d_CM_logical 0 0 0 1 ECU_ADDRESS 0x0001E622
 /begin IF_DATA XCP
  /begin DAQ_EVENT VARIABLE /begin DEFAULT_EVENT_LIST EVENT 0x0000 /end DEFAULT_EVENT_LIST /end DAQ_EVENT
 /end IF_DATA
/end MEASUREMENT
/begin MEASUREMENT mcb_pmsm_foc_I2C_f28379d_DW.End_SubsysRanBC "" SBYTE mcb_pmsm_foc_I2C_f28379d_CM_int8 0 0 -128 127 ECU_ADDRESS 0x0001E5FE /end MEASUREMENT
/begin MEASUREMENT mcb_pmsm_foc_I2C_f28379d_DW.IaOffset "" UWORD mcb_pmsm_foc_I2C_f28379d_CM_uint16 0 0 0 65535 ECU_ADDRESS 0x0001E5D8 /end MEASUREMENT
/begin MEASUREMENT mcb_pmsm_foc_I2C_f28379d_DW.IbOffset "" UWORD mcb_pmsm_foc_I2C_f28379d_CM_uint16 0 0 0 65535 ECU_ADDRESS 0x0001E5DA /end MEASUREMENT
/begin MEASUREMENT mcb_pmsm_foc_I2C_f28379d_DW.IfActionSubsystem.IfActionSubsystem_SubsysRanBC "" SBYTE mcb_pmsm_foc_I2C_f28379d_CM_int8 0 0 -128 127 ECU_ADDRESS 0x0001E662 /end MEASUREMENT
/begin MEASUREMENT mcb_pmsm_foc_I2C_f28379d_DW.IfActionSubsystem1.IfActionSubsystem1_SubsysRanBC "" SBYTE mcb_pmsm_foc_I2C_f28379d_CM_int8 0 0 -128 127 ECU_ADDRESS 0x0001E660 /end MEASUREMENT
/begin MEASUREMENT mcb_pmsm_foc_I2C_f28379d_DW.IfActionSubsystem1_SubsysRanBC "" SBYTE mcb_pmsm_foc_I2C_f28379d_CM_int8 0 0 -128 127 ECU_ADDRESS 0x0001E5EE /end MEASUREMENT
/begin MEASUREMENT mcb_pmsm_foc_I2C_f28379d_DW.IfActionSubsystem1_SubsysRanB_n "" SBYTE mcb_pmsm_foc_I2C_f28379d_CM_int8 0 0 -128 127 ECU_ADDRESS 0x0001E602 /end MEASUREMENT
/begin MEASUREMENT mcb_pmsm_foc_I2C_f28379d_DW.IfActionSubsystem1_k.IfActionSubsystem1_SubsysRanBC "" SBYTE mcb_pmsm_foc_I2C_f28379d_CM_int8 0 0 -128 127 ECU_ADDRESS 0x0001E65C /end MEASUREMENT
/begin MEASUREMENT mcb_pmsm_foc_I2C_f28379d_DW.IfActionSubsystem2_SubsysRanBC "" SBYTE mcb_pmsm_foc_I2C_f28379d_CM_int8 0 0 -128 127 ECU_ADDRESS 0x0001E5EC /end MEASUREMENT
/begin MEASUREMENT mcb_pmsm_foc_I2C_f28379d_DW.IfActionSubsystem3_SubsysRanBC "" SBYTE mcb_pmsm_foc_I2C_f28379d_CM_int8 0 0 -128 127 ECU_ADDRESS 0x0001E5EA /end MEASUREMENT
/begin MEASUREMENT mcb_pmsm_foc_I2C_f28379d_DW.IfActionSubsystem_SubsysRanBC "" SBYTE mcb_pmsm_foc_I2C_f28379d_CM_int8 0 0 -128 127 ECU_ADDRESS 0x0001E5F0 /end MEASUREMENT
/begin MEASUREMENT mcb_pmsm_foc_I2C_f28379d_DW.IfActionSubsystem_SubsysRanBC_j "" SBYTE mcb_pmsm_foc_I2C_f28379d_CM_int8 0 0 -128 127 ECU_ADDRESS 0x0001E5F2 /end MEASUREMENT
/begin MEASUREMENT mcb_pmsm_foc_I2C_f28379d_DW.IfActionSubsystem_SubsysRanBC_l "" SBYTE mcb_pmsm_foc_I2C_f28379d_CM_int8 0 0 -128 127 ECU_ADDRESS 0x0001E604 /end MEASUREMENT
/begin MEASUREMENT mcb_pmsm_foc_I2C_f28379d_DW.IfActionSubsystem_e.IfActionSubsystem_SubsysRanBC "" SBYTE mcb_pmsm_foc_I2C_f28379d_CM_int8 0 0 -128 127 ECU_ADDRESS 0x0001E65E /end MEASUREMENT
/begin MEASUREMENT mcb_pmsm_foc_I2C_f28379d_DW.Initialization_SubsysRanBC "" SBYTE mcb_pmsm_foc_I2C_f28379d_CM_int8 0 0 -128 127 ECU_ADDRESS 0x0001E618
 /begin IF_DATA XCP
  /begin DAQ_EVENT VARIABLE /begin DEFAULT_EVENT_LIST EVENT 0x0002 /end DEFAULT_EVENT_LIST /end DAQ_EVENT
 /end IF_DATA
/end MEASUREMENT
/begin MEASUREMENT mcb_pmsm_foc_I2C_f28379d_DW.Integrator_DSTATE "" FLOAT32_IEEE mcb_pmsm_foc_I2C_f28379d_CM_single 0 0 -3.4E+38 3.4E+38 ECU_ADDRESS 0x0001E504 /end MEASUREMENT
/begin MEASUREMENT mcb_pmsm_foc_I2C_f28379d_DW.Integrator_DSTATE_o "" FLOAT32_IEEE mcb_pmsm_foc_I2C_f28379d_CM_single 0 0 -3.4E+38 3.4E+38 ECU_ADDRESS 0x0001E508 /end MEASUREMENT
/begin MEASUREMENT mcb_pmsm_foc_I2C_f28379d_DW.Integrator_PrevResetState "" SBYTE mcb_pmsm_foc_I2C_f28379d_CM_int8 0 0 -128 127 ECU_ADDRESS 0x0001E5F8 /end MEASUREMENT
/begin MEASUREMENT mcb_pmsm_foc_I2C_f28379d_DW.Integrator_PrevResetState_k "" SBYTE mcb_pmsm_foc_I2C_f28379d_CM_int8 0 0 -128 127 ECU_ADDRESS 0x0001E5FA /end MEASUREMENT
/begin MEASUREMENT mcb_pmsm_foc_I2C_f28379d_DW.Limiter_SubsysRanBC "" SBYTE mcb_pmsm_foc_I2C_f28379d_CM_int8 0 0 -128 127 ECU_ADDRESS 0x0001E610 /end MEASUREMENT
/begin MEASUREMENT mcb_pmsm_foc_I2C_f28379d_DW.Output_DSTATE "" UWORD mcb_pmsm_foc_I2C_f28379d_CM_uint16 0 0 0 65535 ECU_ADDRESS 0x0001E5CC /end MEASUREMENT
/begin MEASUREMENT mcb_pmsm_foc_I2C_f28379d_DW.Passthrough_SubsysRanBC "" SBYTE mcb_pmsm_foc_I2C_f28379d_CM_int8 0 0 -128 127 ECU_ADDRESS 0x0001E60E /end MEASUREMENT
/begin MEASUREMENT mcb_pmsm_foc_I2C_f28379d_DW.PosRef "" FLOAT32_IEEE mcb_pmsm_foc_I2C_f28379d_CM_single 0 0 -3.4E+38 3.4E+38 ECU_ADDRESS 0x0001E580
 /begin IF_DATA XCP
  /begin DAQ_EVENT VARIABLE /begin DEFAULT_EVENT_LIST EVENT 0x0000 /end DEFAULT_EVENT_LIST /end DAQ_EVENT
 /end IF_DATA
/end MEASUREMENT
/begin MEASUREMENT mcb_pmsm_foc_I2C_f28379d_DW.RT1_ActiveBufIdx "" SWORD mcb_pmsm_foc_I2C_f28379d_CM_int16 0 0 -32768 32767 ECU_ADDRESS 0x0001E5CE
 /begin IF_DATA XCP
  /begin DAQ_EVENT VARIABLE /begin DEFAULT_EVENT_LIST EVENT 0x0000 /end DEFAULT_EVENT_LIST /end DAQ_EVENT
 /end IF_DATA
/end MEASUREMENT
/begin MEASUREMENT mcb_pmsm_foc_I2C_f28379d_DW.RT1_Buffer "" FLOAT32_IEEE mcb_pmsm_foc_I2C_f28379d_CM_single 0 0 -3.4E+38 3.4E+38 ARRAY_SIZE 2 ECU_ADDRESS 0x0001E560
 /begin IF_DATA XCP
  /begin DAQ_EVENT VARIABLE /begin DEFAULT_EVENT_LIST EVENT 0x0000 /end DEFAULT_EVENT_LIST /end DAQ_EVENT
 /end IF_DATA
/end MEASUREMENT
/begin MEASUREMENT mcb_pmsm_foc_I2C_f28379d_DW.RT1_semaphoreTaken "" SWORD mcb_pmsm_foc_I2C_f28379d_CM_int16 0 0 -32768 32767 ECU_ADDRESS 0x0001E5D0
 /begin IF_DATA XCP
  /begin DAQ_EVENT VARIABLE /begin DEFAULT_EVENT_LIST EVENT 0x0000 /end DEFAULT_EVENT_LIST /end DAQ_EVENT
 /end IF_DATA
/end MEASUREMENT
/begin MEASUREMENT mcb_pmsm_foc_I2C_f28379d_DW.RT2_ActiveBufIdx "" SWORD mcb_pmsm_foc_I2C_f28379d_CM_int16 0 0 -32768 32767 ECU_ADDRESS 0x0001E5D4
 /begin IF_DATA XCP
  /begin DAQ_EVENT VARIABLE /begin DEFAULT_EVENT_LIST EVENT 0x0000 /end DEFAULT_EVENT_LIST /end DAQ_EVENT
 /end IF_DATA
/end MEASUREMENT
/begin MEASUREMENT mcb_pmsm_foc_I2C_f28379d_DW.RT2_Buffer "" FLOAT32_IEEE mcb_pmsm_foc_I2C_f28379d_CM_single 0 0 -3.4E+38 3.4E+38 ARRAY_SIZE 4 ECU_ADDRESS 0x0001E570
 /begin IF_DATA XCP
  /begin DAQ_EVENT VARIABLE /begin DEFAULT_EVENT_LIST EVENT 0x0000 /end DEFAULT_EVENT_LIST /end DAQ_EVENT
 /end IF_DATA
/end MEASUREMENT
/begin MEASUREMENT mcb_pmsm_foc_I2C_f28379d_DW.RT3_ActiveBufIdx "" SWORD mcb_pmsm_foc_I2C_f28379d_CM_int16 0 0 -32768 32767 ECU_ADDRESS 0x0001E5D2
 /begin IF_DATA XCP
  /begin DAQ_EVENT VARIABLE /begin DEFAULT_EVENT_LIST EVENT 0x0000 /end DEFAULT_EVENT_LIST /end DAQ_EVENT
 /end IF_DATA
/end MEASUREMENT
/begin MEASUREMENT mcb_pmsm_foc_I2C_f28379d_DW.RT3_Buffer "" FLOAT32_IEEE mcb_pmsm_foc_I2C_f28379d_CM_single 0 0 -3.4E+38 3.4E+38 ARRAY_SIZE 2 ECU_ADDRESS 0x0001E568
 /begin IF_DATA XCP
  /begin DAQ_EVENT VARIABLE /begin DEFAULT_EVENT_LIST EVENT 0x0000 /end DEFAULT_EVENT_LIST /end DAQ_EVENT
 /end IF_DATA
/end MEASUREMENT
/begin MEASUREMENT mcb_pmsm_foc_I2C_f28379d_DW.RT4_ActiveBufIdx "" SWORD mcb_pmsm_foc_I2C_f28379d_CM_int16 0 0 -32768 32767 ECU_ADDRESS 0x0001E5D6
 /begin IF_DATA XCP
  /begin DAQ_EVENT VARIABLE /begin DEFAULT_EVENT_LIST EVENT 0x0001 /end DEFAULT_EVENT_LIST /end DAQ_EVENT
 /end IF_DATA
/end MEASUREMENT
/begin MEASUREMENT mcb_pmsm_foc_I2C_f28379d_DW.RT4_Buffer "" FLOAT32_IEEE mcb_pmsm_foc_I2C_f28379d_CM_single 0 0 -3.4E+38 3.4E+38 ARRAY_SIZE 2 ECU_ADDRESS 0x0001E584
 /begin IF_DATA XCP
  /begin DAQ_EVENT VARIABLE /begin DEFAULT_EVENT_LIST EVENT 0x0001 /end DEFAULT_EVENT_LIST /end DAQ_EVENT
 /end IF_DATA
/end MEASUREMENT
/begin MEASUREMENT mcb_pmsm_foc_I2C_f28379d_DW.SPIMasterTransfer.objisempty "" UBYTE mcb_pmsm_foc_I2C_f28379d_CM_logical 0 0 0 1 ECU_ADDRESS 0x0001E658 /end MEASUREMENT
/begin MEASUREMENT mcb_pmsm_foc_I2C_f28379d_DW.SPIMasterTransfer1.objisempty "" UBYTE mcb_pmsm_foc_I2C_f28379d_CM_logical 0 0 0 1 ECU_ADDRESS 0x0001E644 /end MEASUREMENT
/begin MEASUREMENT mcb_pmsm_foc_I2C_f28379d_DW.SerialReceive_SubsysRanBC "" SBYTE mcb_pmsm_foc_I2C_f28379d_CM_int8 0 0 -128 127 ECU_ADDRESS 0x0001E5F4 /end MEASUREMENT
/begin MEASUREMENT mcb_pmsm_foc_I2C_f28379d_DW.SpeedControl.Integrator_DSTATE "" FLOAT32_IEEE mcb_pmsm_foc_I2C_f28379d_CM_single 0 0 -3.4E+38 3.4E+38 ECU_ADDRESS 0x0001E62C
 /begin IF_DATA XCP
  /begin DAQ_EVENT VARIABLE /begin DEFAULT_EVENT_LIST EVENT 0x0000 /end DEFAULT_EVENT_LIST /end DAQ_EVENT
 /end IF_DATA
/end MEASUREMENT
/begin MEASUREMENT mcb_pmsm_foc_I2C_f28379d_DW.SpeedControl.Integrator_PrevResetState "" SBYTE mcb_pmsm_foc_I2C_f28379d_CM_int8 0 0 -128 127 ECU_ADDRESS 0x0001E630
 /begin IF_DATA XCP
  /begin DAQ_EVENT VARIABLE /begin DEFAULT_EVENT_LIST EVENT 0x0000 /end DEFAULT_EVENT_LIST /end DAQ_EVENT
 /end IF_DATA
/end MEASUREMENT
/begin MEASUREMENT mcb_pmsm_foc_I2C_f28379d_DW.SpeedControl.UnitDelay_DSTATE "" FLOAT32_IEEE mcb_pmsm_foc_I2C_f28379d_CM_single 0 0 -3.4E+38 3.4E+38 ECU_ADDRESS 0x0001E628
 /begin IF_DATA XCP
  /begin DAQ_EVENT VARIABLE /begin DEFAULT_EVENT_LIST EVENT 0x0000 /end DEFAULT_EVENT_LIST /end DAQ_EVENT
 /end IF_DATA
/end MEASUREMENT
/begin MEASUREMENT mcb_pmsm_foc_I2C_f28379d_DW.SpeedCount_DWORK1 "" SLONG mcb_pmsm_foc_I2C_f28379d_CM_int32 0 0 -2147483648 2147483647 ECU_ADDRESS 0x0001E5A4 /end MEASUREMENT
/begin MEASUREMENT mcb_pmsm_foc_I2C_f28379d_DW.SpeedRef "" FLOAT32_IEEE mcb_pmsm_foc_I2C_f28379d_CM_single 0 0 -3.4E+38 3.4E+38 ECU_ADDRESS 0x0001E58C
 /begin IF_DATA XCP
  /begin DAQ_EVENT VARIABLE /begin DEFAULT_EVENT_LIST EVENT 0x0000 /end DEFAULT_EVENT_LIST /end DAQ_EVENT
 /end IF_DATA
/end MEASUREMENT
/begin MEASUREMENT mcb_pmsm_foc_I2C_f28379d_DW.Start_SubsysRanBC "" SBYTE mcb_pmsm_foc_I2C_f28379d_CM_int8 0 0 -128 127 ECU_ADDRESS 0x0001E600 /end MEASUREMENT
/begin MEASUREMENT mcb_pmsm_foc_I2C_f28379d_DW.Subsystem1_SubsysRanBC "" SBYTE mcb_pmsm_foc_I2C_f28379d_CM_int8 0 0 -128 127 ECU_ADDRESS 0x0001E608 /end MEASUREMENT
/begin MEASUREMENT mcb_pmsm_foc_I2C_f28379d_DW.Subsystem2_SubsysRanBC "" SBYTE mcb_pmsm_foc_I2C_f28379d_CM_int8 0 0 -128 127 ECU_ADDRESS 0x0001E606 /end MEASUREMENT
/begin MEASUREMENT mcb_pmsm_foc_I2C_f28379d_DW.Subsystem_SubsysRanBC "" SBYTE mcb_pmsm_foc_I2C_f28379d_CM_int8 0 0 -128 127 ECU_ADDRESS 0x0001E60A /end MEASUREMENT
/begin MEASUREMENT mcb_pmsm_foc_I2C_f28379d_DW.Sum_DWORK1 "" ULONG mcb_pmsm_foc_I2C_f28379d_CM_uint32 0 0 0 4294967295 ARRAY_SIZE 4 ECU_ADDRESS 0x0001E5B8 /end MEASUREMENT
/begin MEASUREMENT mcb_pmsm_foc_I2C_f28379d_DW.UnitDelay_DSTATE "" FLOAT32_IEEE mcb_pmsm_foc_I2C_f28379d_CM_single 0 0 -3.4E+38 3.4E+38 ECU_ADDRESS 0x0001E500 /end MEASUREMENT
/begin MEASUREMENT mcb_pmsm_foc_I2C_f28379d_DW.UnitDelay_DSTATE_f "" UBYTE mcb_pmsm_foc_I2C_f28379d_CM_logical 0 0 0 1 ECU_ADDRESS 0x0001E5E2
 /begin IF_DATA XCP
  /begin DAQ_EVENT VARIABLE /begin DEFAULT_EVENT_LIST EVENT 0x0002 /end DEFAULT_EVENT_LIST /end DAQ_EVENT
 /end IF_DATA
/end MEASUREMENT
/begin MEASUREMENT mcb_pmsm_foc_I2C_f28379d_DW.Unwrap_Cumsum "" FLOAT32_IEEE mcb_pmsm_foc_I2C_f28379d_CM_single 0 0 -3.4E+38 3.4E+38 ECU_ADDRESS 0x0001E594 /end MEASUREMENT
/begin MEASUREMENT mcb_pmsm_foc_I2C_f28379d_DW.Unwrap_FirstStep "" UBYTE mcb_pmsm_foc_I2C_f28379d_CM_logical 0 0 0 1 ECU_ADDRESS 0x0001E624 /end MEASUREMENT
/begin MEASUREMENT mcb_pmsm_foc_I2C_f28379d_DW.Unwrap_Prev "" FLOAT32_IEEE mcb_pmsm_foc_I2C_f28379d_CM_single 0 0 -3.4E+38 3.4E+38 ECU_ADDRESS 0x0001E590 /end MEASUREMENT
/begin MEASUREMENT mcb_pmsm_foc_I2C_f28379d_DW.doneDoubleBufferReInit "" UBYTE mcb_pmsm_foc_I2C_f28379d_CM_logical 0 0 0 1 ECU_ADDRESS 0x0001E626
 /begin IF_DATA XCP
  /begin DAQ_EVENT VARIABLE /begin DEFAULT_EVENT_LIST EVENT 0x0001 /end DEFAULT_EVENT_LIST /end DAQ_EVENT
 /end IF_DATA
/end MEASUREMENT
/begin MEASUREMENT mcb_pmsm_foc_I2C_f28379d_DW.is_active_c1_mcb_pmsm_foc_I2C_f "" UBYTE mcb_pmsm_foc_I2C_f28379d_CM_uint8 0 0 0 255 ECU_ADDRESS 0x0001E61E
 /begin IF_DATA XCP
  /begin DAQ_EVENT VARIABLE /begin DEFAULT_EVENT_LIST EVENT 0x0001 /end DEFAULT_EVENT_LIST /end DAQ_EVENT
 /end IF_DATA
/end MEASUREMENT
/begin MEASUREMENT mcb_pmsm_foc_I2C_f28379d_DW.limitRef2_SubsysRanBC "" SBYTE mcb_pmsm_foc_I2C_f28379d_CM_int8 0 0 -128 127 ECU_ADDRESS 0x0001E614 /end MEASUREMENT
/begin MEASUREMENT mcb_pmsm_foc_I2C_f28379d_DW.passThrough_SubsysRanBC "" SBYTE mcb_pmsm_foc_I2C_f28379d_CM_int8 0 0 -128 127 ECU_ADDRESS 0x0001E616 /end MEASUREMENT
/begin MEASUREMENT mcb_pmsm_foc_I2C_f28379d_DW.sfEvent "" SLONG mcb_pmsm_foc_I2C_f28379d_CM_int32 0 0 -2147483648 2147483647 ECU_ADDRESS 0x0001E5B4
 /begin IF_DATA XCP
  /begin DAQ_EVENT VARIABLE /begin DEFAULT_EVENT_LIST EVENT 0x0001 /end DEFAULT_EVENT_LIST /end DAQ_EVENT
 /end IF_DATA
/end MEASUREMENT
/begin FUNCTION mcb_pmsm_IfActionSubsystem1 ""
 /begin IN_MEASUREMENT mcb_pmsm_foc_I2C_f28379d_B.Add_c mcb_pmsm_foc_I2C_f28379d_B.Merge_a /end IN_MEASUREMENT
/end FUNCTION
/begin FUNCTION mcb_pmsm__IfActionSubsystem ""
 /begin IN_MEASUREMENT mcb_pmsm_foc_I2C_f28379d_B.Add_c mcb_pmsm_foc_I2C_f28379d_B.Merge_a /end IN_MEASUREMENT
/end FUNCTION
/begin FUNCTION mcb_pmsm_foc_I_SpeedControl ""
 /begin IN_MEASUREMENT mcb_pmsm_foc_I2C_f28379d_B.RT3 mcb_pmsm_foc_I2C_f28379d_B.RT1 mcb_pmsm_foc_I2C_f28379d_DW.Enable mcb_pmsm_foc_I2C_f28379d_DW.PosRef /end IN_MEASUREMENT
/end FUNCTION
/begin COMPU_METHOD mcb_pmsm_foc_I2C_f28379d_CM_int16 "Q = V" RAT_FUNC "%5.0" "" COEFFS 0 1 0 0 0 1 /end COMPU_METHOD
/begin COMPU_METHOD mcb_pmsm_foc_I2C_f28379d_CM_int32 "Q = V" RAT_FUNC "%10.0" "" COEFFS 0 1 0 0 0 1 /end COMPU_METHOD
/begin COMPU_METHOD mcb_pmsm_foc_I2C_f28379d_CM_int8 "Q = V" RAT_FUNC "%3.0" "" COEFFS 0 1 0 0 0 1 /end COMPU_METHOD
/begin COMPU_METHOD mcb_pmsm_foc_I2C_f28379d_CM_logical "Q = V" RAT_FUNC "%1.0" "" COEFFS 0 1 0 0 0 1 /end COMPU_METHOD
/begin COMPU_METHOD mcb_pmsm_foc_I2C_f28379d_CM_single "Q = V" RAT_FUNC "%8.6" "" COEFFS 0 1 0 0 0 1 /end COMPU_METHOD
/begin COMPU_METHOD mcb_pmsm_foc_I2C_f28379d_CM_uint16 "Q = V" RAT_FUNC "%5.0" "" COEFFS 0 1 0 0 0 1 /end COMPU_METHOD
/begin COMPU_METHOD mcb_pmsm_foc_I2C_f28379d_CM_uint32 "Q = V" RAT_FUNC "%10.0" "" COEFFS 0 1 0 0 0 1 /end COMPU_METHOD
/begin COMPU_METHOD mcb_pmsm_foc_I2C_f28379d_CM_uint8 "Q = V" RAT_FUNC "%3.0" "" COEFFS 0 1 0 0 0 1 /end COMPU_METHOD
/begin RECORD_LAYOUT Record_BOOLEAN FNC_VALUES 1 UBYTE COLUMN_DIR DIRECT /end RECORD_LAYOUT
/begin RECORD_LAYOUT Record_FLOAT32_IEEE FNC_VALUES 1 FLOAT32_IEEE COLUMN_DIR DIRECT /end RECORD_LAYOUT
/begin RECORD_LAYOUT Record_SBYTE FNC_VALUES 1 SBYTE COLUMN_DIR DIRECT /end RECORD_LAYOUT
/begin RECORD_LAYOUT Record_SLONG FNC_VALUES 1 SLONG COLUMN_DIR DIRECT /end RECORD_LAYOUT
/begin RECORD_LAYOUT Record_SWORD FNC_VALUES 1 SWORD COLUMN_DIR DIRECT /end RECORD_LAYOUT
/begin RECORD_LAYOUT Record_UBYTE FNC_VALUES 1 UBYTE COLUMN_DIR DIRECT /end RECORD_LAYOUT
/begin RECORD_LAYOUT Record_ULONG FNC_VALUES 1 ULONG COLUMN_DIR DIRECT /end RECORD_LAYOUT
/begin RECORD_LAYOUT Record_UWORD FNC_VALUES 1 UWORD COLUMN_DIR DIRECT /end RECORD_LAYOUT
/begin GROUP mcb_pmsm_foc_I2C_f28379d "mcb_pmsm_foc_I2C_f28379d" /* Root */ ROOT
 /begin SUB_GROUP mcb_pmsm_foc_I2C_f28379d_AS5600_Read mcb_pmsm_foc_I2C_f28379d_Current_Control mcb_pmsm_foc_I2C_f28379d_Hardware_Init mcb_pmsm_foc_I2C_f28379d_Heartbeat_LED mcb_pmsm_foc_I2C_f28379d_Serial_Receive mcb_pmsm_foc_I2C_f28379d_Speed_Control /end SUB_GROUP
 /begin REF_MEASUREMENT mcb_pmsm_foc_I2C_f28379d_B.Add1 mcb_pmsm_foc_I2C_f28379d_B.Gain mcb_pmsm_foc_I2C_f28379d_B.RT1 mcb_pmsm_foc_I2C_f28379d_B.RT2 mcb_pmsm_foc_I2C_f28379d_B.RT3 mcb_pmsm_foc_I2C_f28379d_B.RT4 mcb_pmsm_foc_I2C_f28379d_B.RT7 mcb_pmsm_foc_I2C_f28379d_B.SCIReceive mcb_pmsm_foc_I2C_f28379d_DW.Control_Mode mcb_pmsm_foc_I2C_f28379d_DW.Debug_signals mcb_pmsm_foc_I2C_f28379d_DW.Enable mcb_pmsm_foc_I2C_f28379d_DW.Enable_I2C mcb_pmsm_foc_I2C_f28379d_DW.IaOffset mcb_pmsm_foc_I2C_f28379d_DW.IbOffset mcb_pmsm_foc_I2C_f28379d_DW.PosRef mcb_pmsm_foc_I2C_f28379d_DW.RT1_ActiveBufIdx mcb_pmsm_foc_I2C_f28379d_DW.RT1_Buffer mcb_pmsm_foc_I2C_f28379d_DW.RT1_semaphoreTaken mcb_pmsm_foc_I2C_f28379d_DW.RT2_ActiveBufIdx mcb_pmsm_foc_I2C_f28379d_DW.RT2_Buffer mcb_pmsm_foc_I2C_f28379d_DW.RT3_ActiveBufIdx mcb_pmsm_foc_I2C_f28379d_DW.RT3_Buffer mcb_pmsm_foc_I2C_f28379d_DW.RT4_ActiveBufIdx mcb_pmsm_foc_I2C_f28379d_DW.RT4_Buffer mcb_pmsm_foc_I2C_f28379d_DW.SpeedRef /end REF_MEASUREMENT
/end GROUP
/begin GROUP mcb_pmsm_foc_I2C_f28379d_AS5600_Read "mcb_pmsm_foc_I2C_f28379d/AS5600 Read"
 /begin SUB_GROUP mcb_pmsm_foc_I2C_f28379d_AS5600_Read_Data_Read mcb_pmsm_foc_I2C_f28379d_AS5600_Read_Data_Realignment_ mcb_pmsm_foc_I2C_f28379d_AS5600_Read_Initialization /end SUB_GROUP
 /begin REF_MEASUREMENT mcb_pmsm_foc_I2C_f28379d_B.DataStoreRead_g mcb_pmsm_foc_I2C_f28379d_B.LogicalOperator2 mcb_pmsm_foc_I2C_f28379d_B.RT4_h mcb_pmsm_foc_I2C_f28379d_B.UnitDelay_l mcb_pmsm_foc_I2C_f28379d_DW.Enable_I2C mcb_pmsm_foc_I2C_f28379d_DW.UnitDelay_DSTATE_f /end REF_MEASUREMENT
/end GROUP
/begin GROUP mcb_pmsm_foc_I2C_f28379d_AS5600_Read_Data_Read "mcb_pmsm_foc_I2C_f28379d/AS5600 Read/Data Read"
 /begin REF_MEASUREMENT mcb_pmsm_foc_I2C_f28379d_B.I2CReceive_o1 mcb_pmsm_foc_I2C_f28379d_B.I2CReceive_o2 mcb_pmsm_foc_I2C_f28379d_B.I2CTransmit /end REF_MEASUREMENT
/end GROUP
/begin GROUP mcb_pmsm_foc_I2C_f28379d_AS5600_Read_Data_Realignment_ "mcb_pmsm_foc_I2C_f28379d/AS5600 Read/Data Realignment "
 /begin REF_MEASUREMENT mcb_pmsm_foc_I2C_f28379d_B.CastToSingle mcb_pmsm_foc_I2C_f28379d_B.Gain mcb_pmsm_foc_I2C_f28379d_B.I2CReceive_o1 mcb_pmsm_foc_I2C_f28379d_B.raw_angle mcb_pmsm_foc_I2C_f28379d_DW.doneDoubleBufferReInit mcb_pmsm_foc_I2C_f28379d_DW.is_active_c1_mcb_pmsm_foc_I2C_f mcb_pmsm_foc_I2C_f28379d_DW.sfEvent /end REF_MEASUREMENT
/end GROUP
/begin GROUP mcb_pmsm_foc_I2C_f28379d_AS5600_Read_Initialization "mcb_pmsm_foc_I2C_f28379d/AS5600 Read/Initialization"
 /begin SUB_GROUP mcb_pmsm_foc_I2C_f28379d_AS5600_Read_Initialization_Address___Data_read /end SUB_GROUP
/end GROUP
/begin GROUP mcb_pmsm_foc_I2C_f28379d_AS5600_Read_Initialization_Address___Data_read "mcb_pmsm_foc_I2C_f28379d/AS5600 Read/Initialization/Address - Data read" /begin REF_MEASUREMENT mcb_pmsm_foc_I2C_f28379d_B.I2CTransmit1 /end REF_MEASUREMENT /end GROUP
/begin GROUP mcb_pmsm_foc_I2C_f28379d_Current_Control "mcb_pmsm_foc_I2C_f28379d/Current Control"
 /begin SUB_GROUP mcb_pmsm_foc_I2C_f28379d_Current_Control_Control_System mcb_pmsm_foc_I2C_f28379d_Current_Control_Debug_signals mcb_pmsm_foc_I2C_f28379d_Current_Control_HW_Inputs mcb_pmsm_foc_I2C_f28379d_Current_Control_Input_Scaling mcb_pmsm_foc_I2C_f28379d_Current_Control_Inverter mcb_pmsm_foc_I2C_f28379d_Current_Control_Output_Scaling mcb_pmsm_foc_I2C_f28379d_Current_Control_SCI_Tx /end SUB_GROUP
 /begin REF_MEASUREMENT mcb_pmsm_foc_I2C_f28379d_B.Add1 mcb_pmsm_foc_I2C_f28379d_B.DataStoreRead1 mcb_pmsm_foc_I2C_f28379d_B.DataStoreRead2 mcb_pmsm_foc_I2C_f28379d_DW.PosRef mcb_pmsm_foc_I2C_f28379d_DW.SpeedRef /end REF_MEASUREMENT
/end GROUP
/begin GROUP mcb_pmsm_foc_I2C_f28379d_Current_Control_Control_System "mcb_pmsm_foc_I2C_f28379d/Current Control/Control_System"
 /begin SUB_GROUP mcb_pmsm_foc_I2C_f28379d_Current_Control_Control_System_Clarke_Transform mcb_pmsm_foc_I2C_f28379d_Current_Control_Control_System_Current_Controllers mcb_pmsm_foc_I2C_f28379d_Current_Control_Control_System_Inverse_Park_Transform mcb_pmsm_foc_I2C_f28379d_Current_Control_Control_System_Park_Transform mcb_pmsm_foc_I2C_f28379d_Current_Control_Control_System_Space_Vector_Generator /end SUB_GROUP
/end GROUP
/begin GROUP mcb_pmsm_foc_I2C_f28379d_Current_Control_Control_System_Clarke_Transform "mcb_pmsm_foc_I2C_f28379d/Current Control/Control_System/Clarke Transform"
 /begin SUB_GROUP mcb_pmsm_foc_I2C_f28379d_Current_Control_Control_System_Clarke_Transform_Two_phase_input /end SUB_GROUP
/end GROUP
/begin GROUP mcb_pmsm_foc_I2C_f28379d_Current_Control_Control_System_Clarke_Transform_Two_phase_input "mcb_pmsm_foc_I2C_f28379d/Current Control/Control_System/Clarke Transform/Two phase input"
 /begin SUB_GROUP mcb_pmsm_foc_I2C_f28379d_Current_Control_Control_System_Clarke_Transform_Two_phase_input_Two_phase_CRL_wrap /end SUB_GROUP
/end GROUP
/begin GROUP mcb_pmsm_foc_I2C_f28379d_Current_Control_Control_System_Clarke_Transform_Two_phase_input_Two_phase_CRL_wrap "mcb_pmsm_foc_I2C_f28379d/Current Control/Control_System/Clarke Transform/Two phase input/Two phase CRL wrap"
 /begin REF_MEASUREMENT mcb_pmsm_foc_I2C_f28379d_B.InvertingNoninvertingCurrentmea mcb_pmsm_foc_I2C_f28379d_B.a_plus_2b mcb_pmsm_foc_I2C_f28379d_B.one_by_sqrt3 /end REF_MEASUREMENT
/end GROUP
/begin GROUP mcb_pmsm_foc_I2C_f28379d_Current_Control_Control_System_Current_Controllers "mcb_pmsm_foc_I2C_f28379d/Current Control/Control_System/Current_Controllers"
 /begin SUB_GROUP mcb_pmsm_foc_I2C_f28379d_Current_Control_Control_System_Current_Controllers_DQ_Limiter mcb_pmsm_foc_I2C_f28379d_Current_Control_Control_System_Current_Controllers_PI_Controller_Id mcb_pmsm_foc_I2C_f28379d_Current_Control_Control_System_Current_Controllers_PI_Controller_Iq /end SUB_GROUP
/end GROUP
/begin GROUP mcb_pmsm_foc_I2C_f28379d_Current_Control_Control_System_Current_Controllers_DQ_Limiter "mcb_pmsm_foc_I2C_f28379d/Current Control/Control_System/Current_Controllers/DQ Limiter"
 /begin SUB_GROUP mcb_pmsm_foc_I2C_f28379d_Current_Control_Control_System_Current_Controllers_DQ_Limiter_D_Q_Equivalence mcb_pmsm_foc_I2C_f28379d_Current_Control_Control_System_Current_Controllers_DQ_Limiter_D__Q_Axis_Priority mcb_pmsm_foc_I2C_f28379d_Current_Control_Control_System_Current_Controllers_DQ_Limiter_Inport__Dialog_Selection mcb_pmsm_foc_I2C_f28379d_Current_Control_Control_System_Current_Controllers_DQ_Limiter_Magnitude_calc /end SUB_GROUP
 /begin REF_MEASUREMENT mcb_pmsm_foc_I2C_f28379d_B.Merge_i mcb_pmsm_foc_I2C_f28379d_B.Switch1_j /end REF_MEASUREMENT
/end GROUP
/begin GROUP mcb_pmsm_foc_I2C_f28379d_Current_Control_Control_System_Current_Controllers_DQ_Limiter_D_Q_Equivalence "mcb_pmsm_foc_I2C_f28379d/Current Control/Control_System/Current_Controllers/DQ Limiter/D-Q Equivalence"
 /begin SUB_GROUP mcb_pmsm_foc_I2C_f28379d_Current_Control_Control_System_Current_Controllers_DQ_Limiter_D_Q_Equivalence_Limiter mcb_pmsm_foc_I2C_f28379d_Current_Control_Control_System_Current_Controllers_DQ_Limiter_D_Q_Equivalence_Passthrough /end SUB_GROUP
 /begin REF_MEASUREMENT mcb_pmsm_foc_I2C_f28379d_B.DataTypeConversion_f mcb_pmsm_foc_I2C_f28379d_B.Merge_i mcb_pmsm_foc_I2C_f28379d_B.Product_j mcb_pmsm_foc_I2C_f28379d_B.RelationalOperator_k mcb_pmsm_foc_I2C_f28379d_B.Sum1 /end REF_MEASUREMENT
/end GROUP
/begin GROUP mcb_pmsm_foc_I2C_f28379d_Current_Control_Control_System_Current_Controllers_DQ_Limiter_D_Q_Equivalence_Limiter "mcb_pmsm_foc_I2C_f28379d/Current Control/Control_System/Current_Controllers/DQ Limiter/D-Q Equivalence/Limiter"
 /begin REF_MEASUREMENT mcb_pmsm_foc_I2C_f28379d_B.Merge_i mcb_pmsm_foc_I2C_f28379d_B.Product_o mcb_pmsm_foc_I2C_f28379d_B.Reciprocal mcb_pmsm_foc_I2C_f28379d_B.SquareRoot mcb_pmsm_foc_I2C_f28379d_B.Sum1 mcb_pmsm_foc_I2C_f28379d_B.Switch_as mcb_pmsm_foc_I2C_f28379d_B.Switch_n /end REF_MEASUREMENT
/end GROUP
/begin GROUP mcb_pmsm_foc_I2C_f28379d_Current_Control_Control_System_Current_Controllers_DQ_Limiter_D_Q_Equivalence_Passthrough "mcb_pmsm_foc_I2C_f28379d/Current Control/Control_System/Current_Controllers/DQ Limiter/D-Q Equivalence/Passthrough" /begin REF_MEASUREMENT mcb_pmsm_foc_I2C_f28379d_B.Merge_i /end REF_MEASUREMENT /end GROUP
/begin GROUP mcb_pmsm_foc_I2C_f28379d_Current_Control_Control_System_Current_Controllers_DQ_Limiter_D__Q_Axis_Priority "mcb_pmsm_foc_I2C_f28379d/Current Control/Control_System/Current_Controllers/DQ Limiter/D//Q Axis Priority"
 /begin SUB_GROUP mcb_pmsm_foc_I2C_f28379d_Current_Control_Control_System_Current_Controllers_DQ_Limiter_D__Q_Axis_Priority_Compare_To_Constant mcb_pmsm_foc_I2C_f28379d_Current_Control_Control_System_Current_Controllers_DQ_Limiter_D__Q_Axis_Priority_Compare_To_Constant1 mcb_pmsm_foc_I2C_f28379d_Current_Control_Control_System_Current_Controllers_DQ_Limiter_D__Q_Axis_Priority_limiter /end SUB_GROUP
 /begin REF_MEASUREMENT mcb_pmsm_foc_I2C_f28379d_B.Compare_f0 mcb_pmsm_foc_I2C_f28379d_B.Compare_k mcb_pmsm_foc_I2C_f28379d_B.Merge_i mcb_pmsm_foc_I2C_f28379d_B.Switch_j /end REF_MEASUREMENT
/end GROUP
/begin GROUP mcb_pmsm_foc_I2C_f28379d_Current_Control_Control_System_Current_Controllers_DQ_Limiter_D__Q_Axis_Priority_Compare_To_Constant "mcb_pmsm_foc_I2C_f28379d/Current Control/Control_System/Current_Controllers/DQ Limiter/D//Q Axis Priority/Compare\r\nTo Constant"
 /begin REF_MEASUREMENT mcb_pmsm_foc_I2C_f28379d_B.Compare_k mcb_pmsm_foc_I2C_f28379d_B.Switch1_j /end REF_MEASUREMENT
/end GROUP
/begin GROUP mcb_pmsm_foc_I2C_f28379d_Current_Control_Control_System_Current_Controllers_DQ_Limiter_D__Q_Axis_Priority_Compare_To_Constant1 "mcb_pmsm_foc_I2C_f28379d/Current Control/Control_System/Current_Controllers/DQ Limiter/D//Q Axis Priority/Compare\r\nTo Constant1"
 /begin REF_MEASUREMENT mcb_pmsm_foc_I2C_f28379d_B.Compare_f0 mcb_pmsm_foc_I2C_f28379d_B.Switch1_j /end REF_MEASUREMENT
/end GROUP
/begin GROUP mcb_pmsm_foc_I2C_f28379d_Current_Control_Control_System_Current_Controllers_DQ_Limiter_D__Q_Axis_Priority_limiter "mcb_pmsm_foc_I2C_f28379d/Current Control/Control_System/Current_Controllers/DQ Limiter/D//Q Axis Priority/limiter"
 /begin SUB_GROUP mcb_pmsm_foc_I2C_f28379d_Current_Control_Control_System_Current_Controllers_DQ_Limiter_D__Q_Axis_Priority_limiter_limitRef1 mcb_pmsm_foc_I2C_f28379d_Current_Control_Control_System_Current_Controllers_DQ_Limiter_D__Q_Axis_Priority_limiter_limitRef2 mcb_pmsm_foc_I2C_f28379d_Current_Control_Control_System_Current_Controllers_DQ_Limiter_D__Q_Axis_Priority_limiter_passThrough /end SUB_GROUP
 /begin REF_MEASUREMENT mcb_pmsm_foc_I2C_f28379d_B.DataTypeConversion_fl mcb_pmsm_foc_I2C_f28379d_B.Gain_b mcb_pmsm_foc_I2C_f28379d_B.Merge_d mcb_pmsm_foc_I2C_f28379d_B.Product2 mcb_pmsm_foc_I2C_f28379d_B.Product_b mcb_pmsm_foc_I2C_f28379d_B.Product_j mcb_pmsm_foc_I2C_f28379d_B.RelationalOperator_l mcb_pmsm_foc_I2C_f28379d_B.Sum_jr mcb_pmsm_foc_I2C_f28379d_B.Switch2 mcb_pmsm_foc_I2C_f28379d_B.Switch_j mcb_pmsm_foc_I2C_f28379d_B.Switch_n /end REF_MEASUREMENT
/end GROUP
/begin GROUP mcb_pmsm_foc_I2C_f28379d_Current_Control_Control_System_Current_Controllers_DQ_Limiter_D__Q_Axis_Priority_limiter_limitRef1 "mcb_pmsm_foc_I2C_f28379d/Current Control/Control_System/Current_Controllers/DQ Limiter/D//Q Axis Priority/limiter/limitRef1"
 /begin REF_MEASUREMENT mcb_pmsm_foc_I2C_f28379d_B.Gain_b mcb_pmsm_foc_I2C_f28379d_B.LowerRelop1 mcb_pmsm_foc_I2C_f28379d_B.Switch2 mcb_pmsm_foc_I2C_f28379d_B.Switch_j mcb_pmsm_foc_I2C_f28379d_B.Switch_m mcb_pmsm_foc_I2C_f28379d_B.Switch_n mcb_pmsm_foc_I2C_f28379d_B.UpperRelop /end REF_MEASUREMENT
/end GROUP
/begin GROUP mcb_pmsm_foc_I2C_f28379d_Current_Control_Control_System_Current_Controllers_DQ_Limiter_D__Q_Axis_Priority_limiter_limitRef2 "mcb_pmsm_foc_I2C_f28379d/Current Control/Control_System/Current_Controllers/DQ Limiter/D//Q Axis Priority/limiter/limitRef2"
 /begin REF_MEASUREMENT mcb_pmsm_foc_I2C_f28379d_B.Gain_l mcb_pmsm_foc_I2C_f28379d_B.Merge_d mcb_pmsm_foc_I2C_f28379d_B.Sqrt mcb_pmsm_foc_I2C_f28379d_B.Sum_jr mcb_pmsm_foc_I2C_f28379d_B.Switch1 mcb_pmsm_foc_I2C_f28379d_B.Switch_j /end REF_MEASUREMENT
/end GROUP
/begin GROUP mcb_pmsm_foc_I2C_f28379d_Current_Control_Control_System_Current_Controllers_DQ_Limiter_D__Q_Axis_Priority_limiter_passThrough "mcb_pmsm_foc_I2C_f28379d/Current Control/Control_System/Current_Controllers/DQ Limiter/D//Q Axis Priority/limiter/passThrough" /begin REF_MEASUREMENT mcb_pmsm_foc_I2C_f28379d_B.Merge_d /end REF_MEASUREMENT /end GROUP
/begin GROUP mcb_pmsm_foc_I2C_f28379d_Current_Control_Control_System_Current_Controllers_DQ_Limiter_Inport__Dialog_Selection "mcb_pmsm_foc_I2C_f28379d/Current Control/Control_System/Current_Controllers/DQ Limiter/Inport//Dialog Selection"
 /begin REF_MEASUREMENT mcb_pmsm_foc_I2C_f28379d_B.Product_j mcb_pmsm_foc_I2C_f28379d_B.Switch1_j mcb_pmsm_foc_I2C_f28379d_B.Switch_n /end REF_MEASUREMENT
/end GROUP
/begin GROUP mcb_pmsm_foc_I2C_f28379d_Current_Control_Control_System_Current_Controllers_DQ_Limiter_Magnitude_calc "mcb_pmsm_foc_I2C_f28379d/Current Control/Control_System/Current_Controllers/DQ Limiter/Magnitude_calc"
 /begin REF_MEASUREMENT mcb_pmsm_foc_I2C_f28379d_B.Product1_g mcb_pmsm_foc_I2C_f28379d_B.Product_f mcb_pmsm_foc_I2C_f28379d_B.Saturation mcb_pmsm_foc_I2C_f28379d_B.Saturation_f mcb_pmsm_foc_I2C_f28379d_B.Sum1 /end REF_MEASUREMENT
/end GROUP
/begin GROUP mcb_pmsm_foc_I2C_f28379d_Current_Control_Control_System_Current_Controllers_PI_Controller_Id "mcb_pmsm_foc_I2C_f28379d/Current Control/Control_System/Current_Controllers/PI_Controller_Id"
 /begin SUB_GROUP mcb_pmsm_foc_I2C_f28379d_Current_Control_Control_System_Current_Controllers_PI_Controller_Id_Discrete_PI_Controller__with_anti_windup___reset /end SUB_GROUP
 /begin REF_MEASUREMENT mcb_pmsm_foc_I2C_f28379d_B.DataStoreRead1_m mcb_pmsm_foc_I2C_f28379d_B.Ki1 mcb_pmsm_foc_I2C_f28379d_B.LogicalOperator_a mcb_pmsm_foc_I2C_f28379d_B.RT2 mcb_pmsm_foc_I2C_f28379d_B.Sum_j mcb_pmsm_foc_I2C_f28379d_B.algDD_o1 mcb_pmsm_foc_I2C_f28379d_DW.Enable /end REF_MEASUREMENT
/end GROUP
/begin GROUP mcb_pmsm_foc_I2C_f28379d_Current_Control_Control_System_Current_Controllers_PI_Controller_Id_Discrete_PI_Controller__with_anti_windup___reset "mcb_pmsm_foc_I2C_f28379d/Current Control/Control_System/Current_Controllers/PI_Controller_Id/Discrete PI Controller \r\nwith anti-windup & reset"
 /begin SUB_GROUP mcb_pmsm_foc_I2C_f28379d_Current_Control_Control_System_Current_Controllers_PI_Controller_Id_Discrete_PI_Controller__with_anti_windup___reset_Anti_windup mcb_pmsm_foc_I2C_f28379d_Current_Control_Control_System_Current_Controllers_PI_Controller_Id_Discrete_PI_Controller__with_anti_windup___reset_I_Gain mcb_pmsm_foc_I2C_f28379d_Current_Control_Control_System_Current_Controllers_PI_Controller_Id_Discrete_PI_Controller__with_anti_windup___reset_Integrator mcb_pmsm_foc_I2C_f28379d_Current_Control_Control_System_Current_Controllers_PI_Controller_Id_Discrete_PI_Controller__with_anti_windup___reset_Parallel_P_Gain mcb_pmsm_foc_I2C_f28379d_Current_Control_Control_System_Current_Controllers_PI_Controller_Id_Discrete_PI_Controller__with_anti_windup___reset_Saturation mcb_pmsm_foc_I2C_f28379d_Current_Control_Control_System_Current_Controllers_PI_Controller_Id_Discrete_PI_Controller__with_anti_windup___reset_Sum /end SUB_GROUP
/end GROUP
/begin GROUP mcb_pmsm_foc_I2C_f28379d_Current_Control_Control_System_Current_Controllers_PI_Controller_Id_Discrete_PI_Controller__with_anti_windup___reset_Anti_windup "mcb_pmsm_foc_I2C_f28379d/Current Control/Control_System/Current_Controllers/PI_Controller_Id/Discrete PI Controller \r\nwith anti-windup & reset/Anti-windup"
 /begin SUB_GROUP mcb_pmsm_foc_I2C_f28379d_Current_Control_Control_System_Current_Controllers_PI_Controller_Id_Discrete_PI_Controller__with_anti_windup___reset_Anti_windup_Disc__Clamping_Parallel /end SUB_GROUP
/end GROUP
/begin GROUP mcb_pmsm_foc_I2C_f28379d_Current_Control_Control_System_Current_Controllers_PI_Controller_Id_Discrete_PI_Controller__with_anti_windup___reset_Anti_windup_Disc__Clamping_Parallel "mcb_pmsm_foc_I2C_f28379d/Current Control/Control_System/Current_Controllers/PI_Controller_Id/Discrete PI Controller \r\nwith anti-windup & reset/Anti-windup/Disc. Clamping Parallel"
 /begin SUB_GROUP mcb_pmsm_foc_I2C_f28379d_Current_Control_Control_System_Current_Controllers_PI_Controller_Id_Discrete_PI_Controller__with_anti_windup___reset_Anti_windup_Disc__Clamping_Parallel_Dead_Zone /end SUB_GROUP
 /begin REF_MEASUREMENT mcb_pmsm_foc_I2C_f28379d_B.AND3 mcb_pmsm_foc_I2C_f28379d_B.DeadZone mcb_pmsm_foc_I2C_f28379d_B.Equal1 mcb_pmsm_foc_I2C_f28379d_B.IProdOut mcb_pmsm_foc_I2C_f28379d_B.RelationalOperator mcb_pmsm_foc_I2C_f28379d_B.Switch1_h mcb_pmsm_foc_I2C_f28379d_B.Switch2_l mcb_pmsm_foc_I2C_f28379d_B.Switch_f mcb_pmsm_foc_I2C_f28379d_B.fixforDTpropagationissue mcb_pmsm_foc_I2C_f28379d_B.fixforDTpropagationissue1 /end REF_MEASUREMENT
/end GROUP
/begin GROUP mcb_pmsm_foc_I2C_f28379d_Current_Control_Control_System_Current_Controllers_PI_Controller_Id_Discrete_PI_Controller__with_anti_windup___reset_Anti_windup_Disc__Clamping_Parallel_Dead_Zone "mcb_pmsm_foc_I2C_f28379d/Current Control/Control_System/Current_Controllers/PI_Controller_Id/Discrete PI Controller \r\nwith anti-windup & reset/Anti-windup/Disc. Clamping Parallel/Dead Zone"
 /begin SUB_GROUP mcb_pmsm_foc_I2C_f28379d_Current_Control_Control_System_Current_Controllers_PI_Controller_Id_Discrete_PI_Controller__with_anti_windup___reset_Anti_windup_Disc__Clamping_Parallel_Dead_Zone_Enabled /end SUB_GROUP
/end GROUP
/begin GROUP mcb_pmsm_foc_I2C_f28379d_Current_Control_Control_System_Current_Controllers_PI_Controller_Id_Discrete_PI_Controller__with_anti_windup___reset_Anti_windup_Disc__Clamping_Parallel_Dead_Zone_Enabled "mcb_pmsm_foc_I2C_f28379d/Current Control/Control_System/Current_Controllers/PI_Controller_Id/Discrete PI Controller \r\nwith anti-windup & reset/Anti-windup/Disc. Clamping Parallel/Dead Zone/Enabled"
 /begin REF_MEASUREMENT mcb_pmsm_foc_I2C_f28379d_B.DeadZone mcb_pmsm_foc_I2C_f28379d_B.Sum_g /end REF_MEASUREMENT
/end GROUP
/begin GROUP mcb_pmsm_foc_I2C_f28379d_Current_Control_Control_System_Current_Controllers_PI_Controller_Id_Discrete_PI_Controller__with_anti_windup___reset_I_Gain "mcb_pmsm_foc_I2C_f28379d/Current Control/Control_System/Current_Controllers/PI_Controller_Id/Discrete PI Controller \r\nwith anti-windup & reset/I Gain"
 /begin SUB_GROUP mcb_pmsm_foc_I2C_f28379d_Current_Control_Control_System_Current_Controllers_PI_Controller_Id_Discrete_PI_Controller__with_anti_windup___reset_I_Gain_External_Parameters /end SUB_GROUP
/end GROUP
/begin GROUP mcb_pmsm_foc_I2C_f28379d_Current_Control_Control_System_Current_Controllers_PI_Controller_Id_Discrete_PI_Controller__with_anti_windup___reset_I_Gain_External_Parameters "mcb_pmsm_foc_I2C_f28379d/Current Control/Control_System/Current_Controllers/PI_Controller_Id/Discrete PI Controller \r\nwith anti-windup & reset/I Gain/External Parameters"
 /begin REF_MEASUREMENT mcb_pmsm_foc_I2C_f28379d_B.IProdOut mcb_pmsm_foc_I2C_f28379d_B.Sum_j /end REF_MEASUREMENT
/end GROUP
/begin GROUP mcb_pmsm_foc_I2C_f28379d_Current_Control_Control_System_Current_Controllers_PI_Controller_Id_Discrete_PI_Controller__with_anti_windup___reset_Integrator "mcb_pmsm_foc_I2C_f28379d/Current Control/Control_System/Current_Controllers/PI_Controller_Id/Discrete PI Controller \r\nwith anti-windup & reset/Integrator"
 /begin SUB_GROUP mcb_pmsm_foc_I2C_f28379d_Current_Control_Control_System_Current_Controllers_PI_Controller_Id_Discrete_PI_Controller__with_anti_windup___reset_Integrator_Discrete /end SUB_GROUP
/end GROUP
/begin GROUP mcb_pmsm_foc_I2C_f28379d_Current_Control_Control_System_Current_Controllers_PI_Controller_Id_Discrete_PI_Controller__with_anti_windup___reset_Integrator_Discrete "mcb_pmsm_foc_I2C_f28379d/Current Control/Control_System/Current_Controllers/PI_Controller_Id/Discrete PI Controller \r\nwith anti-windup & reset/Integrator/Discrete"
 /begin REF_MEASUREMENT mcb_pmsm_foc_I2C_f28379d_B.Integrator_f mcb_pmsm_foc_I2C_f28379d_B.Ki1 mcb_pmsm_foc_I2C_f28379d_B.LogicalOperator_a mcb_pmsm_foc_I2C_f28379d_B.Switch_f mcb_pmsm_foc_I2C_f28379d_DW.Integrator_DSTATE_o mcb_pmsm_foc_I2C_f28379d_DW.Integrator_PrevResetState_k /end REF_MEASUREMENT
/end GROUP
/begin GROUP mcb_pmsm_foc_I2C_f28379d_Current_Control_Control_System_Current_Controllers_PI_Controller_Id_Discrete_PI_Controller__with_anti_windup___reset_Parallel_P_Gain "mcb_pmsm_foc_I2C_f28379d/Current Control/Control_System/Current_Controllers/PI_Controller_Id/Discrete PI Controller \r\nwith anti-windup & reset/Parallel P Gain"
 /begin SUB_GROUP mcb_pmsm_foc_I2C_f28379d_Current_Control_Control_System_Current_Controllers_PI_Controller_Id_Discrete_PI_Controller__with_anti_windup___reset_Parallel_P_Gain_External_Parameters /end SUB_GROUP
/end GROUP
/begin GROUP mcb_pmsm_foc_I2C_f28379d_Current_Control_Control_System_Current_Controllers_PI_Controller_Id_Discrete_PI_Controller__with_anti_windup___reset_Parallel_P_Gain_External_Parameters "mcb_pmsm_foc_I2C_f28379d/Current Control/Control_System/Current_Controllers/PI_Controller_Id/Discrete PI Controller \r\nwith anti-windup & reset/Parallel P Gain/External Parameters"
 /begin REF_MEASUREMENT mcb_pmsm_foc_I2C_f28379d_B.PProdOut_g mcb_pmsm_foc_I2C_f28379d_B.Sum_j /end REF_MEASUREMENT
/end GROUP
/begin GROUP mcb_pmsm_foc_I2C_f28379d_Current_Control_Control_System_Current_Controllers_PI_Controller_Id_Discrete_PI_Controller__with_anti_windup___reset_Saturation "mcb_pmsm_foc_I2C_f28379d/Current Control/Control_System/Current_Controllers/PI_Controller_Id/Discrete PI Controller \r\nwith anti-windup & reset/Saturation"
 /begin SUB_GROUP mcb_pmsm_foc_I2C_f28379d_Current_Control_Control_System_Current_Controllers_PI_Controller_Id_Discrete_PI_Controller__with_anti_windup___reset_Saturation_Enabled /end SUB_GROUP
/end GROUP
/begin GROUP mcb_pmsm_foc_I2C_f28379d_Current_Control_Control_System_Current_Controllers_PI_Controller_Id_Discrete_PI_Controller__with_anti_windup___reset_Saturation_Enabled "mcb_pmsm_foc_I2C_f28379d/Current Control/Control_System/Current_Controllers/PI_Controller_Id/Discrete PI Controller \r\nwith anti-windup & reset/Saturation/Enabled"
 /begin REF_MEASUREMENT mcb_pmsm_foc_I2C_f28379d_B.Saturation_f mcb_pmsm_foc_I2C_f28379d_B.Sum_g /end REF_MEASUREMENT
/end GROUP
/begin GROUP mcb_pmsm_foc_I2C_f28379d_Current_Control_Control_System_Current_Controllers_PI_Controller_Id_Discrete_PI_Controller__with_anti_windup___reset_Sum "mcb_pmsm_foc_I2C_f28379d/Current Control/Control_System/Current_Controllers/PI_Controller_Id/Discrete PI Controller \r\nwith anti-windup & reset/Sum"
 /begin SUB_GROUP mcb_pmsm_foc_I2C_f28379d_Current_Control_Control_System_Current_Controllers_PI_Controller_Id_Discrete_PI_Controller__with_anti_windup___reset_Sum_Sum_PI /end SUB_GROUP
/end GROUP
/begin GROUP mcb_pmsm_foc_I2C_f28379d_Current_Control_Control_System_Current_Controllers_PI_Controller_Id_Discrete_PI_Controller__with_anti_windup___reset_Sum_Sum_PI "mcb_pmsm_foc_I2C_f28379d/Current Control/Control_System/Current_Controllers/PI_Controller_Id/Discrete PI Controller \r\nwith anti-windup & reset/Sum/Sum_PI"
 /begin REF_MEASUREMENT mcb_pmsm_foc_I2C_f28379d_B.Integrator_f mcb_pmsm_foc_I2C_f28379d_B.PProdOut_g mcb_pmsm_foc_I2C_f28379d_B.Sum_g /end REF_MEASUREMENT
/end GROUP
/begin GROUP mcb_pmsm_foc_I2C_f28379d_Current_Control_Control_System_Current_Controllers_PI_Controller_Iq "mcb_pmsm_foc_I2C_f28379d/Current Control/Control_System/Current_Controllers/PI_Controller_Iq"
 /begin SUB_GROUP mcb_pmsm_foc_I2C_f28379d_Current_Control_Control_System_Current_Controllers_PI_Controller_Iq_Discrete_PI_Controller__with_anti_windup___reset /end SUB_GROUP
 /begin REF_MEASUREMENT mcb_pmsm_foc_I2C_f28379d_B.DataStoreRead1_b mcb_pmsm_foc_I2C_f28379d_B.Kp1 mcb_pmsm_foc_I2C_f28379d_B.LogicalOperator mcb_pmsm_foc_I2C_f28379d_B.RT2 mcb_pmsm_foc_I2C_f28379d_B.Sum_o mcb_pmsm_foc_I2C_f28379d_B.algDD_o2 mcb_pmsm_foc_I2C_f28379d_DW.Enable /end REF_MEASUREMENT
/end GROUP
/begin GROUP mcb_pmsm_foc_I2C_f28379d_Current_Control_Control_System_Current_Controllers_PI_Controller_Iq_Discrete_PI_Controller__with_anti_windup___reset "mcb_pmsm_foc_I2C_f28379d/Current Control/Control_System/Current_Controllers/PI_Controller_Iq/Discrete PI Controller \r\nwith anti-windup & reset"
 /begin SUB_GROUP mcb_pmsm_foc_I2C_f28379d_Current_Control_Control_System_Current_Controllers_PI_Controller_Iq_Discrete_PI_Controller__with_anti_windup___reset_Anti_windup mcb_pmsm_foc_I2C_f28379d_Current_Control_Control_System_Current_Controllers_PI_Controller_Iq_Discrete_PI_Controller__with_anti_windup___reset_I_Gain mcb_pmsm_foc_I2C_f28379d_Current_Control_Control_System_Current_Controllers_PI_Controller_Iq_Discrete_PI_Controller__with_anti_windup___reset_Integrator mcb_pmsm_foc_I2C_f28379d_Current_Control_Control_System_Current_Controllers_PI_Controller_Iq_Discrete_PI_Controller__with_anti_windup___reset_Parallel_P_Gain mcb_pmsm_foc_I2C_f28379d_Current_Control_Control_System_Current_Controllers_PI_Controller_Iq_Discrete_PI_Controller__with_anti_windup___reset_Saturation mcb_pmsm_foc_I2C_f28379d_Current_Control_Control_System_Current_Controllers_PI_Controller_Iq_Discrete_PI_Controller__with_anti_windup___reset_Sum /end SUB_GROUP
/end GROUP
/begin GROUP mcb_pmsm_foc_I2C_f28379d_Current_Control_Control_System_Current_Controllers_PI_Controller_Iq_Discrete_PI_Controller__with_anti_windup___reset_Anti_windup "mcb_pmsm_foc_I2C_f28379d/Current Control/Control_System/Current_Controllers/PI_Controller_Iq/Discrete PI Controller \r\nwith anti-windup & reset/Anti-windup"
 /begin SUB_GROUP mcb_pmsm_foc_I2C_f28379d_Current_Control_Control_System_Current_Controllers_PI_Controller_Iq_Discrete_PI_Controller__with_anti_windup___reset_Anti_windup_Disc__Clamping_Parallel /end SUB_GROUP
/end GROUP
/begin GROUP mcb_pmsm_foc_I2C_f28379d_Current_Control_Control_System_Current_Controllers_PI_Controller_Iq_Discrete_PI_Controller__with_anti_windup___reset_Anti_windup_Disc__Clamping_Parallel "mcb_pmsm_foc_I2C_f28379d/Current Control/Control_System/Current_Controllers/PI_Controller_Iq/Discrete PI Controller \r\nwith anti-windup & reset/Anti-windup/Disc. Clamping Parallel"
 /begin SUB_GROUP mcb_pmsm_foc_I2C_f28379d_Current_Control_Control_System_Current_Controllers_PI_Controller_Iq_Discrete_PI_Controller__with_anti_windup___reset_Anti_windup_Disc__Clamping_Parallel_Dead_Zone /end SUB_GROUP
 /begin REF_MEASUREMENT mcb_pmsm_foc_I2C_f28379d_B.AND3_n mcb_pmsm_foc_I2C_f28379d_B.DeadZone_a mcb_pmsm_foc_I2C_f28379d_B.Equal1_i mcb_pmsm_foc_I2C_f28379d_B.IProdOut_b mcb_pmsm_foc_I2C_f28379d_B.RelationalOperator_e mcb_pmsm_foc_I2C_f28379d_B.Switch1_l mcb_pmsm_foc_I2C_f28379d_B.Switch2_c mcb_pmsm_foc_I2C_f28379d_B.Switch_a mcb_pmsm_foc_I2C_f28379d_B.fixforDTpropagationissue1_o mcb_pmsm_foc_I2C_f28379d_B.fixforDTpropagationissue_j /end REF_MEASUREMENT
/end GROUP
/begin GROUP mcb_pmsm_foc_I2C_f28379d_Current_Control_Control_System_Current_Controllers_PI_Controller_Iq_Discrete_PI_Controller__with_anti_windup___reset_Anti_windup_Disc__Clamping_Parallel_Dead_Zone "mcb_pmsm_foc_I2C_f28379d/Current Control/Control_System/Current_Controllers/PI_Controller_Iq/Discrete PI Controller \r\nwith anti-windup & reset/Anti-windup/Disc. Clamping Parallel/Dead Zone"
 /begin SUB_GROUP mcb_pmsm_foc_I2C_f28379d_Current_Control_Control_System_Current_Controllers_PI_Controller_Iq_Discrete_PI_Controller__with_anti_windup___reset_Anti_windup_Disc__Clamping_Parallel_Dead_Zone_Enabled /end SUB_GROUP
/end GROUP
/begin GROUP mcb_pmsm_foc_I2C_f28379d_Current_Control_Control_System_Current_Controllers_PI_Controller_Iq_Discrete_PI_Controller__with_anti_windup___reset_Anti_windup_Disc__Clamping_Parallel_Dead_Zone_Enabled "mcb_pmsm_foc_I2C_f28379d/Current Control/Control_System/Current_Controllers/PI_Controller_Iq/Discrete PI Controller \r\nwith anti-windup & reset/Anti-windup/Disc. Clamping Parallel/Dead Zone/Enabled"
 /begin REF_MEASUREMENT mcb_pmsm_foc_I2C_f28379d_B.DeadZone_a mcb_pmsm_foc_I2C_f28379d_B.Sum_m /end REF_MEASUREMENT
/end GROUP
/begin GROUP mcb_pmsm_foc_I2C_f28379d_Current_Control_Control_System_Current_Controllers_PI_Controller_Iq_Discrete_PI_Controller__with_anti_windup___reset_I_Gain "mcb_pmsm_foc_I2C_f28379d/Current Control/Control_System/Current_Controllers/PI_Controller_Iq/Discrete PI Controller \r\nwith anti-windup & reset/I Gain"
 /begin SUB_GROUP mcb_pmsm_foc_I2C_f28379d_Current_Control_Control_System_Current_Controllers_PI_Controller_Iq_Discrete_PI_Controller__with_anti_windup___reset_I_Gain_External_Parameters /end SUB_GROUP
/end GROUP
/begin GROUP mcb_pmsm_foc_I2C_f28379d_Current_Control_Control_System_Current_Controllers_PI_Controller_Iq_Discrete_PI_Controller__with_anti_windup___reset_I_Gain_External_Parameters "mcb_pmsm_foc_I2C_f28379d/Current Control/Control_System/Current_Controllers/PI_Controller_Iq/Discrete PI Controller \r\nwith anti-windup & reset/I Gain/External Parameters"
 /begin REF_MEASUREMENT mcb_pmsm_foc_I2C_f28379d_B.IProdOut_b mcb_pmsm_foc_I2C_f28379d_B.Sum_o /end REF_MEASUREMENT
/end GROUP
/begin GROUP mcb_pmsm_foc_I2C_f28379d_Current_Control_Control_System_Current_Controllers_PI_Controller_Iq_Discrete_PI_Controller__with_anti_windup___reset_Integrator "mcb_pmsm_foc_I2C_f28379d/Current Control/Control_System/Current_Controllers/PI_Controller_Iq/Discrete PI Controller \r\nwith anti-windup & reset/Integrator"
 /begin SUB_GROUP mcb_pmsm_foc_I2C_f28379d_Current_Control_Control_System_Current_Controllers_PI_Controller_Iq_Discrete_PI_Controller__with_anti_windup___reset_Integrator_Discrete /end SUB_GROUP
/end GROUP
/begin GROUP mcb_pmsm_foc_I2C_f28379d_Current_Control_Control_System_Current_Controllers_PI_Controller_Iq_Discrete_PI_Controller__with_anti_windup___reset_Integrator_Discrete "mcb_pmsm_foc_I2C_f28379d/Current Control/Control_System/Current_Controllers/PI_Controller_Iq/Discrete PI Controller \r\nwith anti-windup & reset/Integrator/Discrete"
 /begin REF_MEASUREMENT mcb_pmsm_foc_I2C_f28379d_B.Integrator mcb_pmsm_foc_I2C_f28379d_B.Kp1 mcb_pmsm_foc_I2C_f28379d_B.LogicalOperator mcb_pmsm_foc_I2C_f28379d_B.Switch_a mcb_pmsm_foc_I2C_f28379d_DW.Integrator_DSTATE mcb_pmsm_foc_I2C_f28379d_DW.Integrator_PrevResetState /end REF_MEASUREMENT
/end GROUP
/begin GROUP mcb_pmsm_foc_I2C_f28379d_Current_Control_Control_System_Current_Controllers_PI_Controller_Iq_Discrete_PI_Controller__with_anti_windup___reset_Parallel_P_Gain "mcb_pmsm_foc_I2C_f28379d/Current Control/Control_System/Current_Controllers/PI_Controller_Iq/Discrete PI Controller \r\nwith anti-windup & reset/Parallel P Gain"
 /begin SUB_GROUP mcb_pmsm_foc_I2C_f28379d_Current_Control_Control_System_Current_Controllers_PI_Controller_Iq_Discrete_PI_Controller__with_anti_windup___reset_Parallel_P_Gain_External_Parameters /end SUB_GROUP
/end GROUP
/begin GROUP mcb_pmsm_foc_I2C_f28379d_Current_Control_Control_System_Current_Controllers_PI_Controller_Iq_Discrete_PI_Controller__with_anti_windup___reset_Parallel_P_Gain_External_Parameters "mcb_pmsm_foc_I2C_f28379d/Current Control/Control_System/Current_Controllers/PI_Controller_Iq/Discrete PI Controller \r\nwith anti-windup & reset/Parallel P Gain/External Parameters"
 /begin REF_MEASUREMENT mcb_pmsm_foc_I2C_f28379d_B.PProdOut mcb_pmsm_foc_I2C_f28379d_B.Sum_o /end REF_MEASUREMENT
/end GROUP
/begin GROUP mcb_pmsm_foc_I2C_f28379d_Current_Control_Control_System_Current_Controllers_PI_Controller_Iq_Discrete_PI_Controller__with_anti_windup___reset_Saturation "mcb_pmsm_foc_I2C_f28379d/Current Control/Control_System/Current_Controllers/PI_Controller_Iq/Discrete PI Controller \r\nwith anti-windup & reset/Saturation"
 /begin SUB_GROUP mcb_pmsm_foc_I2C_f28379d_Current_Control_Control_System_Current_Controllers_PI_Controller_Iq_Discrete_PI_Controller__with_anti_windup___reset_Saturation_Enabled /end SUB_GROUP
/end GROUP
/begin GROUP mcb_pmsm_foc_I2C_f28379d_Current_Control_Control_System_Current_Controllers_PI_Controller_Iq_Discrete_PI_Controller__with_anti_windup___reset_Saturation_Enabled "mcb_pmsm_foc_I2C_f28379d/Current Control/Control_System/Current_Controllers/PI_Controller_Iq/Discrete PI Controller \r\nwith anti-windup & reset/Saturation/Enabled"
 /begin REF_MEASUREMENT mcb_pmsm_foc_I2C_f28379d_B.Saturation mcb_pmsm_foc_I2C_f28379d_B.Sum_m /end REF_MEASUREMENT
/end GROUP
/begin GROUP mcb_pmsm_foc_I2C_f28379d_Current_Control_Control_System_Current_Controllers_PI_Controller_Iq_Discrete_PI_Controller__with_anti_windup___reset_Sum "mcb_pmsm_foc_I2C_f28379d/Current Control/Control_System/Current_Controllers/PI_Controller_Iq/Discrete PI Controller \r\nwith anti-windup & reset/Sum"
 /begin SUB_GROUP mcb_pmsm_foc_I2C_f28379d_Current_Control_Control_System_Current_Controllers_PI_Controller_Iq_Discrete_PI_Controller__with_anti_windup___reset_Sum_Sum_PI /end SUB_GROUP
/end GROUP
/begin GROUP mcb_pmsm_foc_I2C_f28379d_Current_Control_Control_System_Current_Controllers_PI_Controller_Iq_Discrete_PI_Controller__with_anti_windup___reset_Sum_Sum_PI "mcb_pmsm_foc_I2C_f28379d/Current Control/Control_System/Current_Controllers/PI_Controller_Iq/Discrete PI Controller \r\nwith anti-windup & reset/Sum/Sum_PI"
 /begin REF_MEASUREMENT mcb_pmsm_foc_I2C_f28379d_B.Integrator mcb_pmsm_foc_I2C_f28379d_B.PProdOut mcb_pmsm_foc_I2C_f28379d_B.Sum_m /end REF_MEASUREMENT
/end GROUP
/begin GROUP mcb_pmsm_foc_I2C_f28379d_Current_Control_Control_System_Inverse_Park_Transform "mcb_pmsm_foc_I2C_f28379d/Current Control/Control_System/Inverse Park Transform"
 /begin SUB_GROUP mcb_pmsm_foc_I2C_f28379d_Current_Control_Control_System_Inverse_Park_Transform_Sine_Cosine mcb_pmsm_foc_I2C_f28379d_Current_Control_Control_System_Inverse_Park_Transform_Two_inputs_CRL /end SUB_GROUP
/end GROUP
/begin GROUP mcb_pmsm_foc_I2C_f28379d_Current_Control_Control_System_Inverse_Park_Transform_Sine_Cosine "mcb_pmsm_foc_I2C_f28379d/Current Control/Control_System/Inverse Park Transform/Sine Cosine"
 /begin SUB_GROUP mcb_pmsm_foc_I2C_f28379d_Current_Control_Control_System_Inverse_Park_Transform_Sine_Cosine_Interpolation mcb_pmsm_foc_I2C_f28379d_Current_Control_Control_System_Inverse_Park_Transform_Sine_Cosine_WrapUp /end SUB_GROUP
 /begin REF_MEASUREMENT mcb_pmsm_foc_I2C_f28379d_B.DataTypeConversion1_n mcb_pmsm_foc_I2C_f28379d_B.Get_Integer_j mcb_pmsm_foc_I2C_f28379d_B.Lookup_p mcb_pmsm_foc_I2C_f28379d_B.Merge_a mcb_pmsm_foc_I2C_f28379d_B.Sum2_p mcb_pmsm_foc_I2C_f28379d_B.Sum_h mcb_pmsm_foc_I2C_f28379d_B.indexing_d mcb_pmsm_foc_I2C_f28379d_DW.Sum_DWORK1 /end REF_MEASUREMENT
/end GROUP
/begin GROUP mcb_pmsm_foc_I2C_f28379d_Current_Control_Control_System_Inverse_Park_Transform_Sine_Cosine_Interpolation "mcb_pmsm_foc_I2C_f28379d/Current Control/Control_System/Inverse Park Transform/Sine Cosine/Interpolation"
 /begin REF_MEASUREMENT mcb_pmsm_foc_I2C_f28379d_B.Lookup_p mcb_pmsm_foc_I2C_f28379d_B.Product1_d mcb_pmsm_foc_I2C_f28379d_B.Product_d mcb_pmsm_foc_I2C_f28379d_B.Sum2_p mcb_pmsm_foc_I2C_f28379d_B.Sum3_j mcb_pmsm_foc_I2C_f28379d_B.Sum4_h mcb_pmsm_foc_I2C_f28379d_B.Sum5_l mcb_pmsm_foc_I2C_f28379d_B.Sum6_h /end REF_MEASUREMENT
/end GROUP
/begin GROUP mcb_pmsm_foc_I2C_f28379d_Current_Control_Control_System_Inverse_Park_Transform_Sine_Cosine_WrapUp "mcb_pmsm_foc_I2C_f28379d/Current Control/Control_System/Inverse Park Transform/Sine Cosine/WrapUp"
 /begin SUB_GROUP mcb_pmsm_foc_I2C_f28379d_Current_Control_Control_System_Inverse_Park_Transform_Sine_Cosine_WrapUp_Compare_To_Zero mcb_pmsm_foc_I2C_f28379d_Current_Control_Control_System_Inverse_Park_Transform_Sine_Cosine_WrapUp_If_Action_Subsystem mcb_pmsm_foc_I2C_f28379d_Current_Control_Control_System_Inverse_Park_Transform_Sine_Cosine_WrapUp_If_Action_Subsystem1 /end SUB_GROUP
 /begin REF_MEASUREMENT mcb_pmsm_foc_I2C_f28379d_B.Compare_f mcb_pmsm_foc_I2C_f28379d_B.DataTypeConversion_h mcb_pmsm_foc_I2C_f28379d_B.Merge_a /end REF_MEASUREMENT
/end GROUP
/begin GROUP mcb_pmsm_foc_I2C_f28379d_Current_Control_Control_System_Inverse_Park_Transform_Sine_Cosine_WrapUp_Compare_To_Zero "mcb_pmsm_foc_I2C_f28379d/Current Control/Control_System/Inverse Park Transform/Sine Cosine/WrapUp/Compare\r\nTo Zero"
 /begin REF_MEASUREMENT mcb_pmsm_foc_I2C_f28379d_B.Add_c mcb_pmsm_foc_I2C_f28379d_B.Compare_f /end REF_MEASUREMENT
/end GROUP
/begin GROUP mcb_pmsm_foc_I2C_f28379d_Current_Control_Control_System_Inverse_Park_Transform_Sine_Cosine_WrapUp_If_Action_Subsystem "mcb_pmsm_foc_I2C_f28379d/Current Control/Control_System/Inverse Park Transform/Sine Cosine/WrapUp/If Action\r\nSubsystem"
 /begin REF_MEASUREMENT mcb_pmsm_foc_I2C_f28379d_B.Add_c mcb_pmsm_foc_I2C_f28379d_B.Merge_a /end REF_MEASUREMENT
/end GROUP
/begin GROUP mcb_pmsm_foc_I2C_f28379d_Current_Control_Control_System_Inverse_Park_Transform_Sine_Cosine_WrapUp_If_Action_Subsystem1 "mcb_pmsm_foc_I2C_f28379d/Current Control/Control_System/Inverse Park Transform/Sine Cosine/WrapUp/If Action\r\nSubsystem1"
 /begin REF_MEASUREMENT mcb_pmsm_foc_I2C_f28379d_B.Add_c mcb_pmsm_foc_I2C_f28379d_B.Merge_a /end REF_MEASUREMENT
/end GROUP
/begin GROUP mcb_pmsm_foc_I2C_f28379d_Current_Control_Control_System_Inverse_Park_Transform_Two_inputs_CRL "mcb_pmsm_foc_I2C_f28379d/Current Control/Control_System/Inverse Park Transform/Two inputs CRL"
 /begin SUB_GROUP mcb_pmsm_foc_I2C_f28379d_Current_Control_Control_System_Inverse_Park_Transform_Two_inputs_CRL_Switch_Axis /end SUB_GROUP
 /begin REF_MEASUREMENT mcb_pmsm_foc_I2C_f28379d_B.Merge_i mcb_pmsm_foc_I2C_f28379d_B.Sum4_h mcb_pmsm_foc_I2C_f28379d_B.Sum6_h mcb_pmsm_foc_I2C_f28379d_B.dcos mcb_pmsm_foc_I2C_f28379d_B.dsin mcb_pmsm_foc_I2C_f28379d_B.qcos mcb_pmsm_foc_I2C_f28379d_B.qsin mcb_pmsm_foc_I2C_f28379d_B.sum_alpha mcb_pmsm_foc_I2C_f28379d_B.sum_beta /end REF_MEASUREMENT
/end GROUP
/begin GROUP mcb_pmsm_foc_I2C_f28379d_Current_Control_Control_System_Inverse_Park_Transform_Two_inputs_CRL_Switch_Axis "mcb_pmsm_foc_I2C_f28379d/Current Control/Control_System/Inverse Park Transform/Two inputs CRL/Switch_Axis" /begin REF_MEASUREMENT mcb_pmsm_foc_I2C_f28379d_B.Switch_b /end REF_MEASUREMENT /end GROUP
/begin GROUP mcb_pmsm_foc_I2C_f28379d_Current_Control_Control_System_Park_Transform "mcb_pmsm_foc_I2C_f28379d/Current Control/Control_System/Park Transform"
 /begin SUB_GROUP mcb_pmsm_foc_I2C_f28379d_Current_Control_Control_System_Park_Transform_Sine_Cosine mcb_pmsm_foc_I2C_f28379d_Current_Control_Control_System_Park_Transform_Two_inputs_CRL /end SUB_GROUP
/end GROUP
/begin GROUP mcb_pmsm_foc_I2C_f28379d_Current_Control_Control_System_Park_Transform_Sine_Cosine "mcb_pmsm_foc_I2C_f28379d/Current Control/Control_System/Park Transform/Sine Cosine"
 /begin SUB_GROUP mcb_pmsm_foc_I2C_f28379d_Current_Control_Control_System_Park_Transform_Sine_Cosine_Sine_Cosine_Lookup /end SUB_GROUP
/end GROUP
/begin GROUP mcb_pmsm_foc_I2C_f28379d_Current_Control_Control_System_Park_Transform_Sine_Cosine_Sine_Cosine_Lookup "mcb_pmsm_foc_I2C_f28379d/Current Control/Control_System/Park Transform/Sine Cosine/Sine-Cosine Lookup"
 /begin SUB_GROUP mcb_pmsm_foc_I2C_f28379d_Current_Control_Control_System_Park_Transform_Sine_Cosine_Sine_Cosine_Lookup_Interpolation mcb_pmsm_foc_I2C_f28379d_Current_Control_Control_System_Park_Transform_Sine_Cosine_Sine_Cosine_Lookup_WrapUp /end SUB_GROUP
 /begin REF_MEASUREMENT mcb_pmsm_foc_I2C_f28379d_B.DataTypeConversion1 mcb_pmsm_foc_I2C_f28379d_B.Get_Integer mcb_pmsm_foc_I2C_f28379d_B.Lookup mcb_pmsm_foc_I2C_f28379d_B.Merge_o mcb_pmsm_foc_I2C_f28379d_B.Sum mcb_pmsm_foc_I2C_f28379d_B.Sum2 mcb_pmsm_foc_I2C_f28379d_B.indexing mcb_pmsm_foc_I2C_f28379d_DW.Sum_DWORK1 /end REF_MEASUREMENT
/end GROUP
/begin GROUP mcb_pmsm_foc_I2C_f28379d_Current_Control_Control_System_Park_Transform_Sine_Cosine_Sine_Cosine_Lookup_Interpolation "mcb_pmsm_foc_I2C_f28379d/Current Control/Control_System/Park Transform/Sine Cosine/Sine-Cosine Lookup/Interpolation"
 /begin REF_MEASUREMENT mcb_pmsm_foc_I2C_f28379d_B.Lookup mcb_pmsm_foc_I2C_f28379d_B.Product1_b mcb_pmsm_foc_I2C_f28379d_B.Product_i mcb_pmsm_foc_I2C_f28379d_B.Sum2 mcb_pmsm_foc_I2C_f28379d_B.Sum3 mcb_pmsm_foc_I2C_f28379d_B.Sum4 mcb_pmsm_foc_I2C_f28379d_B.Sum5 mcb_pmsm_foc_I2C_f28379d_B.Sum6 /end REF_MEASUREMENT
/end GROUP
/begin GROUP mcb_pmsm_foc_I2C_f28379d_Current_Control_Control_System_Park_Transform_Sine_Cosine_Sine_Cosine_Lookup_WrapUp "mcb_pmsm_foc_I2C_f28379d/Current Control/Control_System/Park Transform/Sine Cosine/Sine-Cosine Lookup/WrapUp"
 /begin SUB_GROUP mcb_pmsm_foc_I2C_f28379d_Current_Control_Control_System_Park_Transform_Sine_Cosine_Sine_Cosine_Lookup_WrapUp_Compare_To_Zero mcb_pmsm_foc_I2C_f28379d_Current_Control_Control_System_Park_Transform_Sine_Cosine_Sine_Cosine_Lookup_WrapUp_If_Action_Subsystem mcb_pmsm_foc_I2C_f28379d_Current_Control_Control_System_Park_Transform_Sine_Cosine_Sine_Cosine_Lookup_WrapUp_If_Action_Subsystem1 /end SUB_GROUP
 /begin REF_MEASUREMENT mcb_pmsm_foc_I2C_f28379d_B.Compare mcb_pmsm_foc_I2C_f28379d_B.DataTypeConversion_i mcb_pmsm_foc_I2C_f28379d_B.Merge_o /end REF_MEASUREMENT
/end GROUP
/begin GROUP mcb_pmsm_foc_I2C_f28379d_Current_Control_Control_System_Park_Transform_Sine_Cosine_Sine_Cosine_Lookup_WrapUp_Compare_To_Zero "mcb_pmsm_foc_I2C_f28379d/Current Control/Control_System/Park Transform/Sine Cosine/Sine-Cosine Lookup/WrapUp/Compare\r\nTo Zero"
 /begin REF_MEASUREMENT mcb_pmsm_foc_I2C_f28379d_B.Add_c mcb_pmsm_foc_I2C_f28379d_B.Compare /end REF_MEASUREMENT
/end GROUP
/begin GROUP mcb_pmsm_foc_I2C_f28379d_Current_Control_Control_System_Park_Transform_Sine_Cosine_Sine_Cosine_Lookup_WrapUp_If_Action_Subsystem "mcb_pmsm_foc_I2C_f28379d/Current Control/Control_System/Park Transform/Sine Cosine/Sine-Cosine Lookup/WrapUp/If Action\r\nSubsystem"
 /begin REF_MEASUREMENT mcb_pmsm_foc_I2C_f28379d_B.Add_c mcb_pmsm_foc_I2C_f28379d_B.Merge_o /end REF_MEASUREMENT
/end GROUP
/begin GROUP mcb_pmsm_foc_I2C_f28379d_Current_Control_Control_System_Park_Transform_Sine_Cosine_Sine_Cosine_Lookup_WrapUp_If_Action_Subsystem1 "mcb_pmsm_foc_I2C_f28379d/Current Control/Control_System/Park Transform/Sine Cosine/Sine-Cosine Lookup/WrapUp/If Action\r\nSubsystem1"
 /begin REF_MEASUREMENT mcb_pmsm_foc_I2C_f28379d_B.Add_c mcb_pmsm_foc_I2C_f28379d_B.Merge_o /end REF_MEASUREMENT
/end GROUP
/begin GROUP mcb_pmsm_foc_I2C_f28379d_Current_Control_Control_System_Park_Transform_Two_inputs_CRL "mcb_pmsm_foc_I2C_f28379d/Current Control/Control_System/Park Transform/Two inputs CRL"
 /begin SUB_GROUP mcb_pmsm_foc_I2C_f28379d_Current_Control_Control_System_Park_Transform_Two_inputs_CRL_Switch_Axis /end SUB_GROUP
 /begin REF_MEASUREMENT mcb_pmsm_foc_I2C_f28379d_B.Sum4 mcb_pmsm_foc_I2C_f28379d_B.Sum6 mcb_pmsm_foc_I2C_f28379d_B.acos_b mcb_pmsm_foc_I2C_f28379d_B.algDD_o1 mcb_pmsm_foc_I2C_f28379d_B.algDD_o1_e mcb_pmsm_foc_I2C_f28379d_B.algDD_o2 mcb_pmsm_foc_I2C_f28379d_B.algDD_o2_h mcb_pmsm_foc_I2C_f28379d_B.asin_o mcb_pmsm_foc_I2C_f28379d_B.bcos mcb_pmsm_foc_I2C_f28379d_B.bsin mcb_pmsm_foc_I2C_f28379d_B.sum_Ds mcb_pmsm_foc_I2C_f28379d_B.sum_Qs /end REF_MEASUREMENT
/end GROUP
/begin GROUP mcb_pmsm_foc_I2C_f28379d_Current_Control_Control_System_Park_Transform_Two_inputs_CRL_Switch_Axis "mcb_pmsm_foc_I2C_f28379d/Current Control/Control_System/Park Transform/Two inputs CRL/Switch_Axis" /begin REF_MEASUREMENT mcb_pmsm_foc_I2C_f28379d_B.Switch_h /end REF_MEASUREMENT /end GROUP
/begin GROUP mcb_pmsm_foc_I2C_f28379d_Current_Control_Control_System_Space_Vector_Generator "mcb_pmsm_foc_I2C_f28379d/Current Control/Control_System/Space Vector Generator"
 /begin SUB_GROUP mcb_pmsm_foc_I2C_f28379d_Current_Control_Control_System_Space_Vector_Generator_Modulation_method mcb_pmsm_foc_I2C_f28379d_Current_Control_Control_System_Space_Vector_Generator_Voltage_Input /end SUB_GROUP
/end GROUP
/begin GROUP mcb_pmsm_foc_I2C_f28379d_Current_Control_Control_System_Space_Vector_Generator_Modulation_method "mcb_pmsm_foc_I2C_f28379d/Current Control/Control_System/Space Vector Generator/Modulation method"
 /begin SUB_GROUP mcb_pmsm_foc_I2C_f28379d_Current_Control_Control_System_Space_Vector_Generator_Modulation_method_SVPWM /end SUB_GROUP
/end GROUP
/begin GROUP mcb_pmsm_foc_I2C_f28379d_Current_Control_Control_System_Space_Vector_Generator_Modulation_method_SVPWM "mcb_pmsm_foc_I2C_f28379d/Current Control/Control_System/Space Vector Generator/Modulation method/SVPWM"
 /begin SUB_GROUP mcb_pmsm_foc_I2C_f28379d_Current_Control_Control_System_Space_Vector_Generator_Modulation_method_SVPWM_Half_Vmin_Vmax_ /end SUB_GROUP
 /begin REF_MEASUREMENT mcb_pmsm_foc_I2C_f28379d_B.Add1_d mcb_pmsm_foc_I2C_f28379d_B.Add2 mcb_pmsm_foc_I2C_f28379d_B.Add3 mcb_pmsm_foc_I2C_f28379d_B.Gain_a mcb_pmsm_foc_I2C_f28379d_B.add_b mcb_pmsm_foc_I2C_f28379d_B.add_c mcb_pmsm_foc_I2C_f28379d_B.algDD_o1_p mcb_pmsm_foc_I2C_f28379d_B.one_by_two_l /end REF_MEASUREMENT
/end GROUP
/begin GROUP mcb_pmsm_foc_I2C_f28379d_Current_Control_Control_System_Space_Vector_Generator_Modulation_method_SVPWM_Half_Vmin_Vmax_ "mcb_pmsm_foc_I2C_f28379d/Current Control/Control_System/Space Vector Generator/Modulation method/SVPWM/Half(Vmin+Vmax)"
 /begin REF_MEASUREMENT mcb_pmsm_foc_I2C_f28379d_B.Add_n mcb_pmsm_foc_I2C_f28379d_B.Max mcb_pmsm_foc_I2C_f28379d_B.Min mcb_pmsm_foc_I2C_f28379d_B.add_b mcb_pmsm_foc_I2C_f28379d_B.add_c mcb_pmsm_foc_I2C_f28379d_B.algDD_o1_p mcb_pmsm_foc_I2C_f28379d_B.one_by_two_l /end REF_MEASUREMENT
/end GROUP
/begin GROUP mcb_pmsm_foc_I2C_f28379d_Current_Control_Control_System_Space_Vector_Generator_Voltage_Input "mcb_pmsm_foc_I2C_f28379d/Current Control/Control_System/Space Vector Generator/Voltage Input"
 /begin SUB_GROUP mcb_pmsm_foc_I2C_f28379d_Current_Control_Control_System_Space_Vector_Generator_Voltage_Input_Valphabeta /end SUB_GROUP
/end GROUP
/begin GROUP mcb_pmsm_foc_I2C_f28379d_Current_Control_Control_System_Space_Vector_Generator_Voltage_Input_Valphabeta "mcb_pmsm_foc_I2C_f28379d/Current Control/Control_System/Space Vector Generator/Voltage Input/Valphabeta"
 /begin SUB_GROUP mcb_pmsm_foc_I2C_f28379d_Current_Control_Control_System_Space_Vector_Generator_Voltage_Input_Valphabeta_Inverse_Clarke_Transform /end SUB_GROUP
/end GROUP
/begin GROUP mcb_pmsm_foc_I2C_f28379d_Current_Control_Control_System_Space_Vector_Generator_Voltage_Input_Valphabeta_Inverse_Clarke_Transform "mcb_pmsm_foc_I2C_f28379d/Current Control/Control_System/Space Vector Generator/Voltage Input/Valphabeta/Inverse Clarke Transform"
 /begin SUB_GROUP mcb_pmsm_foc_I2C_f28379d_Current_Control_Control_System_Space_Vector_Generator_Voltage_Input_Valphabeta_Inverse_Clarke_Transform_Two_phase_input /end SUB_GROUP
/end GROUP
/begin GROUP mcb_pmsm_foc_I2C_f28379d_Current_Control_Control_System_Space_Vector_Generator_Voltage_Input_Valphabeta_Inverse_Clarke_Transform_Two_phase_input "mcb_pmsm_foc_I2C_f28379d/Current Control/Control_System/Space Vector Generator/Voltage Input/Valphabeta/Inverse Clarke Transform/Two phase input"
 /begin REF_MEASUREMENT mcb_pmsm_foc_I2C_f28379d_B.add_b mcb_pmsm_foc_I2C_f28379d_B.add_c mcb_pmsm_foc_I2C_f28379d_B.algDD_o1_p mcb_pmsm_foc_I2C_f28379d_B.algDD_o2_o mcb_pmsm_foc_I2C_f28379d_B.one_by_two mcb_pmsm_foc_I2C_f28379d_B.sqrt3_by_two /end REF_MEASUREMENT
/end GROUP
/begin GROUP mcb_pmsm_foc_I2C_f28379d_Current_Control_Debug_signals "mcb_pmsm_foc_I2C_f28379d/Current Control/Debug_signals"
 /begin REF_MEASUREMENT mcb_pmsm_foc_I2C_f28379d_B.DataStoreRead mcb_pmsm_foc_I2C_f28379d_B.MultiportSwitch mcb_pmsm_foc_I2C_f28379d_B.Selector mcb_pmsm_foc_I2C_f28379d_B.TmpSignalConversionAtSelectorIn mcb_pmsm_foc_I2C_f28379d_DW.Debug_signals /end REF_MEASUREMENT
/end GROUP
/begin GROUP mcb_pmsm_foc_I2C_f28379d_Current_Control_HW_Inputs "mcb_pmsm_foc_I2C_f28379d/Current Control/HW_Inputs"
 /begin SUB_GROUP mcb_pmsm_foc_I2C_f28379d_Current_Control_HW_Inputs_Sensor_Driver_Blocks__codegen_ /end SUB_GROUP
/end GROUP
/begin GROUP mcb_pmsm_foc_I2C_f28379d_Current_Control_HW_Inputs_Sensor_Driver_Blocks__codegen_ "mcb_pmsm_foc_I2C_f28379d/Current Control/HW_Inputs/Sensor Driver Blocks (codegen)"
 /begin REF_MEASUREMENT mcb_pmsm_foc_I2C_f28379d_B.ADC_B_IN2 mcb_pmsm_foc_I2C_f28379d_B.ADC_C_IN2 /end REF_MEASUREMENT
/end GROUP
/begin GROUP mcb_pmsm_foc_I2C_f28379d_Current_Control_Input_Scaling "mcb_pmsm_foc_I2C_f28379d/Current Control/Input Scaling"
 /begin SUB_GROUP mcb_pmsm_foc_I2C_f28379d_Current_Control_Input_Scaling_Calculate_Phase_Currents mcb_pmsm_foc_I2C_f28379d_Current_Control_Input_Scaling__Calculate_Position_and_Speed /end SUB_GROUP
/end GROUP
/begin GROUP mcb_pmsm_foc_I2C_f28379d_Current_Control_Input_Scaling_Calculate_Phase_Currents "mcb_pmsm_foc_I2C_f28379d/Current Control/Input Scaling/Calculate Phase Currents"
 /begin SUB_GROUP mcb_pmsm_foc_I2C_f28379d_Current_Control_Input_Scaling_Calculate_Phase_Currents_Data_Type /end SUB_GROUP
 /begin REF_MEASUREMENT mcb_pmsm_foc_I2C_f28379d_B.Add_e mcb_pmsm_foc_I2C_f28379d_B.DataStoreRead1_o mcb_pmsm_foc_I2C_f28379d_B.DataStoreRead2_j mcb_pmsm_foc_I2C_f28379d_B.DataTypeConversion_c mcb_pmsm_foc_I2C_f28379d_B.InvertingNoninvertingCurrentmea mcb_pmsm_foc_I2C_f28379d_B.PU_Conversion mcb_pmsm_foc_I2C_f28379d_DW.Add_DWORK1 mcb_pmsm_foc_I2C_f28379d_DW.IaOffset mcb_pmsm_foc_I2C_f28379d_DW.IbOffset /end REF_MEASUREMENT
/end GROUP
/begin GROUP mcb_pmsm_foc_I2C_f28379d_Current_Control_Input_Scaling_Calculate_Phase_Currents_Data_Type "mcb_pmsm_foc_I2C_f28379d/Current Control/Input Scaling/Calculate Phase Currents/Data_Type"
 /begin SUB_GROUP mcb_pmsm_foc_I2C_f28379d_Current_Control_Input_Scaling_Calculate_Phase_Currents_Data_Type_Data_Type_Float /end SUB_GROUP
/end GROUP
/begin GROUP mcb_pmsm_foc_I2C_f28379d_Current_Control_Input_Scaling_Calculate_Phase_Currents_Data_Type_Data_Type_Float "mcb_pmsm_foc_I2C_f28379d/Current Control/Input Scaling/Calculate Phase Currents/Data_Type/Data_Type_Float"
 /begin REF_MEASUREMENT mcb_pmsm_foc_I2C_f28379d_B.Add_e mcb_pmsm_foc_I2C_f28379d_B.GetADCVoltage mcb_pmsm_foc_I2C_f28379d_B.GetCurrents mcb_pmsm_foc_I2C_f28379d_B.PU_Conversion /end REF_MEASUREMENT
/end GROUP
/begin GROUP mcb_pmsm_foc_I2C_f28379d_Current_Control_Input_Scaling__Calculate_Position_and_Speed "mcb_pmsm_foc_I2C_f28379d/Current Control/Input Scaling/ Calculate Position and Speed"
 /begin SUB_GROUP mcb_pmsm_foc_I2C_f28379d_Current_Control_Input_Scaling__Calculate_Position_and_Speed_IIR_Filter mcb_pmsm_foc_I2C_f28379d_Current_Control_Input_Scaling__Calculate_Position_and_Speed_Mechanical_to_Electrical_Position mcb_pmsm_foc_I2C_f28379d_Current_Control_Input_Scaling__Calculate_Position_and_Speed_Speed_Measurement mcb_pmsm_foc_I2C_f28379d_Current_Control_Input_Scaling__Calculate_Position_and_Speed_Subsystem mcb_pmsm_foc_I2C_f28379d_Current_Control_Input_Scaling__Calculate_Position_and_Speed_Subsystem1 mcb_pmsm_foc_I2C_f28379d_Current_Control_Input_Scaling__Calculate_Position_and_Speed_Subsystem2 /end SUB_GROUP
 /begin REF_MEASUREMENT mcb_pmsm_foc_I2C_f28379d_B.Delay_c mcb_pmsm_foc_I2C_f28379d_B.Merge_c mcb_pmsm_foc_I2C_f28379d_B.RT4 mcb_pmsm_foc_I2C_f28379d_B.Sum_a mcb_pmsm_foc_I2C_f28379d_B.Unwrap mcb_pmsm_foc_I2C_f28379d_DW.Delay_DSTATE mcb_pmsm_foc_I2C_f28379d_DW.Unwrap_Cumsum mcb_pmsm_foc_I2C_f28379d_DW.Unwrap_FirstStep mcb_pmsm_foc_I2C_f28379d_DW.Unwrap_Prev /end REF_MEASUREMENT
/end GROUP
/begin GROUP mcb_pmsm_foc_I2C_f28379d_Current_Control_Input_Scaling__Calculate_Position_and_Speed_IIR_Filter "mcb_pmsm_foc_I2C_f28379d/Current Control/Input Scaling/ Calculate Position and Speed/IIR Filter"
 /begin SUB_GROUP mcb_pmsm_foc_I2C_f28379d_Current_Control_Input_Scaling__Calculate_Position_and_Speed_IIR_Filter_IIR_Filter /end SUB_GROUP
/end GROUP
/begin GROUP mcb_pmsm_foc_I2C_f28379d_Current_Control_Input_Scaling__Calculate_Position_and_Speed_IIR_Filter_IIR_Filter "mcb_pmsm_foc_I2C_f28379d/Current Control/Input Scaling/ Calculate Position and Speed/IIR Filter/IIR Filter"
 /begin SUB_GROUP mcb_pmsm_foc_I2C_f28379d_Current_Control_Input_Scaling__Calculate_Position_and_Speed_IIR_Filter_IIR_Filter_Low_pass /end SUB_GROUP
/end GROUP
/begin GROUP mcb_pmsm_foc_I2C_f28379d_Current_Control_Input_Scaling__Calculate_Position_and_Speed_IIR_Filter_IIR_Filter_Low_pass "mcb_pmsm_foc_I2C_f28379d/Current Control/Input Scaling/ Calculate Position and Speed/IIR Filter/IIR Filter/Low-pass"
 /begin SUB_GROUP mcb_pmsm_foc_I2C_f28379d_Current_Control_Input_Scaling__Calculate_Position_and_Speed_IIR_Filter_IIR_Filter_Low_pass_IIR_Low_Pass_Filter /end SUB_GROUP
/end GROUP
/begin GROUP mcb_pmsm_foc_I2C_f28379d_Current_Control_Input_Scaling__Calculate_Position_and_Speed_IIR_Filter_IIR_Filter_Low_pass_IIR_Low_Pass_Filter "mcb_pmsm_foc_I2C_f28379d/Current Control/Input Scaling/ Calculate Position and Speed/IIR Filter/IIR Filter/Low-pass/IIR Low Pass Filter"
 /begin REF_MEASUREMENT mcb_pmsm_foc_I2C_f28379d_B.Add1 mcb_pmsm_foc_I2C_f28379d_B.Product mcb_pmsm_foc_I2C_f28379d_B.Product1 mcb_pmsm_foc_I2C_f28379d_B.SpeedGain mcb_pmsm_foc_I2C_f28379d_B.UnitDelay mcb_pmsm_foc_I2C_f28379d_DW.UnitDelay_DSTATE /end REF_MEASUREMENT
/end GROUP
/begin GROUP mcb_pmsm_foc_I2C_f28379d_Current_Control_Input_Scaling__Calculate_Position_and_Speed_Mechanical_to_Electrical_Position "mcb_pmsm_foc_I2C_f28379d/Current Control/Input Scaling/ Calculate Position and Speed/Mechanical to Electrical Position"
 /begin SUB_GROUP mcb_pmsm_foc_I2C_f28379d_Current_Control_Input_Scaling__Calculate_Position_and_Speed_Mechanical_to_Electrical_Position_MechToElec /end SUB_GROUP
/end GROUP
/begin GROUP mcb_pmsm_foc_I2C_f28379d_Current_Control_Input_Scaling__Calculate_Position_and_Speed_Mechanical_to_Electrical_Position_MechToElec "mcb_pmsm_foc_I2C_f28379d/Current Control/Input Scaling/ Calculate Position and Speed/Mechanical to Electrical Position/MechToElec"
 /begin SUB_GROUP mcb_pmsm_foc_I2C_f28379d_Current_Control_Input_Scaling__Calculate_Position_and_Speed_Mechanical_to_Electrical_Position_MechToElec_floating_point /end SUB_GROUP
/end GROUP
/begin GROUP mcb_pmsm_foc_I2C_f28379d_Current_Control_Input_Scaling__Calculate_Position_and_Speed_Mechanical_to_Electrical_Position_MechToElec_floating_point "mcb_pmsm_foc_I2C_f28379d/Current Control/Input Scaling/ Calculate Position and Speed/Mechanical to Electrical Position/MechToElec/floating-point"
 /begin SUB_GROUP mcb_pmsm_foc_I2C_f28379d_Current_Control_Input_Scaling__Calculate_Position_and_Speed_Mechanical_to_Electrical_Position_MechToElec_floating_point_Compensate_Offset mcb_pmsm_foc_I2C_f28379d_Current_Control_Input_Scaling__Calculate_Position_and_Speed_Mechanical_to_Electrical_Position_MechToElec_floating_point_Mech_To_Elec /end SUB_GROUP
 /begin REF_MEASUREMENT mcb_pmsm_foc_I2C_f28379d_B.Switch /end REF_MEASUREMENT
/end GROUP
/begin GROUP mcb_pmsm_foc_I2C_f28379d_Current_Control_Input_Scaling__Calculate_Position_and_Speed_Mechanical_to_Electrical_Position_MechToElec_floating_point_Compensate_Offset "mcb_pmsm_foc_I2C_f28379d/Current Control/Input Scaling/ Calculate Position and Speed/Mechanical to Electrical Position/MechToElec/floating-point/Compensate Offset"
 /begin SUB_GROUP mcb_pmsm_foc_I2C_f28379d_Current_Control_Input_Scaling__Calculate_Position_and_Speed_Mechanical_to_Electrical_Position_MechToElec_floating_point_Compensate_Offset_If_Action_Subsystem mcb_pmsm_foc_I2C_f28379d_Current_Control_Input_Scaling__Calculate_Position_and_Speed_Mechanical_to_Electrical_Position_MechToElec_floating_point_Compensate_Offset_If_Action_Subsystem1 /end SUB_GROUP
 /begin REF_MEASUREMENT mcb_pmsm_foc_I2C_f28379d_B.Merge mcb_pmsm_foc_I2C_f28379d_B.RT4 mcb_pmsm_foc_I2C_f28379d_B.Switch /end REF_MEASUREMENT
/end GROUP
/begin GROUP mcb_pmsm_foc_I2C_f28379d_Current_Control_Input_Scaling__Calculate_Position_and_Speed_Mechanical_to_Electrical_Position_MechToElec_floating_point_Compensate_Offset_If_Action_Subsystem "mcb_pmsm_foc_I2C_f28379d/Current Control/Input Scaling/ Calculate Position and Speed/Mechanical to Electrical Position/MechToElec/floating-point/Compensate Offset/If Action\r\nSubsystem"
 /begin REF_MEASUREMENT mcb_pmsm_foc_I2C_f28379d_B.Merge mcb_pmsm_foc_I2C_f28379d_B.RT4 mcb_pmsm_foc_I2C_f28379d_B.Switch /end REF_MEASUREMENT
/end GROUP
/begin GROUP mcb_pmsm_foc_I2C_f28379d_Current_Control_Input_Scaling__Calculate_Position_and_Speed_Mechanical_to_Electrical_Position_MechToElec_floating_point_Compensate_Offset_If_Action_Subsystem1 "mcb_pmsm_foc_I2C_f28379d/Current Control/Input Scaling/ Calculate Position and Speed/Mechanical to Electrical Position/MechToElec/floating-point/Compensate Offset/If Action\r\nSubsystem1"
 /begin REF_MEASUREMENT mcb_pmsm_foc_I2C_f28379d_B.Merge mcb_pmsm_foc_I2C_f28379d_B.RT4 mcb_pmsm_foc_I2C_f28379d_B.Switch /end REF_MEASUREMENT
/end GROUP
/begin GROUP mcb_pmsm_foc_I2C_f28379d_Current_Control_Input_Scaling__Calculate_Position_and_Speed_Mechanical_to_Electrical_Position_MechToElec_floating_point_Mech_To_Elec "mcb_pmsm_foc_I2C_f28379d/Current Control/Input Scaling/ Calculate Position and Speed/Mechanical to Electrical Position/MechToElec/floating-point/Mech To Elec"
 /begin SUB_GROUP mcb_pmsm_foc_I2C_f28379d_Current_Control_Input_Scaling__Calculate_Position_and_Speed_Mechanical_to_Electrical_Position_MechToElec_floating_point_Mech_To_Elec_Variant_Subsystem /end SUB_GROUP
 /begin REF_MEASUREMENT mcb_pmsm_foc_I2C_f28379d_B.Add_c mcb_pmsm_foc_I2C_f28379d_B.Floor mcb_pmsm_foc_I2C_f28379d_B.Numberofpolepairs /end REF_MEASUREMENT
/end GROUP
/begin GROUP mcb_pmsm_foc_I2C_f28379d_Current_Control_Input_Scaling__Calculate_Position_and_Speed_Mechanical_to_Electrical_Position_MechToElec_floating_point_Mech_To_Elec_Variant_Subsystem "mcb_pmsm_foc_I2C_f28379d/Current Control/Input Scaling/ Calculate Position and Speed/Mechanical to Electrical Position/MechToElec/floating-point/Mech To Elec/Variant Subsystem"
 /begin SUB_GROUP mcb_pmsm_foc_I2C_f28379d_Current_Control_Input_Scaling__Calculate_Position_and_Speed_Mechanical_to_Electrical_Position_MechToElec_floating_point_Mech_To_Elec_Variant_Subsystem_Dialog /end SUB_GROUP
/end GROUP
/begin GROUP mcb_pmsm_foc_I2C_f28379d_Current_Control_Input_Scaling__Calculate_Position_and_Speed_Mechanical_to_Electrical_Position_MechToElec_floating_point_Mech_To_Elec_Variant_Subsystem_Dialog "mcb_pmsm_foc_I2C_f28379d/Current Control/Input Scaling/ Calculate Position and Speed/Mechanical to Electrical Position/MechToElec/floating-point/Mech To Elec/Variant Subsystem/Dialog"
 /begin REF_MEASUREMENT mcb_pmsm_foc_I2C_f28379d_B.Merge mcb_pmsm_foc_I2C_f28379d_B.Numberofpolepairs /end REF_MEASUREMENT
/end GROUP
/begin GROUP mcb_pmsm_foc_I2C_f28379d_Current_Control_Input_Scaling__Calculate_Position_and_Speed_Speed_Measurement "mcb_pmsm_foc_I2C_f28379d/Current Control/Input Scaling/ Calculate Position and Speed/Speed Measurement"
 /begin SUB_GROUP mcb_pmsm_foc_I2C_f28379d_Current_Control_Input_Scaling__Calculate_Position_and_Speed_Speed_Measurement_DT_Handle /end SUB_GROUP
 /begin REF_MEASUREMENT mcb_pmsm_foc_I2C_f28379d_B.DTC mcb_pmsm_foc_I2C_f28379d_B.Delay mcb_pmsm_foc_I2C_f28379d_B.PositionToCount mcb_pmsm_foc_I2C_f28379d_B.SpeedCount mcb_pmsm_foc_I2C_f28379d_B.SpeedGain mcb_pmsm_foc_I2C_f28379d_B.Unwrap mcb_pmsm_foc_I2C_f28379d_DW.CircBufIdx mcb_pmsm_foc_I2C_f28379d_DW.Delay_DSTATE_p mcb_pmsm_foc_I2C_f28379d_DW.SpeedCount_DWORK1 /end REF_MEASUREMENT
/end GROUP
/begin GROUP mcb_pmsm_foc_I2C_f28379d_Current_Control_Input_Scaling__Calculate_Position_and_Speed_Speed_Measurement_DT_Handle "mcb_pmsm_foc_I2C_f28379d/Current Control/Input Scaling/ Calculate Position and Speed/Speed Measurement/DT_Handle"
 /begin SUB_GROUP mcb_pmsm_foc_I2C_f28379d_Current_Control_Input_Scaling__Calculate_Position_and_Speed_Speed_Measurement_DT_Handle_floating_point /end SUB_GROUP
/end GROUP
/begin GROUP mcb_pmsm_foc_I2C_f28379d_Current_Control_Input_Scaling__Calculate_Position_and_Speed_Speed_Measurement_DT_Handle_floating_point "mcb_pmsm_foc_I2C_f28379d/Current Control/Input Scaling/ Calculate Position and Speed/Speed Measurement/DT_Handle/floating-point"
 /begin REF_MEASUREMENT mcb_pmsm_foc_I2C_f28379d_B.DTC mcb_pmsm_foc_I2C_f28379d_B.SpeedCount /end REF_MEASUREMENT
/end GROUP
/begin GROUP mcb_pmsm_foc_I2C_f28379d_Current_Control_Input_Scaling__Calculate_Position_and_Speed_Subsystem "mcb_pmsm_foc_I2C_f28379d/Current Control/Input Scaling/ Calculate Position and Speed/Subsystem"
 /begin REF_MEASUREMENT mcb_pmsm_foc_I2C_f28379d_B.Merge_c mcb_pmsm_foc_I2C_f28379d_B.Sum_a /end REF_MEASUREMENT
/end GROUP
/begin GROUP mcb_pmsm_foc_I2C_f28379d_Current_Control_Input_Scaling__Calculate_Position_and_Speed_Subsystem1 "mcb_pmsm_foc_I2C_f28379d/Current Control/Input Scaling/ Calculate Position and Speed/Subsystem1"
 /begin REF_MEASUREMENT mcb_pmsm_foc_I2C_f28379d_B.Merge_c mcb_pmsm_foc_I2C_f28379d_B.Sum_a /end REF_MEASUREMENT
/end GROUP
/begin GROUP mcb_pmsm_foc_I2C_f28379d_Current_Control_Input_Scaling__Calculate_Position_and_Speed_Subsystem2 "mcb_pmsm_foc_I2C_f28379d/Current Control/Input Scaling/ Calculate Position and Speed/Subsystem2" /begin REF_MEASUREMENT mcb_pmsm_foc_I2C_f28379d_B.Merge_c /end REF_MEASUREMENT /end GROUP
/begin GROUP mcb_pmsm_foc_I2C_f28379d_Current_Control_Inverter "mcb_pmsm_foc_I2C_f28379d/Current Control/Inverter"
 /begin SUB_GROUP mcb_pmsm_foc_I2C_f28379d_Current_Control_Inverter_Code_Generation /end SUB_GROUP
/end GROUP
/begin GROUP mcb_pmsm_foc_I2C_f28379d_Current_Control_Inverter_Code_Generation "mcb_pmsm_foc_I2C_f28379d/Current Control/Inverter/Code Generation"
 /begin REF_MEASUREMENT mcb_pmsm_foc_I2C_f28379d_B.DataTypeConversion mcb_pmsm_foc_I2C_f28379d_B.PWM_Duty_Cycles mcb_pmsm_foc_I2C_f28379d_B.Scale_to_PWM_Counter_PRD mcb_pmsm_foc_I2C_f28379d_B.Switch1_jv mcb_pmsm_foc_I2C_f28379d_B.Switch_g mcb_pmsm_foc_I2C_f28379d_DW.DRV830xEnable_FRAC_LEN /end REF_MEASUREMENT
/end GROUP
/begin GROUP mcb_pmsm_foc_I2C_f28379d_Current_Control_Output_Scaling "mcb_pmsm_foc_I2C_f28379d/Current Control/Output Scaling"
 /begin REF_MEASUREMENT mcb_pmsm_foc_I2C_f28379d_B.DataTypeConversion mcb_pmsm_foc_I2C_f28379d_B.Gain_a mcb_pmsm_foc_I2C_f28379d_B.One_by_Two mcb_pmsm_foc_I2C_f28379d_B.PWM_Duty_Cycles mcb_pmsm_foc_I2C_f28379d_B.PWM_En mcb_pmsm_foc_I2C_f28379d_DW.Enable /end REF_MEASUREMENT
/end GROUP
/begin GROUP mcb_pmsm_foc_I2C_f28379d_Current_Control_SCI_Tx "mcb_pmsm_foc_I2C_f28379d/Current Control/SCI_Tx"
 /begin SUB_GROUP mcb_pmsm_foc_I2C_f28379d_Current_Control_SCI_Tx_Code_Generation /end SUB_GROUP
/end GROUP
/begin GROUP mcb_pmsm_foc_I2C_f28379d_Current_Control_SCI_Tx_Code_Generation "mcb_pmsm_foc_I2C_f28379d/Current Control/SCI_Tx/Code Generation"
 /begin SUB_GROUP mcb_pmsm_foc_I2C_f28379d_Current_Control_SCI_Tx_Code_Generation_Data_Conditioning_Tx mcb_pmsm_foc_I2C_f28379d_Current_Control_SCI_Tx_Code_Generation_Data_Logging mcb_pmsm_foc_I2C_f28379d_Current_Control_SCI_Tx_Code_Generation_While_Iterator_Subsystem /end SUB_GROUP
/end GROUP
/begin GROUP mcb_pmsm_foc_I2C_f28379d_Current_Control_SCI_Tx_Code_Generation_Data_Conditioning_Tx "mcb_pmsm_foc_I2C_f28379d/Current Control/SCI_Tx/Code Generation/Data_Conditioning_Tx"
 /begin SUB_GROUP mcb_pmsm_foc_I2C_f28379d_Current_Control_SCI_Tx_Code_Generation_Data_Conditioning_Tx_Data_Type_Float /end SUB_GROUP
/end GROUP
/begin GROUP mcb_pmsm_foc_I2C_f28379d_Current_Control_SCI_Tx_Code_Generation_Data_Conditioning_Tx_Data_Type_Float "mcb_pmsm_foc_I2C_f28379d/Current Control/SCI_Tx/Code Generation/Data_Conditioning_Tx/Data_Type_Float"
 /begin REF_MEASUREMENT mcb_pmsm_foc_I2C_f28379d_B.BytePack mcb_pmsm_foc_I2C_f28379d_B.Selector /end REF_MEASUREMENT
/end GROUP
/begin GROUP mcb_pmsm_foc_I2C_f28379d_Current_Control_SCI_Tx_Code_Generation_Data_Logging "mcb_pmsm_foc_I2C_f28379d/Current Control/SCI_Tx/Code Generation/Data_Logging"
 /begin SUB_GROUP mcb_pmsm_foc_I2C_f28379d_Current_Control_SCI_Tx_Code_Generation_Data_Logging_Counter_Limited mcb_pmsm_foc_I2C_f28379d_Current_Control_SCI_Tx_Code_Generation_Data_Logging_Data mcb_pmsm_foc_I2C_f28379d_Current_Control_SCI_Tx_Code_Generation_Data_Logging_End mcb_pmsm_foc_I2C_f28379d_Current_Control_SCI_Tx_Code_Generation_Data_Logging_Start /end SUB_GROUP
 /begin REF_MEASUREMENT mcb_pmsm_foc_I2C_f28379d_B.BytePack mcb_pmsm_foc_I2C_f28379d_B.Output mcb_pmsm_foc_I2C_f28379d_B.SCI_Tx_Data mcb_pmsm_foc_I2C_f28379d_B.SCI_Tx_Iteration /end REF_MEASUREMENT
/end GROUP
/begin GROUP mcb_pmsm_foc_I2C_f28379d_Current_Control_SCI_Tx_Code_Generation_Data_Logging_Counter_Limited "mcb_pmsm_foc_I2C_f28379d/Current Control/SCI_Tx/Code Generation/Data_Logging/Counter\r\nLimited"
 /begin SUB_GROUP mcb_pmsm_foc_I2C_f28379d_Current_Control_SCI_Tx_Code_Generation_Data_Logging_Counter_Limited_Increment_Real_World mcb_pmsm_foc_I2C_f28379d_Current_Control_SCI_Tx_Code_Generation_Data_Logging_Counter_Limited_Wrap_To_Zero /end SUB_GROUP
 /begin REF_MEASUREMENT mcb_pmsm_foc_I2C_f28379d_B.FixPtSwitch mcb_pmsm_foc_I2C_f28379d_B.Output mcb_pmsm_foc_I2C_f28379d_DW.Output_DSTATE /end REF_MEASUREMENT
/end GROUP
/begin GROUP mcb_pmsm_foc_I2C_f28379d_Current_Control_SCI_Tx_Code_Generation_Data_Logging_Counter_Limited_Increment_Real_World "mcb_pmsm_foc_I2C_f28379d/Current Control/SCI_Tx/Code Generation/Data_Logging/Counter\r\nLimited/Increment\r\nReal World"
 /begin REF_MEASUREMENT mcb_pmsm_foc_I2C_f28379d_B.FixPtSum1 mcb_pmsm_foc_I2C_f28379d_B.Output /end REF_MEASUREMENT
/end GROUP
/begin GROUP mcb_pmsm_foc_I2C_f28379d_Current_Control_SCI_Tx_Code_Generation_Data_Logging_Counter_Limited_Wrap_To_Zero "mcb_pmsm_foc_I2C_f28379d/Current Control/SCI_Tx/Code Generation/Data_Logging/Counter\r\nLimited/Wrap To Zero"
 /begin REF_MEASUREMENT mcb_pmsm_foc_I2C_f28379d_B.FixPtSum1 mcb_pmsm_foc_I2C_f28379d_B.FixPtSwitch /end REF_MEASUREMENT
/end GROUP
/begin GROUP mcb_pmsm_foc_I2C_f28379d_Current_Control_SCI_Tx_Code_Generation_Data_Logging_Data "mcb_pmsm_foc_I2C_f28379d/Current Control/SCI_Tx/Code Generation/Data_Logging/Data"
 /begin REF_MEASUREMENT mcb_pmsm_foc_I2C_f28379d_B.Data mcb_pmsm_foc_I2C_f28379d_B.SCI_Tx_Iteration /end REF_MEASUREMENT
/end GROUP
/begin GROUP mcb_pmsm_foc_I2C_f28379d_Current_Control_SCI_Tx_Code_Generation_Data_Logging_End "mcb_pmsm_foc_I2C_f28379d/Current Control/SCI_Tx/Code Generation/Data_Logging/End"
 /begin REF_MEASUREMENT mcb_pmsm_foc_I2C_f28379d_B.Data_f mcb_pmsm_foc_I2C_f28379d_B.SCI_Tx_Iteration /end REF_MEASUREMENT
/end GROUP
/begin GROUP mcb_pmsm_foc_I2C_f28379d_Current_Control_SCI_Tx_Code_Generation_Data_Logging_Start "mcb_pmsm_foc_I2C_f28379d/Current Control/SCI_Tx/Code Generation/Data_Logging/Start"
 /begin REF_MEASUREMENT mcb_pmsm_foc_I2C_f28379d_B.Data_fw mcb_pmsm_foc_I2C_f28379d_B.SCI_Tx_Iteration /end REF_MEASUREMENT
/end GROUP
/begin GROUP mcb_pmsm_foc_I2C_f28379d_Current_Control_SCI_Tx_Code_Generation_While_Iterator_Subsystem "mcb_pmsm_foc_I2C_f28379d/Current Control/SCI_Tx/Code Generation/While Iterator\r\nSubsystem"
 /begin REF_MEASUREMENT mcb_pmsm_foc_I2C_f28379d_B.Add mcb_pmsm_foc_I2C_f28379d_B.IndexVector mcb_pmsm_foc_I2C_f28379d_B.SCI_Tx_Data mcb_pmsm_foc_I2C_f28379d_B.SCI_Tx_Iteration mcb_pmsm_foc_I2C_f28379d_B.WhileIterator mcb_pmsm_foc_I2C_f28379d_DW.Add_DWORK1_n /end REF_MEASUREMENT
/end GROUP
/begin GROUP mcb_pmsm_foc_I2C_f28379d_Hardware_Init "mcb_pmsm_foc_I2C_f28379d/Hardware Init" /begin SUB_GROUP mcb_pmsm_foc_I2C_f28379d_Hardware_Init_Variant_Subsystem /end SUB_GROUP /end GROUP
/begin GROUP mcb_pmsm_foc_I2C_f28379d_Hardware_Init_Variant_Subsystem "mcb_pmsm_foc_I2C_f28379d/Hardware Init/Variant Subsystem"
 /begin SUB_GROUP mcb_pmsm_foc_I2C_f28379d_Hardware_Init_Variant_Subsystem_Code_Generation /end SUB_GROUP
/end GROUP
/begin GROUP mcb_pmsm_foc_I2C_f28379d_Hardware_Init_Variant_Subsystem_Code_Generation "mcb_pmsm_foc_I2C_f28379d/Hardware Init/Variant Subsystem/Code Generation"
 /begin SUB_GROUP mcb_pmsm_foc_I2C_f28379d_Hardware_Init_Variant_Subsystem_Code_Generation_Calculate_ADC_Offset_ mcb_pmsm_foc_I2C_f28379d_Hardware_Init_Variant_Subsystem_Code_Generation_DRV_Enable mcb_pmsm_foc_I2C_f28379d_Hardware_Init_Variant_Subsystem_Code_Generation_Default_ADC_Offset /end SUB_GROUP
 /begin REF_MEASUREMENT mcb_pmsm_foc_I2C_f28379d_B.NOT /end REF_MEASUREMENT
/end GROUP
/begin GROUP mcb_pmsm_foc_I2C_f28379d_Hardware_Init_Variant_Subsystem_Code_Generation_Calculate_ADC_Offset_ "mcb_pmsm_foc_I2C_f28379d/Hardware Init/Variant Subsystem/Code Generation/Calculate ADC Offset\r\n"
 /begin SUB_GROUP mcb_pmsm_foc_I2C_f28379d_Hardware_Init_Variant_Subsystem_Code_Generation_Calculate_ADC_Offset__For_Iterator_Subsystem mcb_pmsm_foc_I2C_f28379d_Hardware_Init_Variant_Subsystem_Code_Generation_Calculate_ADC_Offset__If_Action_Subsystem mcb_pmsm_foc_I2C_f28379d_Hardware_Init_Variant_Subsystem_Code_Generation_Calculate_ADC_Offset__If_Action_Subsystem1 mcb_pmsm_foc_I2C_f28379d_Hardware_Init_Variant_Subsystem_Code_Generation_Calculate_ADC_Offset__If_Action_Subsystem2 mcb_pmsm_foc_I2C_f28379d_Hardware_Init_Variant_Subsystem_Code_Generation_Calculate_ADC_Offset__If_Action_Subsystem3 /end SUB_GROUP
 /begin REF_MEASUREMENT mcb_pmsm_foc_I2C_f28379d_B.Divide mcb_pmsm_foc_I2C_f28379d_B.Divide1 mcb_pmsm_foc_I2C_f28379d_B.Sum1_j mcb_pmsm_foc_I2C_f28379d_B.Sum_hk /end REF_MEASUREMENT
/end GROUP
/begin GROUP mcb_pmsm_foc_I2C_f28379d_Hardware_Init_Variant_Subsystem_Code_Generation_Calculate_ADC_Offset__For_Iterator_Subsystem "mcb_pmsm_foc_I2C_f28379d/Hardware Init/Variant Subsystem/Code Generation/Calculate ADC Offset\r\n/For Iterator\r\nSubsystem"
 /begin SUB_GROUP mcb_pmsm_foc_I2C_f28379d_Hardware_Init_Variant_Subsystem_Code_Generation_Calculate_ADC_Offset__For_Iterator_Subsystem_If_Action_Subsystem /end SUB_GROUP
 /begin REF_MEASUREMENT mcb_pmsm_foc_I2C_f28379d_B.ADC_A_IN0 mcb_pmsm_foc_I2C_f28379d_B.ADC_B_IN0 mcb_pmsm_foc_I2C_f28379d_B.ForIterator /end REF_MEASUREMENT
/end GROUP
/begin GROUP mcb_pmsm_foc_I2C_f28379d_Hardware_Init_Variant_Subsystem_Code_Generation_Calculate_ADC_Offset__For_Iterator_Subsystem_If_Action_Subsystem "mcb_pmsm_foc_I2C_f28379d/Hardware Init/Variant Subsystem/Code Generation/Calculate ADC Offset\r\n/For Iterator\r\nSubsystem/If Action\r\nSubsystem"
 /begin REF_MEASUREMENT mcb_pmsm_foc_I2C_f28379d_B.ADC_A_IN0 mcb_pmsm_foc_I2C_f28379d_B.ADC_B_IN0 mcb_pmsm_foc_I2C_f28379d_B.Memory mcb_pmsm_foc_I2C_f28379d_B.Memory1 mcb_pmsm_foc_I2C_f28379d_B.Sum1_j mcb_pmsm_foc_I2C_f28379d_B.Sum_hk /end REF_MEASUREMENT
/end GROUP
/begin GROUP mcb_pmsm_foc_I2C_f28379d_Hardware_Init_Variant_Subsystem_Code_Generation_Calculate_ADC_Offset__If_Action_Subsystem "mcb_pmsm_foc_I2C_f28379d/Hardware Init/Variant Subsystem/Code Generation/Calculate ADC Offset\r\n/If Action\r\nSubsystem"
 /begin REF_MEASUREMENT mcb_pmsm_foc_I2C_f28379d_B.Divide mcb_pmsm_foc_I2C_f28379d_DW.IaOffset /end REF_MEASUREMENT
/end GROUP
/begin GROUP mcb_pmsm_foc_I2C_f28379d_Hardware_Init_Variant_Subsystem_Code_Generation_Calculate_ADC_Offset__If_Action_Subsystem1 "mcb_pmsm_foc_I2C_f28379d/Hardware Init/Variant Subsystem/Code Generation/Calculate ADC Offset\r\n/If Action\r\nSubsystem1" /begin REF_MEASUREMENT mcb_pmsm_foc_I2C_f28379d_DW.IaOffset /end REF_MEASUREMENT /end GROUP
/begin GROUP mcb_pmsm_foc_I2C_f28379d_Hardware_Init_Variant_Subsystem_Code_Generation_Calculate_ADC_Offset__If_Action_Subsystem2 "mcb_pmsm_foc_I2C_f28379d/Hardware Init/Variant Subsystem/Code Generation/Calculate ADC Offset\r\n/If Action\r\nSubsystem2"
 /begin REF_MEASUREMENT mcb_pmsm_foc_I2C_f28379d_B.Divide1 mcb_pmsm_foc_I2C_f28379d_DW.IbOffset /end REF_MEASUREMENT
/end GROUP
/begin GROUP mcb_pmsm_foc_I2C_f28379d_Hardware_Init_Variant_Subsystem_Code_Generation_Calculate_ADC_Offset__If_Action_Subsystem3 "mcb_pmsm_foc_I2C_f28379d/Hardware Init/Variant Subsystem/Code Generation/Calculate ADC Offset\r\n/If Action\r\nSubsystem3" /begin REF_MEASUREMENT mcb_pmsm_foc_I2C_f28379d_DW.IbOffset /end REF_MEASUREMENT /end GROUP
/begin GROUP mcb_pmsm_foc_I2C_f28379d_Hardware_Init_Variant_Subsystem_Code_Generation_DRV_Enable "mcb_pmsm_foc_I2C_f28379d/Hardware Init/Variant Subsystem/Code Generation/DRV Enable"
 /begin REF_MEASUREMENT mcb_pmsm_foc_I2C_f28379d_B.Switch_c mcb_pmsm_foc_I2C_f28379d_DW.DigitalOutput1_FRAC_LEN mcb_pmsm_foc_I2C_f28379d_DW.DigitalOutput_FRAC_LEN_e /end REF_MEASUREMENT
/end GROUP
/begin GROUP mcb_pmsm_foc_I2C_f28379d_Hardware_Init_Variant_Subsystem_Code_Generation_Default_ADC_Offset "mcb_pmsm_foc_I2C_f28379d/Hardware Init/Variant Subsystem/Code Generation/Default ADC Offset"
 /begin REF_MEASUREMENT mcb_pmsm_foc_I2C_f28379d_DW.IaOffset mcb_pmsm_foc_I2C_f28379d_DW.IbOffset /end REF_MEASUREMENT
/end GROUP
/begin GROUP mcb_pmsm_foc_I2C_f28379d_Heartbeat_LED "mcb_pmsm_foc_I2C_f28379d/Heartbeat LED" /begin SUB_GROUP mcb_pmsm_foc_I2C_f28379d_Heartbeat_LED_Heartbeat_LED /end SUB_GROUP /end GROUP
/begin GROUP mcb_pmsm_foc_I2C_f28379d_Heartbeat_LED_Heartbeat_LED "mcb_pmsm_foc_I2C_f28379d/Heartbeat LED/Heartbeat LED"
 /begin SUB_GROUP mcb_pmsm_foc_I2C_f28379d_Heartbeat_LED_Heartbeat_LED_Code_generation /end SUB_GROUP
/end GROUP
/begin GROUP mcb_pmsm_foc_I2C_f28379d_Heartbeat_LED_Heartbeat_LED_Code_generation "mcb_pmsm_foc_I2C_f28379d/Heartbeat LED/Heartbeat LED/Code generation" /begin REF_MEASUREMENT mcb_pmsm_foc_I2C_f28379d_DW.DigitalOutput_FRAC_LEN /end REF_MEASUREMENT /end GROUP
/begin GROUP mcb_pmsm_foc_I2C_f28379d_Serial_Receive "mcb_pmsm_foc_I2C_f28379d/Serial Receive"
 /begin SUB_GROUP mcb_pmsm_foc_I2C_f28379d_Serial_Receive_Data_Conditioning_Rx mcb_pmsm_foc_I2C_f28379d_Serial_Receive_SCI_Rx mcb_pmsm_foc_I2C_f28379d_Serial_Receive_unParse /end SUB_GROUP
 /begin REF_MEASUREMENT mcb_pmsm_foc_I2C_f28379d_B.DataTypeConversion3 mcb_pmsm_foc_I2C_f28379d_B.SCIReceive mcb_pmsm_foc_I2C_f28379d_B.ShiftArithmetic1 mcb_pmsm_foc_I2C_f28379d_B.ShiftArithmetic2 mcb_pmsm_foc_I2C_f28379d_DW.Control_Mode mcb_pmsm_foc_I2C_f28379d_DW.Debug_signals mcb_pmsm_foc_I2C_f28379d_DW.Enable mcb_pmsm_foc_I2C_f28379d_DW.SpeedRef /end REF_MEASUREMENT
/end GROUP
/begin GROUP mcb_pmsm_foc_I2C_f28379d_Serial_Receive_Data_Conditioning_Rx "mcb_pmsm_foc_I2C_f28379d/Serial Receive/Data_Conditioning_Rx"
 /begin SUB_GROUP mcb_pmsm_foc_I2C_f28379d_Serial_Receive_Data_Conditioning_Rx_Data_Type_Float /end SUB_GROUP
/end GROUP
/begin GROUP mcb_pmsm_foc_I2C_f28379d_Serial_Receive_Data_Conditioning_Rx_Data_Type_Float "mcb_pmsm_foc_I2C_f28379d/Serial Receive/Data_Conditioning_Rx/Data_Type_Float"
 /begin REF_MEASUREMENT mcb_pmsm_foc_I2C_f28379d_B.DataTypeConversion2 mcb_pmsm_foc_I2C_f28379d_B.SCIReceive /end REF_MEASUREMENT
/end GROUP
/begin GROUP mcb_pmsm_foc_I2C_f28379d_Serial_Receive_SCI_Rx "mcb_pmsm_foc_I2C_f28379d/Serial Receive/SCI_Rx"
 /begin SUB_GROUP mcb_pmsm_foc_I2C_f28379d_Serial_Receive_SCI_Rx_Code_Generation /end SUB_GROUP
/end GROUP
/begin GROUP mcb_pmsm_foc_I2C_f28379d_Serial_Receive_SCI_Rx_Code_Generation "mcb_pmsm_foc_I2C_f28379d/Serial Receive/SCI_Rx/Code Generation"
 /begin SUB_GROUP mcb_pmsm_foc_I2C_f28379d_Serial_Receive_SCI_Rx_Code_Generation_Data_Type_Float /end SUB_GROUP
/end GROUP
/begin GROUP mcb_pmsm_foc_I2C_f28379d_Serial_Receive_SCI_Rx_Code_Generation_Data_Type_Float "mcb_pmsm_foc_I2C_f28379d/Serial Receive/SCI_Rx/Code Generation/Data_Type_Float" /begin REF_MEASUREMENT mcb_pmsm_foc_I2C_f28379d_B.SCIReceive /end REF_MEASUREMENT /end GROUP
/begin GROUP mcb_pmsm_foc_I2C_f28379d_Serial_Receive_unParse "mcb_pmsm_foc_I2C_f28379d/Serial Receive/unParse"
 /begin REF_MEASUREMENT mcb_pmsm_foc_I2C_f28379d_B.BitwiseOperator mcb_pmsm_foc_I2C_f28379d_B.BitwiseOperator1 mcb_pmsm_foc_I2C_f28379d_B.BitwiseOperator2 mcb_pmsm_foc_I2C_f28379d_B.DataTypeConversion2 mcb_pmsm_foc_I2C_f28379d_B.DataTypeConversion3 mcb_pmsm_foc_I2C_f28379d_B.ShiftArithmetic1 mcb_pmsm_foc_I2C_f28379d_B.ShiftArithmetic2 /end REF_MEASUREMENT
/end GROUP
/begin GROUP mcb_pmsm_foc_I2C_f28379d_Speed_Control "mcb_pmsm_foc_I2C_f28379d/Speed Control"
 /begin SUB_GROUP mcb_pmsm_foc_I2C_f28379d_Speed_Control_PI_Controller_Speed mcb_pmsm_foc_I2C_f28379d_Speed_Control_Speed_Ref_Selector /end SUB_GROUP
 /begin REF_MEASUREMENT mcb_pmsm_foc_I2C_f28379d_B.RT3 mcb_pmsm_foc_I2C_f28379d_DW.PosRef /end REF_MEASUREMENT
/end GROUP
/begin GROUP mcb_pmsm_foc_I2C_f28379d_Speed_Control_PI_Controller_Speed "mcb_pmsm_foc_I2C_f28379d/Speed Control/PI_Controller_Speed"
 /begin REF_MEASUREMENT mcb_pmsm_foc_I2C_f28379d_B.RT1 mcb_pmsm_foc_I2C_f28379d_DW.Enable /end REF_MEASUREMENT
/end GROUP
/begin GROUP mcb_pmsm_foc_I2C_f28379d_Speed_Control_Speed_Ref_Selector "mcb_pmsm_foc_I2C_f28379d/Speed Control/Speed_Ref_Selector"
 /begin REF_MEASUREMENT mcb_pmsm_foc_I2C_f28379d_B.RT1 mcb_pmsm_foc_I2C_f28379d_B.RT3 mcb_pmsm_foc_I2C_f28379d_DW.Enable /end REF_MEASUREMENT
/end GROUP
/end MODULE
/end PROJECT
/* (add any file trailer comments here) */
/* EOF mcb_pmsm_foc_I2C_f28379d.a2l*/
