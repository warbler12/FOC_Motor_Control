/******************************************************************************
* ASAP2 file: c28x_i2c_sensor.a2l
* Academic License - for use in teaching, academic research, and meeting
* course requirements at degree granting institutions only. Not for
* government, commercial, or other organizational use.
* Code generation for model "c28x_i2c_sensor".
* Model version : 12.3
* Simulink Coder version : 23.2 (R2023b) 01-Aug-2023
* C source code generated on : Fri Nov 07 16:38:11 2025
* Target selection: ert.tlc
* Embedded hardware selection: Texas Instruments->C2000
* Code generation objectives: Unspecified
* Validation result: Not run
* (add additional file header information here)
******************************************************************************/ ASAP2_VERSION 1 31
/* Version 1.31 */
/begin PROJECT ProjectName "Project Comment Goes Here"
/begin HEADER "Header Comments go here" /end HEADER
/begin MODULE ModuleName "Module Comment Goes Here"
/begin IF_DATA XCP
 /begin PROTOCOL_LAYER 0x0100 0x03E8 0x00C8 0x0000 0x0000 0x0000 0x0000 0x0000 0x08 0x0008 BYTE_ORDER_MSB_LAST ADDRESS_GRANULARITY_BYTE OPTIONAL_CMD ALLOC_ODT_ENTRY OPTIONAL_CMD ALLOC_ODT OPTIONAL_CMD ALLOC_DAQ OPTIONAL_CMD FREE_DAQ OPTIONAL_CMD GET_DAQ_RESOLUTION_INFO OPTIONAL_CMD GET_DAQ_PROCESSOR_INFO OPTIONAL_CMD START_STOP_SYNCH OPTIONAL_CMD START_STOP_DAQ_LIST OPTIONAL_CMD SET_DAQ_LIST_MODE OPTIONAL_CMD WRITE_DAQ OPTIONAL_CMD SET_DAQ_PTR OPTIONAL_CMD SHORT_DOWNLOAD OPTIONAL_CMD DOWNLOAD OPTIONAL_CMD SHORT_UPLOAD OPTIONAL_CMD UPLOAD OPTIONAL_CMD SET_MTA /end PROTOCOL_LAYER
 /begin DAQ DYNAMIC 0xFFFF 0x0080 0x00 OPTIMISATION_TYPE_DEFAULT ADDRESS_EXTENSION_FREE IDENTIFICATION_FIELD_TYPE_ABSOLUTE GRANULARITY_ODT_ENTRY_SIZE_DAQ_BYTE 0x07 NO_OVERLOAD_INDICATION /begin TIMESTAMP_SUPPORTED 0x0001 SIZE_DWORD UNIT_1US /end TIMESTAMP_SUPPORTED /begin EVENT "1 ms" "1 ms" 0x0000 DAQ 0xFF 0x01 0x06 0x00 /end EVENT /begin EVENT "15 ms" "15 ms" 0x0001 DAQ 0xFF 0x0F 0x06 0x00 /end EVENT /end DAQ
 /begin XCP_ON_CAN 0x0100 CAN_ID_MASTER 0x00000002 CAN_ID_SLAVE 0x00000003 BAUDRATE 0x000F4240 SAMPLE_RATE SINGLE SJW 0x02 SYNC_EDGE SINGLE /end XCP_ON_CAN
/end IF_DATA
/begin MOD_PAR "MOD PAR Comment Goes Here" /end MOD_PAR
/begin MOD_COMMON "Mod Common Comment Here" BYTE_ORDER MSB_LAST ALIGNMENT_BYTE 1 ALIGNMENT_WORD 2 ALIGNMENT_LONG 4 ALIGNMENT_FLOAT32_IEEE 4 ALIGNMENT_FLOAT64_IEEE 4 /end MOD_COMMON
/begin MEASUREMENT c28x_i2c_sensor_B.CastToSingle "" FLOAT32_IEEE c28x_i2c_sensor_CM_single 0 0 -3.4E+38 3.4E+38 ECU_ADDRESS 0x0001D6AC
 /begin IF_DATA XCP
  /begin DAQ_EVENT VARIABLE /begin DEFAULT_EVENT_LIST EVENT 0x0000 /end DEFAULT_EVENT_LIST /end DAQ_EVENT
 /end IF_DATA
/end MEASUREMENT
/begin MEASUREMENT c28x_i2c_sensor_B.Gain "" FLOAT32_IEEE c28x_i2c_sensor_CM_single 0 0 -3.4E+38 3.4E+38 ECU_ADDRESS 0x0001D6B0
 /begin IF_DATA XCP
  /begin DAQ_EVENT VARIABLE /begin DEFAULT_EVENT_LIST EVENT 0x0000 /end DEFAULT_EVENT_LIST /end DAQ_EVENT
 /end IF_DATA
/end MEASUREMENT
/begin MEASUREMENT c28x_i2c_sensor_B.I2CReceive_o1 "" UBYTE c28x_i2c_sensor_CM_uint8 0 0 0 255 /* Array Size */ ARRAY_SIZE 2 ECU_ADDRESS 0x0001D6C0
 /begin IF_DATA XCP
  /begin DAQ_EVENT VARIABLE /begin DEFAULT_EVENT_LIST EVENT 0x0000 /end DEFAULT_EVENT_LIST /end DAQ_EVENT
 /end IF_DATA
/end MEASUREMENT
/begin MEASUREMENT c28x_i2c_sensor_B.I2CReceive_o2 "" UWORD c28x_i2c_sensor_CM_uint16 0 0 0 65535 ECU_ADDRESS 0x0001D6B8
 /begin IF_DATA XCP
  /begin DAQ_EVENT VARIABLE /begin DEFAULT_EVENT_LIST EVENT 0x0000 /end DEFAULT_EVENT_LIST /end DAQ_EVENT
 /end IF_DATA
/end MEASUREMENT
/begin MEASUREMENT c28x_i2c_sensor_B.I2CTransmit "" UWORD c28x_i2c_sensor_CM_uint16 0 0 0 65535 ECU_ADDRESS 0x0001D6BA
 /begin IF_DATA XCP
  /begin DAQ_EVENT VARIABLE /begin DEFAULT_EVENT_LIST EVENT 0x0000 /end DEFAULT_EVENT_LIST /end DAQ_EVENT
 /end IF_DATA
/end MEASUREMENT
/begin MEASUREMENT c28x_i2c_sensor_B.I2CTransmit1 "" UWORD c28x_i2c_sensor_CM_uint16 0 0 0 65535 ECU_ADDRESS 0x0001D6B4
 /begin IF_DATA XCP
  /begin DAQ_EVENT VARIABLE /begin DEFAULT_EVENT_LIST EVENT 0x0001 /end DEFAULT_EVENT_LIST /end DAQ_EVENT
 /end IF_DATA
/end MEASUREMENT
/begin MEASUREMENT c28x_i2c_sensor_B.LogicalOperator2 "" UBYTE c28x_i2c_sensor_CM_logical 0 0 0 1 ECU_ADDRESS 0x0001D6C8
 /begin IF_DATA XCP
  /begin DAQ_EVENT VARIABLE /begin DEFAULT_EVENT_LIST EVENT 0x0001 /end DEFAULT_EVENT_LIST /end DAQ_EVENT
 /end IF_DATA
/end MEASUREMENT
/begin MEASUREMENT c28x_i2c_sensor_B.RT4 "" UBYTE c28x_i2c_sensor_CM_logical 0 0 0 1 ECU_ADDRESS 0x0001D6C4
 /begin IF_DATA XCP
  /begin DAQ_EVENT VARIABLE /begin DEFAULT_EVENT_LIST EVENT 0x0000 /end DEFAULT_EVENT_LIST /end DAQ_EVENT
 /end IF_DATA
/end MEASUREMENT
/begin MEASUREMENT c28x_i2c_sensor_B.Reshape "" UBYTE c28x_i2c_sensor_CM_uint8 0 0 0 255 /* Array Size */ ARRAY_SIZE 2 ECU_ADDRESS 0x0001D6BC
 /begin IF_DATA XCP
  /begin DAQ_EVENT VARIABLE /begin DEFAULT_EVENT_LIST EVENT 0x0000 /end DEFAULT_EVENT_LIST /end DAQ_EVENT
 /end IF_DATA
/end MEASUREMENT
/begin MEASUREMENT c28x_i2c_sensor_B.UnitDelay "" UBYTE c28x_i2c_sensor_CM_logical 0 0 0 1 ECU_ADDRESS 0x0001D6C6
 /begin IF_DATA XCP
  /begin DAQ_EVENT VARIABLE /begin DEFAULT_EVENT_LIST EVENT 0x0001 /end DEFAULT_EVENT_LIST /end DAQ_EVENT
 /end IF_DATA
/end MEASUREMENT
/begin MEASUREMENT c28x_i2c_sensor_B.raw_angle "" UWORD c28x_i2c_sensor_CM_uint16 0 0 0 65535 ECU_ADDRESS 0x0001D6B6
 /begin IF_DATA XCP
  /begin DAQ_EVENT VARIABLE /begin DEFAULT_EVENT_LIST EVENT 0x0000 /end DEFAULT_EVENT_LIST /end DAQ_EVENT
 /end IF_DATA
/end MEASUREMENT
/begin MEASUREMENT c28x_i2c_sensor_DWork.AddressDataread_SubsysRanBC "" SBYTE c28x_i2c_sensor_CM_int8 0 0 -128 127 ECU_ADDRESS 0x0001D6A0
 /begin IF_DATA XCP
  /begin DAQ_EVENT VARIABLE /begin DEFAULT_EVENT_LIST EVENT 0x0001 /end DEFAULT_EVENT_LIST /end DAQ_EVENT
 /end IF_DATA
/end MEASUREMENT
/begin MEASUREMENT c28x_i2c_sensor_DWork.DataRead_SubsysRanBC "" SBYTE c28x_i2c_sensor_CM_int8 0 0 -128 127 ECU_ADDRESS 0x0001D6A2
 /begin IF_DATA XCP
  /begin DAQ_EVENT VARIABLE /begin DEFAULT_EVENT_LIST EVENT 0x0000 /end DEFAULT_EVENT_LIST /end DAQ_EVENT
 /end IF_DATA
/end MEASUREMENT
/begin MEASUREMENT c28x_i2c_sensor_DWork.Delay1ms.Delay1ms_SubsysRanBC "" SBYTE c28x_i2c_sensor_CM_int8 0 0 -128 127 ECU_ADDRESS 0x0001D6AA
 /begin IF_DATA XCP
  /begin DAQ_EVENT VARIABLE /begin DEFAULT_EVENT_LIST EVENT 0x0001 /end DEFAULT_EVENT_LIST /end DAQ_EVENT
 /end IF_DATA
/end MEASUREMENT
/begin MEASUREMENT c28x_i2c_sensor_DWork.Initialization_SubsysRanBC "" SBYTE c28x_i2c_sensor_CM_int8 0 0 -128 127 ECU_ADDRESS 0x0001D69E
 /begin IF_DATA XCP
  /begin DAQ_EVENT VARIABLE /begin DEFAULT_EVENT_LIST EVENT 0x0001 /end DEFAULT_EVENT_LIST /end DAQ_EVENT
 /end IF_DATA
/end MEASUREMENT
/begin MEASUREMENT c28x_i2c_sensor_DWork.RT4_Buffer0 "" UBYTE c28x_i2c_sensor_CM_logical 0 0 0 1 ECU_ADDRESS 0x0001D6A6
 /begin IF_DATA XCP
  /begin DAQ_EVENT VARIABLE /begin DEFAULT_EVENT_LIST EVENT 0x0000 /end DEFAULT_EVENT_LIST /end DAQ_EVENT
 /end IF_DATA
/end MEASUREMENT
/begin MEASUREMENT c28x_i2c_sensor_DWork.UnitDelay_DSTATE "" UBYTE c28x_i2c_sensor_CM_logical 0 0 0 1 ECU_ADDRESS 0x0001D69C
 /begin IF_DATA XCP
  /begin DAQ_EVENT VARIABLE /begin DEFAULT_EVENT_LIST EVENT 0x0001 /end DEFAULT_EVENT_LIST /end DAQ_EVENT
 /end IF_DATA
/end MEASUREMENT
/begin MEASUREMENT c28x_i2c_sensor_DWork.doneDoubleBufferReInit "" UBYTE c28x_i2c_sensor_CM_logical 0 0 0 1 ECU_ADDRESS 0x0001D6A8
 /begin IF_DATA XCP
  /begin DAQ_EVENT VARIABLE /begin DEFAULT_EVENT_LIST EVENT 0x0000 /end DEFAULT_EVENT_LIST /end DAQ_EVENT
 /end IF_DATA
/end MEASUREMENT
/begin MEASUREMENT c28x_i2c_sensor_DWork.is_active_c2_c28x_i2c_sensor "" UBYTE c28x_i2c_sensor_CM_uint8 0 0 0 255 ECU_ADDRESS 0x0001D6A4
 /begin IF_DATA XCP
  /begin DAQ_EVENT VARIABLE /begin DEFAULT_EVENT_LIST EVENT 0x0000 /end DEFAULT_EVENT_LIST /end DAQ_EVENT
 /end IF_DATA
/end MEASUREMENT
/begin MEASUREMENT c28x_i2c_sensor_DWork.sfEvent "" SLONG c28x_i2c_sensor_CM_int32 0 0 -2147483648 2147483647 ECU_ADDRESS 0x0001D698
 /begin IF_DATA XCP
  /begin DAQ_EVENT VARIABLE /begin DEFAULT_EVENT_LIST EVENT 0x0000 /end DEFAULT_EVENT_LIST /end DAQ_EVENT
 /end IF_DATA
/end MEASUREMENT
/begin COMPU_METHOD c28x_i2c_sensor_CM_int32 "Q = V" RAT_FUNC "%10.0" "" COEFFS 0 1 0 0 0 1 /end COMPU_METHOD
/begin COMPU_METHOD c28x_i2c_sensor_CM_int8 "Q = V" RAT_FUNC "%3.0" "" COEFFS 0 1 0 0 0 1 /end COMPU_METHOD
/begin COMPU_METHOD c28x_i2c_sensor_CM_logical "Q = V" RAT_FUNC "%1.0" "" COEFFS 0 1 0 0 0 1 /end COMPU_METHOD
/begin COMPU_METHOD c28x_i2c_sensor_CM_single "Q = V" RAT_FUNC "%8.6" "" COEFFS 0 1 0 0 0 1 /end COMPU_METHOD
/begin COMPU_METHOD c28x_i2c_sensor_CM_uint16 "Q = V" RAT_FUNC "%5.0" "" COEFFS 0 1 0 0 0 1 /end COMPU_METHOD
/begin COMPU_METHOD c28x_i2c_sensor_CM_uint8 "Q = V" RAT_FUNC "%3.0" "" COEFFS 0 1 0 0 0 1 /end COMPU_METHOD
/begin RECORD_LAYOUT Record_BOOLEAN FNC_VALUES 1 UBYTE COLUMN_DIR DIRECT /end RECORD_LAYOUT
/begin RECORD_LAYOUT Record_FLOAT32_IEEE FNC_VALUES 1 FLOAT32_IEEE COLUMN_DIR DIRECT /end RECORD_LAYOUT
/begin RECORD_LAYOUT Record_SBYTE FNC_VALUES 1 SBYTE COLUMN_DIR DIRECT /end RECORD_LAYOUT
/begin RECORD_LAYOUT Record_SLONG FNC_VALUES 1 SLONG COLUMN_DIR DIRECT /end RECORD_LAYOUT
/begin RECORD_LAYOUT Record_UBYTE FNC_VALUES 1 UBYTE COLUMN_DIR DIRECT /end RECORD_LAYOUT
/begin RECORD_LAYOUT Record_UWORD FNC_VALUES 1 UWORD COLUMN_DIR DIRECT /end RECORD_LAYOUT
/begin GROUP c28x_i2c_sensor "c28x_i2c_sensor" /* Root */ ROOT /begin SUB_GROUP c28x_i2c_sensor_AS5600_Read /end SUB_GROUP /begin REF_MEASUREMENT c28x_i2c_sensor_B.Gain /end REF_MEASUREMENT /end GROUP
/begin GROUP c28x_i2c_sensor_AS5600_Read "c28x_i2c_sensor/AS5600 Read"
 /begin SUB_GROUP c28x_i2c_sensor_AS5600_Read_Data_Read c28x_i2c_sensor_AS5600_Read_Data_Realignment_ c28x_i2c_sensor_AS5600_Read_Initialization /end SUB_GROUP
 /begin REF_MEASUREMENT c28x_i2c_sensor_B.LogicalOperator2 c28x_i2c_sensor_B.RT4 c28x_i2c_sensor_B.UnitDelay c28x_i2c_sensor_DWork.RT4_Buffer0 c28x_i2c_sensor_DWork.UnitDelay_DSTATE /end REF_MEASUREMENT
/end GROUP
/begin GROUP c28x_i2c_sensor_AS5600_Read_Data_Read "c28x_i2c_sensor/AS5600 Read/Data Read"
 /begin REF_MEASUREMENT c28x_i2c_sensor_B.I2CReceive_o1 c28x_i2c_sensor_B.I2CReceive_o2 c28x_i2c_sensor_B.I2CTransmit /end REF_MEASUREMENT
/end GROUP
/begin GROUP c28x_i2c_sensor_AS5600_Read_Data_Realignment_ "c28x_i2c_sensor/AS5600 Read/Data Realignment "
 /begin REF_MEASUREMENT c28x_i2c_sensor_B.CastToSingle c28x_i2c_sensor_B.Gain c28x_i2c_sensor_B.I2CReceive_o1 c28x_i2c_sensor_B.Reshape c28x_i2c_sensor_B.raw_angle c28x_i2c_sensor_DWork.doneDoubleBufferReInit c28x_i2c_sensor_DWork.is_active_c2_c28x_i2c_sensor c28x_i2c_sensor_DWork.sfEvent /end REF_MEASUREMENT
/end GROUP
/begin GROUP c28x_i2c_sensor_AS5600_Read_Initialization "c28x_i2c_sensor/AS5600 Read/Initialization"
 /begin SUB_GROUP c28x_i2c_sensor_AS5600_Read_Initialization_Address___Data_read /end SUB_GROUP
/end GROUP
/begin GROUP c28x_i2c_sensor_AS5600_Read_Initialization_Address___Data_read "c28x_i2c_sensor/AS5600 Read/Initialization/Address - Data read" /begin REF_MEASUREMENT c28x_i2c_sensor_B.I2CTransmit1 /end REF_MEASUREMENT /end GROUP
/end MODULE
/end PROJECT
/* (add any file trailer comments here) */
/* EOF c28x_i2c_sensor.a2l*/
