/******************************************************************************
* ASAP2 file: mcb_pmsm_foc_hall_f28379d.a2l
* Academic License - for use in teaching, academic research, and meeting
* course requirements at degree granting institutions only. Not for
* government, commercial, or other organizational use.
* Code generation for model "mcb_pmsm_foc_hall_f28379d".
* Model version : 28
* Simulink Coder version : 23.2 (R2023b) 01-Aug-2023
* C source code generated on : Thu Nov 06 16:54:28 2025
* Target selection: ert.tlc
* Embedded hardware selection: Texas Instruments->C2000
* Code generation objectives: Unspecified
* Validation result: Not run
* (add additional file header information here)
******************************************************************************/ ASAP2_VERSION 1 31
/* Version 1.31 */
/begin PROJECT ProjectName "Project Comment Goes Here"
/begin HEADER "Header Comments go here" /end HEADER
/begin MODULE ModuleName "Module Comment Goes Here"
/begin IF_DATA XCP
 /begin PROTOCOL_LAYER 0x0100 0x03E8 0x00C8 0x0000 0x0000 0x0000 0x0000 0x0000 0x08 0x0008 BYTE_ORDER_MSB_LAST ADDRESS_GRANULARITY_BYTE OPTIONAL_CMD ALLOC_ODT_ENTRY OPTIONAL_CMD ALLOC_ODT OPTIONAL_CMD ALLOC_DAQ OPTIONAL_CMD FREE_DAQ OPTIONAL_CMD GET_DAQ_RESOLUTION_INFO OPTIONAL_CMD GET_DAQ_PROCESSOR_INFO OPTIONAL_CMD START_STOP_SYNCH OPTIONAL_CMD START_STOP_DAQ_LIST OPTIONAL_CMD SET_DAQ_LIST_MODE OPTIONAL_CMD WRITE_DAQ OPTIONAL_CMD SET_DAQ_PTR OPTIONAL_CMD SHORT_DOWNLOAD OPTIONAL_CMD DOWNLOAD OPTIONAL_CMD SHORT_UPLOAD OPTIONAL_CMD UPLOAD OPTIONAL_CMD SET_MTA /end PROTOCOL_LAYER
 /begin DAQ DYNAMIC 0xFFFF 0x0080 0x00 OPTIMISATION_TYPE_DEFAULT ADDRESS_EXTENSION_FREE IDENTIFICATION_FIELD_TYPE_ABSOLUTE GRANULARITY_ODT_ENTRY_SIZE_DAQ_BYTE 0x07 NO_OVERLOAD_INDICATION /begin TIMESTAMP_SUPPORTED 0x0001 SIZE_DWORD UNIT_1US /end TIMESTAMP_SUPPORTED /begin EVENT "630 us" "630 us" 0x0000 DAQ 0xFF 0x3F 0x04 0x00 /end EVENT /begin EVENT "500 ms" "500 ms" 0x0001 DAQ 0xFF 0x05 0x08 0x00 /end EVENT /begin EVENT "1 s" "1 s" 0x0002 DAQ 0xFF 0x01 0x09 0x00 /end EVENT /end DAQ
 /begin XCP_ON_CAN 0x0100 CAN_ID_MASTER 0x00000002 CAN_ID_SLAVE 0x00000003 BAUDRATE 0x000F4240 SAMPLE_RATE SINGLE SJW 0x02 SYNC_EDGE SINGLE /end XCP_ON_CAN
/end IF_DATA
/begin MOD_PAR "MOD PAR Comment Goes Here" /end MOD_PAR
/begin MOD_COMMON "Mod Common Comment Here" BYTE_ORDER MSB_LAST ALIGNMENT_BYTE 1 ALIGNMENT_WORD 2 ALIGNMENT_LONG 4 ALIGNMENT_FLOAT32_IEEE 4 ALIGNMENT_FLOAT64_IEEE 4 /end MOD_COMMON
/begin MEASUREMENT mcb_pmsm_foc_hall_f28379d_B.ADC_A_IN0 "" UWORD mcb_pmsm_foc_hall_f28379d_CM_uint16 0 0 0 65535 ECU_ADDRESS 0x0001EAAE /end MEASUREMENT
/begin MEASUREMENT mcb_pmsm_foc_hall_f28379d_B.ADC_B_IN0 "" UWORD mcb_pmsm_foc_hall_f28379d_CM_uint16 0 0 0 65535 ECU_ADDRESS 0x0001EAB0 /end MEASUREMENT
/begin MEASUREMENT mcb_pmsm_foc_hall_f28379d_B.ADC_B_IN2 "" UWORD mcb_pmsm_foc_hall_f28379d_CM_uint16 0 0 0 65535 ECU_ADDRESS 0x0001EAEA /end MEASUREMENT
/begin MEASUREMENT mcb_pmsm_foc_hall_f28379d_B.ADC_C_IN2 "" UWORD mcb_pmsm_foc_hall_f28379d_CM_uint16 0 0 0 65535 ECU_ADDRESS 0x0001EAE8 /end MEASUREMENT
/begin MEASUREMENT mcb_pmsm_foc_hall_f28379d_B.AND3 "" UBYTE mcb_pmsm_foc_hall_f28379d_CM_logical 0 0 0 1 ECU_ADDRESS 0x0001EB56 /end MEASUREMENT
/begin MEASUREMENT mcb_pmsm_foc_hall_f28379d_B.AND3_f "" UBYTE mcb_pmsm_foc_hall_f28379d_CM_logical 0 0 0 1 ECU_ADDRESS 0x0001EB60 /end MEASUREMENT
/begin MEASUREMENT mcb_pmsm_foc_hall_f28379d_B.Add "" FLOAT32_IEEE mcb_pmsm_foc_hall_f28379d_CM_single 0 0 -3.4E+38 3.4E+38 ECU_ADDRESS 0x0001E850 /end MEASUREMENT
/begin MEASUREMENT mcb_pmsm_foc_hall_f28379d_B.Add1 "" FLOAT32_IEEE mcb_pmsm_foc_hall_f28379d_CM_single 0 0 -3.4E+38 3.4E+38 ECU_ADDRESS 0x0001E968 /end MEASUREMENT
/begin MEASUREMENT mcb_pmsm_foc_hall_f28379d_B.Add2 "" FLOAT32_IEEE mcb_pmsm_foc_hall_f28379d_CM_single 0 0 -3.4E+38 3.4E+38 ECU_ADDRESS 0x0001E96C /end MEASUREMENT
/begin MEASUREMENT mcb_pmsm_foc_hall_f28379d_B.Add3 "" FLOAT32_IEEE mcb_pmsm_foc_hall_f28379d_CM_single 0 0 -3.4E+38 3.4E+38 ECU_ADDRESS 0x0001E970 /end MEASUREMENT
/begin MEASUREMENT mcb_pmsm_foc_hall_f28379d_B.Add_f "" SLONG mcb_pmsm_foc_hall_f28379d_CM_int32 0 0 -2147483648 2147483647 ARRAY_SIZE 2 ECU_ADDRESS 0x0001EAA0 /end MEASUREMENT
/begin MEASUREMENT mcb_pmsm_foc_hall_f28379d_B.Add_i "" FLOAT32_IEEE mcb_pmsm_foc_hall_f28379d_CM_single 0 0 -3.4E+38 3.4E+38 ECU_ADDRESS 0x0001E960 /end MEASUREMENT
/begin MEASUREMENT mcb_pmsm_foc_hall_f28379d_B.BitwiseOperator "" UWORD mcb_pmsm_foc_hall_f28379d_CM_uint16 0 0 0 65535 ECU_ADDRESS 0x0001EABC /end MEASUREMENT
/begin MEASUREMENT mcb_pmsm_foc_hall_f28379d_B.BitwiseOperator1 "" UWORD mcb_pmsm_foc_hall_f28379d_CM_uint16 0 0 0 65535 ECU_ADDRESS 0x0001EABE /end MEASUREMENT
/begin MEASUREMENT mcb_pmsm_foc_hall_f28379d_B.BitwiseOperator2 "" ULONG mcb_pmsm_foc_hall_f28379d_CM_uint32 0 0 0 4294967295 ECU_ADDRESS 0x0001E720 /end MEASUREMENT
/begin MEASUREMENT mcb_pmsm_foc_hall_f28379d_B.BitwiseOperator2_g "" ULONG mcb_pmsm_foc_hall_f28379d_CM_uint32 0 0 0 4294967295 ECU_ADDRESS 0x0001E7E4 /end MEASUREMENT
/begin MEASUREMENT mcb_pmsm_foc_hall_f28379d_B.BitwiseOperator2_m "" ULONG mcb_pmsm_foc_hall_f28379d_CM_uint32 0 0 0 4294967295 ECU_ADDRESS 0x0001E750 /end MEASUREMENT
/begin MEASUREMENT mcb_pmsm_foc_hall_f28379d_B.BitwiseOperator2_n "" ULONG mcb_pmsm_foc_hall_f28379d_CM_uint32 0 0 0 4294967295 ECU_ADDRESS 0x0001E780 /end MEASUREMENT
/begin MEASUREMENT mcb_pmsm_foc_hall_f28379d_B.BitwiseOperator2_p "" ULONG mcb_pmsm_foc_hall_f28379d_CM_uint32 0 0 0 4294967295 ECU_ADDRESS 0x0001E814 /end MEASUREMENT
/begin MEASUREMENT mcb_pmsm_foc_hall_f28379d_B.Compare "" UBYTE mcb_pmsm_foc_hall_f28379d_CM_uint8 0 0 0 255 ECU_ADDRESS 0x0001EB1A /end MEASUREMENT
/begin MEASUREMENT mcb_pmsm_foc_hall_f28379d_B.Compare_d "" UBYTE mcb_pmsm_foc_hall_f28379d_CM_logical 0 0 0 1 ECU_ADDRESS 0x0001EB44 /end MEASUREMENT
/begin MEASUREMENT mcb_pmsm_foc_hall_f28379d_B.Compare_e "" UBYTE mcb_pmsm_foc_hall_f28379d_CM_logical 0 0 0 1 ECU_ADDRESS 0x0001EB36 /end MEASUREMENT
/begin MEASUREMENT mcb_pmsm_foc_hall_f28379d_B.Compare_h "" UBYTE mcb_pmsm_foc_hall_f28379d_CM_logical 0 0 0 1 ECU_ADDRESS 0x0001EB6E /end MEASUREMENT
/begin MEASUREMENT mcb_pmsm_foc_hall_f28379d_B.Compare_n "" UBYTE mcb_pmsm_foc_hall_f28379d_CM_logical 0 0 0 1 ECU_ADDRESS 0x0001EB42 /end MEASUREMENT
/begin MEASUREMENT mcb_pmsm_foc_hall_f28379d_B.Compare_nf "" UBYTE mcb_pmsm_foc_hall_f28379d_CM_logical 0 0 0 1 ECU_ADDRESS 0x0001EB62 /end MEASUREMENT
/begin MEASUREMENT mcb_pmsm_foc_hall_f28379d_B.Compare_nfz "" UBYTE mcb_pmsm_foc_hall_f28379d_CM_logical 0 0 0 1 ECU_ADDRESS 0x0001EB70 /end MEASUREMENT
/begin MEASUREMENT mcb_pmsm_foc_hall_f28379d_B.DataStoreRead "" ULONG mcb_pmsm_foc_hall_f28379d_CM_uint32 0 0 0 4294967295 ECU_ADDRESS 0x0001E700 /end MEASUREMENT
/begin MEASUREMENT mcb_pmsm_foc_hall_f28379d_B.DataStoreRead1 "" UWORD mcb_pmsm_foc_hall_f28379d_CM_uint16 0 0 0 65535 ECU_ADDRESS 0x0001EAE6 /end MEASUREMENT
/begin MEASUREMENT mcb_pmsm_foc_hall_f28379d_B.DataStoreRead1_b "" UBYTE mcb_pmsm_foc_hall_f28379d_CM_logical 0 0 0 1 ECU_ADDRESS 0x0001EB46 /end MEASUREMENT
/begin MEASUREMENT mcb_pmsm_foc_hall_f28379d_B.DataStoreRead1_g "" UBYTE mcb_pmsm_foc_hall_f28379d_CM_logical 0 0 0 1 ECU_ADDRESS 0x0001EB4A /end MEASUREMENT
/begin MEASUREMENT mcb_pmsm_foc_hall_f28379d_B.DataStoreRead1_k "" SWORD mcb_pmsm_foc_hall_f28379d_CM_int16 0 0 -32768 32767 ECU_ADDRESS 0x0001EB0C /end MEASUREMENT
/begin MEASUREMENT mcb_pmsm_foc_hall_f28379d_B.DataStoreRead1_kl "" SWORD mcb_pmsm_foc_hall_f28379d_CM_int16 0 0 -32768 32767 ECU_ADDRESS 0x0001EB10 /end MEASUREMENT
/begin MEASUREMENT mcb_pmsm_foc_hall_f28379d_B.DataStoreRead1_o "" SWORD mcb_pmsm_foc_hall_f28379d_CM_int16 0 0 -32768 32767 ECU_ADDRESS 0x0001EB14 /end MEASUREMENT
/begin MEASUREMENT mcb_pmsm_foc_hall_f28379d_B.DataStoreRead2 "" ULONG mcb_pmsm_foc_hall_f28379d_CM_uint32 0 0 0 4294967295 ECU_ADDRESS 0x0001E7C4 /end MEASUREMENT
/begin MEASUREMENT mcb_pmsm_foc_hall_f28379d_B.DataStoreRead3 "" SWORD mcb_pmsm_foc_hall_f28379d_CM_int16 0 0 -32768 32767 ECU_ADDRESS 0x0001EB18 /end MEASUREMENT
/begin MEASUREMENT mcb_pmsm_foc_hall_f28379d_B.DataStoreRead4 "" UWORD mcb_pmsm_foc_hall_f28379d_CM_uint16 0 0 0 65535 ECU_ADDRESS 0x0001EB06 /end MEASUREMENT
/begin MEASUREMENT mcb_pmsm_foc_hall_f28379d_B.DataStoreRead5 "" UWORD mcb_pmsm_foc_hall_f28379d_CM_uint16 0 0 0 65535 ECU_ADDRESS 0x0001EB04 /end MEASUREMENT
/begin MEASUREMENT mcb_pmsm_foc_hall_f28379d_B.DataStoreRead_k "" UWORD mcb_pmsm_foc_hall_f28379d_CM_uint16 0 0 0 65535 ECU_ADDRESS 0x0001EAE4 /end MEASUREMENT
/begin MEASUREMENT mcb_pmsm_foc_hall_f28379d_B.DataStoreRead_o "" ULONG mcb_pmsm_foc_hall_f28379d_CM_uint32 0 0 0 4294967295 ECU_ADDRESS 0x0001E730 /end MEASUREMENT
/begin MEASUREMENT mcb_pmsm_foc_hall_f28379d_B.DataStoreRead_p "" ULONG mcb_pmsm_foc_hall_f28379d_CM_uint32 0 0 0 4294967295 ECU_ADDRESS 0x0001E760 /end MEASUREMENT
/begin MEASUREMENT mcb_pmsm_foc_hall_f28379d_B.DataTypeConversion "" FLOAT32_IEEE mcb_pmsm_foc_hall_f28379d_CM_single 0 0 -3.4E+38 3.4E+38 ECU_ADDRESS 0x0001E980 /end MEASUREMENT
/begin MEASUREMENT mcb_pmsm_foc_hall_f28379d_B.DataTypeConversion1 "" FLOAT32_IEEE mcb_pmsm_foc_hall_f28379d_CM_single 0 0 -3.4E+38 3.4E+38 ECU_ADDRESS 0x0001E890 /end MEASUREMENT
/begin MEASUREMENT mcb_pmsm_foc_hall_f28379d_B.DataTypeConversion1_d "" UWORD mcb_pmsm_foc_hall_f28379d_CM_uint16 0 0 0 65535 ECU_ADDRESS 0x0001EAD2 /end MEASUREMENT
/begin MEASUREMENT mcb_pmsm_foc_hall_f28379d_B.DataTypeConversion1_f "" FLOAT32_IEEE mcb_pmsm_foc_hall_f28379d_CM_single 0 0 -3.4E+38 3.4E+38 ECU_ADDRESS 0x0001E918 /end MEASUREMENT
/begin MEASUREMENT mcb_pmsm_foc_hall_f28379d_B.DataTypeConversion1_n "" UWORD mcb_pmsm_foc_hall_f28379d_CM_uint16 0 0 0 65535 ECU_ADDRESS 0x0001EACA /end MEASUREMENT
/begin MEASUREMENT mcb_pmsm_foc_hall_f28379d_B.DataTypeConversion1_o "" UWORD mcb_pmsm_foc_hall_f28379d_CM_uint16 0 0 0 65535 ECU_ADDRESS 0x0001EAC2 /end MEASUREMENT
/begin MEASUREMENT mcb_pmsm_foc_hall_f28379d_B.DataTypeConversion2 "" UWORD mcb_pmsm_foc_hall_f28379d_CM_uint16 0 0 0 65535 ECU_ADDRESS 0x0001EABA /end MEASUREMENT
/begin MEASUREMENT mcb_pmsm_foc_hall_f28379d_B.DataTypeConversion2_c "" UWORD mcb_pmsm_foc_hall_f28379d_CM_uint16 0 0 0 65535 ECU_ADDRESS 0x0001EAD4 /end MEASUREMENT
/begin MEASUREMENT mcb_pmsm_foc_hall_f28379d_B.DataTypeConversion2_g "" UWORD mcb_pmsm_foc_hall_f28379d_CM_uint16 0 0 0 65535 ECU_ADDRESS 0x0001EACC /end MEASUREMENT
/begin MEASUREMENT mcb_pmsm_foc_hall_f28379d_B.DataTypeConversion2_p "" UWORD mcb_pmsm_foc_hall_f28379d_CM_uint16 0 0 0 65535 ECU_ADDRESS 0x0001EAC4 /end MEASUREMENT
/begin MEASUREMENT mcb_pmsm_foc_hall_f28379d_B.DataTypeConversion3 "" UBYTE mcb_pmsm_foc_hall_f28379d_CM_logical 0 0 0 1 ECU_ADDRESS 0x0001EB28 /end MEASUREMENT
/begin MEASUREMENT mcb_pmsm_foc_hall_f28379d_B.DataTypeConversion4 "" UBYTE mcb_pmsm_foc_hall_f28379d_CM_logical 0 0 0 1 ECU_ADDRESS 0x0001EB38 /end MEASUREMENT
/begin MEASUREMENT mcb_pmsm_foc_hall_f28379d_B.DataTypeConversion_e "" UWORD mcb_pmsm_foc_hall_f28379d_CM_uint16 0 0 0 65535 ECU_ADDRESS 0x0001EAF2 /end MEASUREMENT
/begin MEASUREMENT mcb_pmsm_foc_hall_f28379d_B.DataTypeConversion_f "" SLONG mcb_pmsm_foc_hall_f28379d_CM_int32 0 0 -2147483648 2147483647 ARRAY_SIZE 2 ECU_ADDRESS 0x0001EA98 /end MEASUREMENT
/begin MEASUREMENT mcb_pmsm_foc_hall_f28379d_B.DataTypeConversion_j "" UWORD mcb_pmsm_foc_hall_f28379d_CM_uint16 0 0 0 65535 ECU_ADDRESS 0x0001EACE /end MEASUREMENT
/begin MEASUREMENT mcb_pmsm_foc_hall_f28379d_B.DataTypeConversion_jg "" UWORD mcb_pmsm_foc_hall_f28379d_CM_uint16 0 0 0 65535 ECU_ADDRESS 0x0001EB08 /end MEASUREMENT
/begin MEASUREMENT mcb_pmsm_foc_hall_f28379d_B.DataTypeConversion_m "" UWORD mcb_pmsm_foc_hall_f28379d_CM_uint16 0 0 0 65535 ECU_ADDRESS 0x0001EAEC /end MEASUREMENT
/begin MEASUREMENT mcb_pmsm_foc_hall_f28379d_B.DataTypeConversion_n "" UWORD mcb_pmsm_foc_hall_f28379d_CM_uint16 0 0 0 65535 ECU_ADDRESS 0x0001EAC6 /end MEASUREMENT
/begin MEASUREMENT mcb_pmsm_foc_hall_f28379d_B.DataTypeConversion_nh "" UBYTE mcb_pmsm_foc_hall_f28379d_CM_logical 0 0 0 1 ECU_ADDRESS 0x0001EB3A /end MEASUREMENT
/begin MEASUREMENT mcb_pmsm_foc_hall_f28379d_B.DataTypeConversion_nl "" UWORD mcb_pmsm_foc_hall_f28379d_CM_uint16 0 0 0 65535 ECU_ADDRESS 0x0001EB0A /end MEASUREMENT
/begin MEASUREMENT mcb_pmsm_foc_hall_f28379d_B.DataTypeConversion_p "" UWORD mcb_pmsm_foc_hall_f28379d_CM_uint16 0 0 0 65535 ECU_ADDRESS 0x0001EAD6 /end MEASUREMENT
/begin MEASUREMENT mcb_pmsm_foc_hall_f28379d_B.DeadZone "" FLOAT32_IEEE mcb_pmsm_foc_hall_f28379d_CM_single 0 0 -3.4E+38 3.4E+38 ECU_ADDRESS 0x0001E8F8 /end MEASUREMENT
/begin MEASUREMENT mcb_pmsm_foc_hall_f28379d_B.DeadZone_g "" FLOAT32_IEEE mcb_pmsm_foc_hall_f28379d_CM_single 0 0 -3.4E+38 3.4E+38 ECU_ADDRESS 0x0001E904 /end MEASUREMENT
/begin MEASUREMENT mcb_pmsm_foc_hall_f28379d_B.DelayOneStep "" UWORD mcb_pmsm_foc_hall_f28379d_CM_uint16 0 0 0 65535 ECU_ADDRESS 0x0001EADE /end MEASUREMENT
/begin MEASUREMENT mcb_pmsm_foc_hall_f28379d_B.DelayOneStep1 "" UBYTE mcb_pmsm_foc_hall_f28379d_CM_logical 0 0 0 1 ECU_ADDRESS 0x0001EB3E /end MEASUREMENT
/begin MEASUREMENT mcb_pmsm_foc_hall_f28379d_B.Divide "" FLOAT32_IEEE mcb_pmsm_foc_hall_f28379d_CM_single 0 0 -3.4E+38 3.4E+38 ECU_ADDRESS 0x0001E9A8 /end MEASUREMENT
/begin MEASUREMENT mcb_pmsm_foc_hall_f28379d_B.Divide1 "" FLOAT32_IEEE mcb_pmsm_foc_hall_f28379d_CM_single 0 0 -3.4E+38 3.4E+38 ECU_ADDRESS 0x0001E9D8 /end MEASUREMENT
/begin MEASUREMENT mcb_pmsm_foc_hall_f28379d_B.Divide1_e "" UWORD mcb_pmsm_foc_hall_f28379d_CM_uint16 0 0 0 65535 ECU_ADDRESS 0x0001EAAA /end MEASUREMENT
/begin MEASUREMENT mcb_pmsm_foc_hall_f28379d_B.Divide_f "" FLOAT32_IEEE mcb_pmsm_foc_hall_f28379d_CM_single 0 0 -3.4E+38 3.4E+38 ECU_ADDRESS 0x0001E9C4 /end MEASUREMENT
/begin MEASUREMENT mcb_pmsm_foc_hall_f28379d_B.Divide_i "" FLOAT32_IEEE mcb_pmsm_foc_hall_f28379d_CM_single 0 0 -3.4E+38 3.4E+38 ECU_ADDRESS 0x0001E9D0 /end MEASUREMENT
/begin MEASUREMENT mcb_pmsm_foc_hall_f28379d_B.Divide_ir "" UWORD mcb_pmsm_foc_hall_f28379d_CM_uint16 0 0 0 65535 ECU_ADDRESS 0x0001EAA8 /end MEASUREMENT
/begin MEASUREMENT mcb_pmsm_foc_hall_f28379d_B.Enable "" UBYTE mcb_pmsm_foc_hall_f28379d_CM_logical 0 0 0 1 ECU_ADDRESS 0x0001EB64 /end MEASUREMENT
/begin MEASUREMENT mcb_pmsm_foc_hall_f28379d_B.Equal1 "" UBYTE mcb_pmsm_foc_hall_f28379d_CM_logical 0 0 0 1 ECU_ADDRESS 0x0001EB54 /end MEASUREMENT
/begin MEASUREMENT mcb_pmsm_foc_hall_f28379d_B.Equal1_d "" UBYTE mcb_pmsm_foc_hall_f28379d_CM_logical 0 0 0 1 ECU_ADDRESS 0x0001EB5E /end MEASUREMENT
/begin MEASUREMENT mcb_pmsm_foc_hall_f28379d_B.Floor "" FLOAT32_IEEE mcb_pmsm_foc_hall_f28379d_CM_single 0 0 -3.4E+38 3.4E+38 ECU_ADDRESS 0x0001E84C /end MEASUREMENT
/begin MEASUREMENT mcb_pmsm_foc_hall_f28379d_B.ForIterator "" UWORD mcb_pmsm_foc_hall_f28379d_CM_uint16 0 0 0 65535 ECU_ADDRESS 0x0001EAAC /end MEASUREMENT
/begin MEASUREMENT mcb_pmsm_foc_hall_f28379d_B.Gain "" FLOAT32_IEEE mcb_pmsm_foc_hall_f28379d_CM_single 0 0 -3.4E+38 3.4E+38 ARRAY_SIZE 3 ECU_ADDRESS 0x0001E974 /end MEASUREMENT
/begin MEASUREMENT mcb_pmsm_foc_hall_f28379d_B.Gain1 "" FLOAT32_IEEE mcb_pmsm_foc_hall_f28379d_CM_single 0 0 -3.4E+38 3.4E+38 ECU_ADDRESS 0x0001E9E0 /end MEASUREMENT
/begin MEASUREMENT mcb_pmsm_foc_hall_f28379d_B.Gain_c "" FLOAT32_IEEE mcb_pmsm_foc_hall_f28379d_CM_single 0 0 -3.4E+38 3.4E+38 ECU_ADDRESS 0x0001EA84 /end MEASUREMENT
/begin MEASUREMENT mcb_pmsm_foc_hall_f28379d_B.Gain_e "" FLOAT32_IEEE mcb_pmsm_foc_hall_f28379d_CM_single 0 0 -3.4E+38 3.4E+38 ECU_ADDRESS 0x0001EA74 /end MEASUREMENT
/begin MEASUREMENT mcb_pmsm_foc_hall_f28379d_B.Gain_m "" FLOAT32_IEEE mcb_pmsm_foc_hall_f28379d_CM_single 0 0 -3.4E+38 3.4E+38 ARRAY_SIZE 3 ECU_ADDRESS 0x0001E988 /end MEASUREMENT
/begin MEASUREMENT mcb_pmsm_foc_hall_f28379d_B.GetADCVoltage "" FLOAT32_IEEE mcb_pmsm_foc_hall_f28379d_CM_single 0 0 -3.4E+38 3.4E+38 ARRAY_SIZE 2 ECU_ADDRESS 0x0001E854 /end MEASUREMENT
/begin MEASUREMENT mcb_pmsm_foc_hall_f28379d_B.GetCurrents "" FLOAT32_IEEE mcb_pmsm_foc_hall_f28379d_CM_single 0 0 -3.4E+38 3.4E+38 ARRAY_SIZE 2 ECU_ADDRESS 0x0001E85C /end MEASUREMENT
/begin MEASUREMENT mcb_pmsm_foc_hall_f28379d_B.Get_Integer "" UWORD mcb_pmsm_foc_hall_f28379d_CM_uint16 0 0 0 65535 ECU_ADDRESS 0x0001EAEE /end MEASUREMENT
/begin MEASUREMENT mcb_pmsm_foc_hall_f28379d_B.Get_Integer_f "" UWORD mcb_pmsm_foc_hall_f28379d_CM_uint16 0 0 0 65535 ECU_ADDRESS 0x0001EAF4 /end MEASUREMENT
/begin MEASUREMENT mcb_pmsm_foc_hall_f28379d_B.Hall_A "" ULONG mcb_pmsm_foc_hall_f28379d_CM_uint32 0 0 0 4294967295 ECU_ADDRESS 0x0001E718 /end MEASUREMENT
/begin MEASUREMENT mcb_pmsm_foc_hall_f28379d_B.Hall_A_c "" ULONG mcb_pmsm_foc_hall_f28379d_CM_uint32 0 0 0 4294967295 ECU_ADDRESS 0x0001E80C /end MEASUREMENT
/begin MEASUREMENT mcb_pmsm_foc_hall_f28379d_B.Hall_A_d "" ULONG mcb_pmsm_foc_hall_f28379d_CM_uint32 0 0 0 4294967295 ECU_ADDRESS 0x0001E7DC /end MEASUREMENT
/begin MEASUREMENT mcb_pmsm_foc_hall_f28379d_B.Hall_A_e "" ULONG mcb_pmsm_foc_hall_f28379d_CM_uint32 0 0 0 4294967295 ECU_ADDRESS 0x0001E748 /end MEASUREMENT
/begin MEASUREMENT mcb_pmsm_foc_hall_f28379d_B.Hall_A_k "" ULONG mcb_pmsm_foc_hall_f28379d_CM_uint32 0 0 0 4294967295 ECU_ADDRESS 0x0001E778 /end MEASUREMENT
/begin MEASUREMENT mcb_pmsm_foc_hall_f28379d_B.Hall_B "" ULONG mcb_pmsm_foc_hall_f28379d_CM_uint32 0 0 0 4294967295 ECU_ADDRESS 0x0001E710 /end MEASUREMENT
/begin MEASUREMENT mcb_pmsm_foc_hall_f28379d_B.Hall_B_e "" ULONG mcb_pmsm_foc_hall_f28379d_CM_uint32 0 0 0 4294967295 ECU_ADDRESS 0x0001E7D4 /end MEASUREMENT
/begin MEASUREMENT mcb_pmsm_foc_hall_f28379d_B.Hall_B_f "" ULONG mcb_pmsm_foc_hall_f28379d_CM_uint32 0 0 0 4294967295 ECU_ADDRESS 0x0001E804 /end MEASUREMENT
/begin MEASUREMENT mcb_pmsm_foc_hall_f28379d_B.Hall_B_i "" ULONG mcb_pmsm_foc_hall_f28379d_CM_uint32 0 0 0 4294967295 ECU_ADDRESS 0x0001E770 /end MEASUREMENT
/begin MEASUREMENT mcb_pmsm_foc_hall_f28379d_B.Hall_B_m "" ULONG mcb_pmsm_foc_hall_f28379d_CM_uint32 0 0 0 4294967295 ECU_ADDRESS 0x0001E740 /end MEASUREMENT
/begin MEASUREMENT mcb_pmsm_foc_hall_f28379d_B.Hall_C "" ULONG mcb_pmsm_foc_hall_f28379d_CM_uint32 0 0 0 4294967295 ECU_ADDRESS 0x0001E708 /end MEASUREMENT
/begin MEASUREMENT mcb_pmsm_foc_hall_f28379d_B.Hall_C_e "" ULONG mcb_pmsm_foc_hall_f28379d_CM_uint32 0 0 0 4294967295 ECU_ADDRESS 0x0001E7CC /end MEASUREMENT
/begin MEASUREMENT mcb_pmsm_foc_hall_f28379d_B.Hall_C_f "" ULONG mcb_pmsm_foc_hall_f28379d_CM_uint32 0 0 0 4294967295 ECU_ADDRESS 0x0001E738 /end MEASUREMENT
/begin MEASUREMENT mcb_pmsm_foc_hall_f28379d_B.Hall_C_fc "" ULONG mcb_pmsm_foc_hall_f28379d_CM_uint32 0 0 0 4294967295 ECU_ADDRESS 0x0001E7FC /end MEASUREMENT
/begin MEASUREMENT mcb_pmsm_foc_hall_f28379d_B.Hall_C_n "" ULONG mcb_pmsm_foc_hall_f28379d_CM_uint32 0 0 0 4294967295 ECU_ADDRESS 0x0001E768 /end MEASUREMENT
/begin MEASUREMENT mcb_pmsm_foc_hall_f28379d_B.IProdOut "" FLOAT32_IEEE mcb_pmsm_foc_hall_f28379d_CM_single 0 0 -3.4E+38 3.4E+38 ECU_ADDRESS 0x0001E8FC /end MEASUREMENT
/begin MEASUREMENT mcb_pmsm_foc_hall_f28379d_B.IProdOut_h "" FLOAT32_IEEE mcb_pmsm_foc_hall_f28379d_CM_single 0 0 -3.4E+38 3.4E+38 ECU_ADDRESS 0x0001E908 /end MEASUREMENT
/begin MEASUREMENT mcb_pmsm_foc_hall_f28379d_B.IfActionSubsystem.Convert_back "" FLOAT32_IEEE mcb_pmsm_foc_hall_f28379d_CM_single 0 0 -3.4E+38 3.4E+38 ECU_ADDRESS 0x0001EC04 /end MEASUREMENT
/begin MEASUREMENT mcb_pmsm_foc_hall_f28379d_B.IfActionSubsystem.Convert_uint16 "" SWORD mcb_pmsm_foc_hall_f28379d_CM_int16 0 0 -32768 32767 ECU_ADDRESS 0x0001EC08 /end MEASUREMENT
/begin MEASUREMENT mcb_pmsm_foc_hall_f28379d_B.IfActionSubsystem1.Convert_back "" FLOAT32_IEEE mcb_pmsm_foc_hall_f28379d_CM_single 0 0 -3.4E+38 3.4E+38 ECU_ADDRESS 0x0001EBFC /end MEASUREMENT
/begin MEASUREMENT mcb_pmsm_foc_hall_f28379d_B.IfActionSubsystem1.Convert_uint16 "" SWORD mcb_pmsm_foc_hall_f28379d_CM_int16 0 0 -32768 32767 ECU_ADDRESS 0x0001EC00 /end MEASUREMENT
/begin MEASUREMENT mcb_pmsm_foc_hall_f28379d_B.IfActionSubsystem1_i.Convert_back "" FLOAT32_IEEE mcb_pmsm_foc_hall_f28379d_CM_single 0 0 -3.4E+38 3.4E+38 ECU_ADDRESS 0x0001EBEC /end MEASUREMENT
/begin MEASUREMENT mcb_pmsm_foc_hall_f28379d_B.IfActionSubsystem1_i.Convert_uint16 "" SWORD mcb_pmsm_foc_hall_f28379d_CM_int16 0 0 -32768 32767 ECU_ADDRESS 0x0001EBF0 /end MEASUREMENT
/begin MEASUREMENT mcb_pmsm_foc_hall_f28379d_B.IfActionSubsystem_n.Convert_back "" FLOAT32_IEEE mcb_pmsm_foc_hall_f28379d_CM_single 0 0 -3.4E+38 3.4E+38 ECU_ADDRESS 0x0001EBF4 /end MEASUREMENT
/begin MEASUREMENT mcb_pmsm_foc_hall_f28379d_B.IfActionSubsystem_n.Convert_uint16 "" SWORD mcb_pmsm_foc_hall_f28379d_CM_int16 0 0 -32768 32767 ECU_ADDRESS 0x0001EBF8 /end MEASUREMENT
/begin MEASUREMENT mcb_pmsm_foc_hall_f28379d_B.Input "" ULONG mcb_pmsm_foc_hall_f28379d_CM_uint32 0 0 0 4294967295 ECU_ADDRESS 0x0001E7B4 /end MEASUREMENT
/begin MEASUREMENT mcb_pmsm_foc_hall_f28379d_B.Integrator "" FLOAT32_IEEE mcb_pmsm_foc_hall_f28379d_CM_single 0 0 -3.4E+38 3.4E+38 ECU_ADDRESS 0x0001E8B8 /end MEASUREMENT
/begin MEASUREMENT mcb_pmsm_foc_hall_f28379d_B.Integrator_o "" FLOAT32_IEEE mcb_pmsm_foc_hall_f28379d_CM_single 0 0 -3.4E+38 3.4E+38 ECU_ADDRESS 0x0001E8D0 /end MEASUREMENT
/begin MEASUREMENT mcb_pmsm_foc_hall_f28379d_B.InvertingNoninvertingCurrentmea "" FLOAT32_IEEE mcb_pmsm_foc_hall_f28379d_CM_single 0 0 -3.4E+38 3.4E+38 ARRAY_SIZE 2 ECU_ADDRESS 0x0001E86C /end MEASUREMENT
/begin MEASUREMENT mcb_pmsm_foc_hall_f28379d_B.Ki1 "" FLOAT32_IEEE mcb_pmsm_foc_hall_f28379d_CM_single 0 0 -3.4E+38 3.4E+38 ECU_ADDRESS 0x0001E8CC /end MEASUREMENT
/begin MEASUREMENT mcb_pmsm_foc_hall_f28379d_B.Kp1 "" FLOAT32_IEEE mcb_pmsm_foc_hall_f28379d_CM_single 0 0 -3.4E+38 3.4E+38 ECU_ADDRESS 0x0001E8B4 /end MEASUREMENT
/begin MEASUREMENT mcb_pmsm_foc_hall_f28379d_B.LogicalOperator "" UBYTE mcb_pmsm_foc_hall_f28379d_CM_logical 0 0 0 1 ECU_ADDRESS 0x0001EB48 /end MEASUREMENT
/begin MEASUREMENT mcb_pmsm_foc_hall_f28379d_B.LogicalOperator_a "" UBYTE mcb_pmsm_foc_hall_f28379d_CM_logical 0 0 0 1 ECU_ADDRESS 0x0001EB66 /end MEASUREMENT
/begin MEASUREMENT mcb_pmsm_foc_hall_f28379d_B.LogicalOperator_j "" UBYTE mcb_pmsm_foc_hall_f28379d_CM_logical 0 0 0 1 ECU_ADDRESS 0x0001EB4C /end MEASUREMENT
/begin MEASUREMENT mcb_pmsm_foc_hall_f28379d_B.Lookup "" FLOAT32_IEEE mcb_pmsm_foc_hall_f28379d_CM_single 0 0 -3.4E+38 3.4E+38 ARRAY_SIZE 4 ECU_ADDRESS 0x0001E87C /end MEASUREMENT
/begin MEASUREMENT mcb_pmsm_foc_hall_f28379d_B.Lookup_f "" FLOAT32_IEEE mcb_pmsm_foc_hall_f28379d_CM_single 0 0 -3.4E+38 3.4E+38 ARRAY_SIZE 4 ECU_ADDRESS 0x0001E91C /end MEASUREMENT
/begin MEASUREMENT mcb_pmsm_foc_hall_f28379d_B.LowerRelop1 "" UBYTE mcb_pmsm_foc_hall_f28379d_CM_logical 0 0 0 1 ECU_ADDRESS 0x0001EB72 /end MEASUREMENT
/begin MEASUREMENT mcb_pmsm_foc_hall_f28379d_B.Max "" ULONG mcb_pmsm_foc_hall_f28379d_CM_uint32 0 0 0 4294967295 ECU_ADDRESS 0x0001E7B8 /end MEASUREMENT
/begin MEASUREMENT mcb_pmsm_foc_hall_f28379d_B.Max_h "" FLOAT32_IEEE mcb_pmsm_foc_hall_f28379d_CM_single 0 0 -3.4E+38 3.4E+38 ECU_ADDRESS 0x0001E958 /end MEASUREMENT
/begin MEASUREMENT mcb_pmsm_foc_hall_f28379d_B.Memory "" UWORD mcb_pmsm_foc_hall_f28379d_CM_uint16 0 0 0 65535 ECU_ADDRESS 0x0001EAB2 /end MEASUREMENT
/begin MEASUREMENT mcb_pmsm_foc_hall_f28379d_B.Memory1 "" UWORD mcb_pmsm_foc_hall_f28379d_CM_uint16 0 0 0 65535 ECU_ADDRESS 0x0001EAB6 /end MEASUREMENT
/begin MEASUREMENT mcb_pmsm_foc_hall_f28379d_B.MemoryCopy "" ULONG mcb_pmsm_foc_hall_f28379d_CM_uint32 0 0 0 4294967295 ECU_ADDRESS 0x0001E7E8 /end MEASUREMENT
/begin MEASUREMENT mcb_pmsm_foc_hall_f28379d_B.MemoryCopy1 "" ULONG mcb_pmsm_foc_hall_f28379d_CM_uint32 0 0 0 4294967295 ECU_ADDRESS 0x0001E7EC /end MEASUREMENT
/begin MEASUREMENT mcb_pmsm_foc_hall_f28379d_B.MemoryCopy2 "" ULONG mcb_pmsm_foc_hall_f28379d_CM_uint32 0 0 0 4294967295 ECU_ADDRESS 0x0001E7F0 /end MEASUREMENT
/begin MEASUREMENT mcb_pmsm_foc_hall_f28379d_B.Merge "" ULONG mcb_pmsm_foc_hall_f28379d_CM_uint32 0 0 0 4294967295 ECU_ADDRESS 0x0001E7C0 /end MEASUREMENT
/begin MEASUREMENT mcb_pmsm_foc_hall_f28379d_B.Merge1 "" FLOAT32_IEEE mcb_pmsm_foc_hall_f28379d_CM_single 0 0 -3.4E+38 3.4E+38 ECU_ADDRESS 0x0001E840 /end MEASUREMENT
/begin MEASUREMENT mcb_pmsm_foc_hall_f28379d_B.Merge1_a "" SWORD mcb_pmsm_foc_hall_f28379d_CM_int16 0 0 -32768 32767 ECU_ADDRESS 0x0001EB12 /end MEASUREMENT
/begin MEASUREMENT mcb_pmsm_foc_hall_f28379d_B.Merge1_d "" FLOAT32_IEEE mcb_pmsm_foc_hall_f28379d_CM_single 0 0 -3.4E+38 3.4E+38 ECU_ADDRESS 0x0001E9F0 /end MEASUREMENT
/begin MEASUREMENT mcb_pmsm_foc_hall_f28379d_B.Merge1_k "" SWORD mcb_pmsm_foc_hall_f28379d_CM_int16 0 0 -32768 32767 ECU_ADDRESS 0x0001EB0E /end MEASUREMENT
/begin MEASUREMENT mcb_pmsm_foc_hall_f28379d_B.Merge1_kl "" SWORD mcb_pmsm_foc_hall_f28379d_CM_int16 0 0 -32768 32767 ECU_ADDRESS 0x0001EB16 /end MEASUREMENT
/begin MEASUREMENT mcb_pmsm_foc_hall_f28379d_B.Merge1_l "" FLOAT32_IEEE mcb_pmsm_foc_hall_f28379d_CM_single 0 0 -3.4E+38 3.4E+38 ECU_ADDRESS 0x0001E9B0 /end MEASUREMENT
/begin MEASUREMENT mcb_pmsm_foc_hall_f28379d_B.Merge1_la "" FLOAT32_IEEE mcb_pmsm_foc_hall_f28379d_CM_single 0 0 -3.4E+38 3.4E+38 ECU_ADDRESS 0x0001E9EC /end MEASUREMENT
/begin MEASUREMENT mcb_pmsm_foc_hall_f28379d_B.Merge3 "" UBYTE mcb_pmsm_foc_hall_f28379d_CM_logical 0 0 0 1 ECU_ADDRESS 0x0001EB2A /end MEASUREMENT
/begin MEASUREMENT mcb_pmsm_foc_hall_f28379d_B.Merge3_m "" UBYTE mcb_pmsm_foc_hall_f28379d_CM_logical 0 0 0 1 ECU_ADDRESS 0x0001EB32 /end MEASUREMENT
/begin MEASUREMENT mcb_pmsm_foc_hall_f28379d_B.Merge3_o "" UBYTE mcb_pmsm_foc_hall_f28379d_CM_logical 0 0 0 1 ECU_ADDRESS 0x0001EB2E /end MEASUREMENT
/begin MEASUREMENT mcb_pmsm_foc_hall_f28379d_B.Merge_c "" FLOAT32_IEEE mcb_pmsm_foc_hall_f28379d_CM_single 0 0 -3.4E+38 3.4E+38 ECU_ADDRESS 0x0001E9B8 /end MEASUREMENT
/begin MEASUREMENT mcb_pmsm_foc_hall_f28379d_B.Merge_d "" FLOAT32_IEEE mcb_pmsm_foc_hall_f28379d_CM_single 0 0 -3.4E+38 3.4E+38 ECU_ADDRESS 0x0001E83C /end MEASUREMENT
/begin MEASUREMENT mcb_pmsm_foc_hall_f28379d_B.Merge_do "" FLOAT32_IEEE mcb_pmsm_foc_hall_f28379d_CM_single 0 0 -3.4E+38 3.4E+38 ARRAY_SIZE 2 ECU_ADDRESS 0x0001E8F0 /end MEASUREMENT
/begin MEASUREMENT mcb_pmsm_foc_hall_f28379d_B.Merge_f "" UBYTE mcb_pmsm_foc_hall_f28379d_CM_logical 0 0 0 1 ECU_ADDRESS 0x0001EB30 /end MEASUREMENT
/begin MEASUREMENT mcb_pmsm_foc_hall_f28379d_B.Merge_j "" UWORD mcb_pmsm_foc_hall_f28379d_CM_uint16 0 0 0 65535 ECU_ADDRESS 0x0001EAD0 /end MEASUREMENT
/begin MEASUREMENT mcb_pmsm_foc_hall_f28379d_B.Merge_k "" UWORD mcb_pmsm_foc_hall_f28379d_CM_uint16 0 0 0 65535 ECU_ADDRESS 0x0001EAD8 /end MEASUREMENT
/begin MEASUREMENT mcb_pmsm_foc_hall_f28379d_B.Merge_m "" FLOAT32_IEEE mcb_pmsm_foc_hall_f28379d_CM_single 0 0 -3.4E+38 3.4E+38 ECU_ADDRESS 0x0001E848 /end MEASUREMENT
/begin MEASUREMENT mcb_pmsm_foc_hall_f28379d_B.Merge_me "" FLOAT32_IEEE mcb_pmsm_foc_hall_f28379d_CM_single 0 0 -3.4E+38 3.4E+38 ECU_ADDRESS 0x0001EA70 /end MEASUREMENT
/begin MEASUREMENT mcb_pmsm_foc_hall_f28379d_B.Merge_mm "" FLOAT32_IEEE mcb_pmsm_foc_hall_f28379d_CM_single 0 0 -3.4E+38 3.4E+38 ECU_ADDRESS 0x0001E874 /end MEASUREMENT
/begin MEASUREMENT mcb_pmsm_foc_hall_f28379d_B.Merge_n "" UBYTE mcb_pmsm_foc_hall_f28379d_CM_logical 0 0 0 1 ECU_ADDRESS 0x0001EB34 /end MEASUREMENT
/begin MEASUREMENT mcb_pmsm_foc_hall_f28379d_B.Merge_p "" FLOAT32_IEEE mcb_pmsm_foc_hall_f28379d_CM_single 0 0 -3.4E+38 3.4E+38 ECU_ADDRESS 0x0001E910 /end MEASUREMENT
/begin MEASUREMENT mcb_pmsm_foc_hall_f28379d_B.Merge_pc "" UWORD mcb_pmsm_foc_hall_f28379d_CM_uint16 0 0 0 65535 ECU_ADDRESS 0x0001EAC8 /end MEASUREMENT
/begin MEASUREMENT mcb_pmsm_foc_hall_f28379d_B.Merge_pt "" UBYTE mcb_pmsm_foc_hall_f28379d_CM_logical 0 0 0 1 ECU_ADDRESS 0x0001EB2C /end MEASUREMENT
/begin MEASUREMENT mcb_pmsm_foc_hall_f28379d_B.Min "" ULONG mcb_pmsm_foc_hall_f28379d_CM_uint32 0 0 0 4294967295 ECU_ADDRESS 0x0001E7F4 /end MEASUREMENT
/begin MEASUREMENT mcb_pmsm_foc_hall_f28379d_B.Min_a "" FLOAT32_IEEE mcb_pmsm_foc_hall_f28379d_CM_single 0 0 -3.4E+38 3.4E+38 ECU_ADDRESS 0x0001E95C /end MEASUREMENT
/begin MEASUREMENT mcb_pmsm_foc_hall_f28379d_B.NOT "" UBYTE mcb_pmsm_foc_hall_f28379d_CM_logical 0 0 0 1 ECU_ADDRESS 0x0001EB26 /end MEASUREMENT
/begin MEASUREMENT mcb_pmsm_foc_hall_f28379d_B.NOT_b "" UBYTE mcb_pmsm_foc_hall_f28379d_CM_logical 0 0 0 1 ECU_ADDRESS 0x0001EB6A /end MEASUREMENT
/begin MEASUREMENT mcb_pmsm_foc_hall_f28379d_B.OR "" UBYTE mcb_pmsm_foc_hall_f28379d_CM_logical 0 0 0 1 ECU_ADDRESS 0x0001EB40 /end MEASUREMENT
/begin MEASUREMENT mcb_pmsm_foc_hall_f28379d_B.PProdOut "" FLOAT32_IEEE mcb_pmsm_foc_hall_f28379d_CM_single 0 0 -3.4E+38 3.4E+38 ECU_ADDRESS 0x0001E8B0 /end MEASUREMENT
/begin MEASUREMENT mcb_pmsm_foc_hall_f28379d_B.PProdOut_b "" FLOAT32_IEEE mcb_pmsm_foc_hall_f28379d_CM_single 0 0 -3.4E+38 3.4E+38 ECU_ADDRESS 0x0001E8C8 /end MEASUREMENT
/begin MEASUREMENT mcb_pmsm_foc_hall_f28379d_B.PU_Conversion "" FLOAT32_IEEE mcb_pmsm_foc_hall_f28379d_CM_single 0 0 -3.4E+38 3.4E+38 ARRAY_SIZE 2 ECU_ADDRESS 0x0001E864 /end MEASUREMENT
/begin MEASUREMENT mcb_pmsm_foc_hall_f28379d_B.PWM_Duty_Cycles "" FLOAT32_IEEE mcb_pmsm_foc_hall_f28379d_CM_single 0 0 -3.4E+38 3.4E+38 ARRAY_SIZE 3 ECU_ADDRESS 0x0001E994 /end MEASUREMENT
/begin MEASUREMENT mcb_pmsm_foc_hall_f28379d_B.Product "" FLOAT32_IEEE mcb_pmsm_foc_hall_f28379d_CM_single 0 0 -3.4E+38 3.4E+38 ECU_ADDRESS 0x0001E898 /end MEASUREMENT
/begin MEASUREMENT mcb_pmsm_foc_hall_f28379d_B.Product1 "" FLOAT32_IEEE mcb_pmsm_foc_hall_f28379d_CM_single 0 0 -3.4E+38 3.4E+38 ECU_ADDRESS 0x0001E8A4 /end MEASUREMENT
/begin MEASUREMENT mcb_pmsm_foc_hall_f28379d_B.Product1_b "" FLOAT32_IEEE mcb_pmsm_foc_hall_f28379d_CM_single 0 0 -3.4E+38 3.4E+38 ECU_ADDRESS 0x0001E8E8 /end MEASUREMENT
/begin MEASUREMENT mcb_pmsm_foc_hall_f28379d_B.Product1_p "" FLOAT32_IEEE mcb_pmsm_foc_hall_f28379d_CM_single 0 0 -3.4E+38 3.4E+38 ECU_ADDRESS 0x0001E93C /end MEASUREMENT
/begin MEASUREMENT mcb_pmsm_foc_hall_f28379d_B.Product2 "" FLOAT32_IEEE mcb_pmsm_foc_hall_f28379d_CM_single 0 0 -3.4E+38 3.4E+38 ECU_ADDRESS 0x0001EA6C /end MEASUREMENT
/begin MEASUREMENT mcb_pmsm_foc_hall_f28379d_B.Product_a "" FLOAT32_IEEE mcb_pmsm_foc_hall_f28379d_CM_single 0 0 -3.4E+38 3.4E+38 ECU_ADDRESS 0x0001EA64 /end MEASUREMENT
/begin MEASUREMENT mcb_pmsm_foc_hall_f28379d_B.Product_b "" FLOAT32_IEEE mcb_pmsm_foc_hall_f28379d_CM_single 0 0 -3.4E+38 3.4E+38 ECU_ADDRESS 0x0001E8E0 /end MEASUREMENT
/begin MEASUREMENT mcb_pmsm_foc_hall_f28379d_B.Product_d "" FLOAT32_IEEE mcb_pmsm_foc_hall_f28379d_CM_single 0 0 -3.4E+38 3.4E+38 ECU_ADDRESS 0x0001E934 /end MEASUREMENT
/begin MEASUREMENT mcb_pmsm_foc_hall_f28379d_B.Product_e "" FLOAT32_IEEE mcb_pmsm_foc_hall_f28379d_CM_single 0 0 -3.4E+38 3.4E+38 ECU_ADDRESS 0x0001E8E4 /end MEASUREMENT
/begin MEASUREMENT mcb_pmsm_foc_hall_f28379d_B.Product_i "" FLOAT32_IEEE mcb_pmsm_foc_hall_f28379d_CM_single 0 0 -3.4E+38 3.4E+38 ECU_ADDRESS 0x0001E9E8 /end MEASUREMENT
/begin MEASUREMENT mcb_pmsm_foc_hall_f28379d_B.Product_ie "" FLOAT32_IEEE mcb_pmsm_foc_hall_f28379d_CM_single 0 0 -3.4E+38 3.4E+38 ARRAY_SIZE 2 ECU_ADDRESS 0x0001EA44 /end MEASUREMENT
/begin MEASUREMENT mcb_pmsm_foc_hall_f28379d_B.RT1 "" FLOAT32_IEEE mcb_pmsm_foc_hall_f28379d_CM_single 0 0 -3.4E+38 3.4E+38 ECU_ADDRESS 0x0001E818
 /begin IF_DATA XCP
  /begin DAQ_EVENT VARIABLE /begin DEFAULT_EVENT_LIST EVENT 0x0000 /end DEFAULT_EVENT_LIST /end DAQ_EVENT
 /end IF_DATA
/end MEASUREMENT
/begin MEASUREMENT mcb_pmsm_foc_hall_f28379d_B.RT2 "" FLOAT32_IEEE mcb_pmsm_foc_hall_f28379d_CM_single 0 0 -3.4E+38 3.4E+38 ARRAY_SIZE 2 ECU_ADDRESS 0x0001E824 /end MEASUREMENT
/begin MEASUREMENT mcb_pmsm_foc_hall_f28379d_B.RT6 "" FLOAT32_IEEE mcb_pmsm_foc_hall_f28379d_CM_single 0 0 -3.4E+38 3.4E+38 ECU_ADDRESS 0x0001E81C
 /begin IF_DATA XCP
  /begin DAQ_EVENT VARIABLE /begin DEFAULT_EVENT_LIST EVENT 0x0000 /end DEFAULT_EVENT_LIST /end DAQ_EVENT
 /end IF_DATA
/end MEASUREMENT
/begin MEASUREMENT mcb_pmsm_foc_hall_f28379d_B.RT7 "" FLOAT32_IEEE mcb_pmsm_foc_hall_f28379d_CM_single 0 0 -3.4E+38 3.4E+38 ECU_ADDRESS 0x0001E820
 /begin IF_DATA XCP
  /begin DAQ_EVENT VARIABLE /begin DEFAULT_EVENT_LIST EVENT 0x0000 /end DEFAULT_EVENT_LIST /end DAQ_EVENT
 /end IF_DATA
/end MEASUREMENT
/begin MEASUREMENT mcb_pmsm_foc_hall_f28379d_B.ReadGPIODATregister "" ULONG mcb_pmsm_foc_hall_f28379d_CM_uint32 0 0 0 4294967295 ECU_ADDRESS 0x0001E704 /end MEASUREMENT
/begin MEASUREMENT mcb_pmsm_foc_hall_f28379d_B.ReadGPIODATregister_g "" ULONG mcb_pmsm_foc_hall_f28379d_CM_uint32 0 0 0 4294967295 ECU_ADDRESS 0x0001E764 /end MEASUREMENT
/begin MEASUREMENT mcb_pmsm_foc_hall_f28379d_B.ReadGPIODATregister_n "" ULONG mcb_pmsm_foc_hall_f28379d_CM_uint32 0 0 0 4294967295 ECU_ADDRESS 0x0001E734 /end MEASUREMENT
/begin MEASUREMENT mcb_pmsm_foc_hall_f28379d_B.ReadGPIODATregister_nt "" ULONG mcb_pmsm_foc_hall_f28379d_CM_uint32 0 0 0 4294967295 ECU_ADDRESS 0x0001E7F8 /end MEASUREMENT
/begin MEASUREMENT mcb_pmsm_foc_hall_f28379d_B.ReadGPIODATregister_p "" ULONG mcb_pmsm_foc_hall_f28379d_CM_uint32 0 0 0 4294967295 ECU_ADDRESS 0x0001E7C8 /end MEASUREMENT
/begin MEASUREMENT mcb_pmsm_foc_hall_f28379d_B.Reciprocal "" FLOAT32_IEEE mcb_pmsm_foc_hall_f28379d_CM_single 0 0 -3.4E+38 3.4E+38 ECU_ADDRESS 0x0001EA54 /end MEASUREMENT
/begin MEASUREMENT mcb_pmsm_foc_hall_f28379d_B.RelationalOperator "" UBYTE mcb_pmsm_foc_hall_f28379d_CM_logical 0 0 0 1 ECU_ADDRESS 0x0001EB4E /end MEASUREMENT
/begin MEASUREMENT mcb_pmsm_foc_hall_f28379d_B.RelationalOperator_h "" UBYTE mcb_pmsm_foc_hall_f28379d_CM_logical 0 0 0 1 ECU_ADDRESS 0x0001EB6C /end MEASUREMENT
/begin MEASUREMENT mcb_pmsm_foc_hall_f28379d_B.RelationalOperator_i "" UBYTE mcb_pmsm_foc_hall_f28379d_CM_logical 0 0 0 1 ECU_ADDRESS 0x0001EB74 /end MEASUREMENT
/begin MEASUREMENT mcb_pmsm_foc_hall_f28379d_B.RelationalOperator_k "" UBYTE mcb_pmsm_foc_hall_f28379d_CM_logical 0 0 0 1 ECU_ADDRESS 0x0001EB68 /end MEASUREMENT
/begin MEASUREMENT mcb_pmsm_foc_hall_f28379d_B.RelationalOperator_m "" UBYTE mcb_pmsm_foc_hall_f28379d_CM_logical 0 0 0 1 ECU_ADDRESS 0x0001EB58 /end MEASUREMENT
/begin MEASUREMENT mcb_pmsm_foc_hall_f28379d_B.SCIReceive "" FLOAT32_IEEE mcb_pmsm_foc_hall_f28379d_CM_single 0 0 -3.4E+38 3.4E+38 ARRAY_SIZE 2 ECU_ADDRESS 0x0001E834 /end MEASUREMENT
/begin MEASUREMENT mcb_pmsm_foc_hall_f28379d_B.SPIMasterTransfer2.SPIMasterTransfer2 "" UWORD mcb_pmsm_foc_hall_f28379d_CM_uint16 0 0 0 65535 ARRAY_SIZE 1 ECU_ADDRESS 0x0001EBCA /end MEASUREMENT
/begin MEASUREMENT mcb_pmsm_foc_hall_f28379d_B.SPIMasterTransfer3.SPIMasterTransfer2 "" UWORD mcb_pmsm_foc_hall_f28379d_CM_uint16 0 0 0 65535 ARRAY_SIZE 1 ECU_ADDRESS 0x0001EBC8 /end MEASUREMENT
/begin MEASUREMENT mcb_pmsm_foc_hall_f28379d_B.Saturation "" FLOAT32_IEEE mcb_pmsm_foc_hall_f28379d_CM_single 0 0 -3.4E+38 3.4E+38 ECU_ADDRESS 0x0001E8C0 /end MEASUREMENT
/begin MEASUREMENT mcb_pmsm_foc_hall_f28379d_B.Saturation_j "" FLOAT32_IEEE mcb_pmsm_foc_hall_f28379d_CM_single 0 0 -3.4E+38 3.4E+38 ECU_ADDRESS 0x0001E8D8 /end MEASUREMENT
/begin MEASUREMENT mcb_pmsm_foc_hall_f28379d_B.Saturation_k "" FLOAT32_IEEE mcb_pmsm_foc_hall_f28379d_CM_single 0 0 -3.4E+38 3.4E+38 ECU_ADDRESS 0x0001E9B4 /end MEASUREMENT
/begin MEASUREMENT mcb_pmsm_foc_hall_f28379d_B.Scale_to_PWM_Counter_PRD "" UWORD mcb_pmsm_foc_hall_f28379d_CM_uint16 0 0 0 65535 ARRAY_SIZE 3 ECU_ADDRESS 0x0001EAFC /end MEASUREMENT
/begin MEASUREMENT mcb_pmsm_foc_hall_f28379d_B.ShiftArithmetic "" ULONG mcb_pmsm_foc_hall_f28379d_CM_uint32 0 0 0 4294967295 ECU_ADDRESS 0x0001E70C /end MEASUREMENT
/begin MEASUREMENT mcb_pmsm_foc_hall_f28379d_B.ShiftArithmetic1 "" ULONG mcb_pmsm_foc_hall_f28379d_CM_uint32 0 0 0 4294967295 ECU_ADDRESS 0x0001E714 /end MEASUREMENT
/begin MEASUREMENT mcb_pmsm_foc_hall_f28379d_B.ShiftArithmetic1_c "" ULONG mcb_pmsm_foc_hall_f28379d_CM_uint32 0 0 0 4294967295 ECU_ADDRESS 0x0001E7D8 /end MEASUREMENT
/begin MEASUREMENT mcb_pmsm_foc_hall_f28379d_B.ShiftArithmetic1_d "" UWORD mcb_pmsm_foc_hall_f28379d_CM_uint16 0 0 0 65535 ECU_ADDRESS 0x0001EAC0 /end MEASUREMENT
/begin MEASUREMENT mcb_pmsm_foc_hall_f28379d_B.ShiftArithmetic1_h "" ULONG mcb_pmsm_foc_hall_f28379d_CM_uint32 0 0 0 4294967295 ECU_ADDRESS 0x0001E808 /end MEASUREMENT
/begin MEASUREMENT mcb_pmsm_foc_hall_f28379d_B.ShiftArithmetic1_j "" ULONG mcb_pmsm_foc_hall_f28379d_CM_uint32 0 0 0 4294967295 ECU_ADDRESS 0x0001E744 /end MEASUREMENT
/begin MEASUREMENT mcb_pmsm_foc_hall_f28379d_B.ShiftArithmetic1_jb "" ULONG mcb_pmsm_foc_hall_f28379d_CM_uint32 0 0 0 4294967295 ECU_ADDRESS 0x0001E774 /end MEASUREMENT
/begin MEASUREMENT mcb_pmsm_foc_hall_f28379d_B.ShiftArithmetic2 "" ULONG mcb_pmsm_foc_hall_f28379d_CM_uint32 0 0 0 4294967295 ECU_ADDRESS 0x0001E71C /end MEASUREMENT
/begin MEASUREMENT mcb_pmsm_foc_hall_f28379d_B.ShiftArithmetic2_e "" ULONG mcb_pmsm_foc_hall_f28379d_CM_uint32 0 0 0 4294967295 ECU_ADDRESS 0x0001E810 /end MEASUREMENT
/begin MEASUREMENT mcb_pmsm_foc_hall_f28379d_B.ShiftArithmetic2_i "" ULONG mcb_pmsm_foc_hall_f28379d_CM_uint32 0 0 0 4294967295 ECU_ADDRESS 0x0001E77C /end MEASUREMENT
/begin MEASUREMENT mcb_pmsm_foc_hall_f28379d_B.ShiftArithmetic2_k "" ULONG mcb_pmsm_foc_hall_f28379d_CM_uint32 0 0 0 4294967295 ECU_ADDRESS 0x0001E74C /end MEASUREMENT
/begin MEASUREMENT mcb_pmsm_foc_hall_f28379d_B.ShiftArithmetic2_kn "" ULONG mcb_pmsm_foc_hall_f28379d_CM_uint32 0 0 0 4294967295 ECU_ADDRESS 0x0001E7E0 /end MEASUREMENT
/begin MEASUREMENT mcb_pmsm_foc_hall_f28379d_B.ShiftArithmetic_b "" ULONG mcb_pmsm_foc_hall_f28379d_CM_uint32 0 0 0 4294967295 ECU_ADDRESS 0x0001E73C /end MEASUREMENT
/begin MEASUREMENT mcb_pmsm_foc_hall_f28379d_B.ShiftArithmetic_e "" ULONG mcb_pmsm_foc_hall_f28379d_CM_uint32 0 0 0 4294967295 ECU_ADDRESS 0x0001E76C /end MEASUREMENT
/begin MEASUREMENT mcb_pmsm_foc_hall_f28379d_B.ShiftArithmetic_l "" ULONG mcb_pmsm_foc_hall_f28379d_CM_uint32 0 0 0 4294967295 ECU_ADDRESS 0x0001E7D0 /end MEASUREMENT
/begin MEASUREMENT mcb_pmsm_foc_hall_f28379d_B.ShiftArithmetic_p "" ULONG mcb_pmsm_foc_hall_f28379d_CM_uint32 0 0 0 4294967295 ECU_ADDRESS 0x0001E800 /end MEASUREMENT
/begin MEASUREMENT mcb_pmsm_foc_hall_f28379d_B.SpeedControl.AND3 "" UBYTE mcb_pmsm_foc_hall_f28379d_CM_logical 0 0 0 1 ECU_ADDRESS 0x0001EBC6
 /begin IF_DATA XCP
  /begin DAQ_EVENT VARIABLE /begin DEFAULT_EVENT_LIST EVENT 0x0000 /end DEFAULT_EVENT_LIST /end DAQ_EVENT
 /end IF_DATA
/end MEASUREMENT
/begin MEASUREMENT mcb_pmsm_foc_hall_f28379d_B.SpeedControl.Add1 "" FLOAT32_IEEE mcb_pmsm_foc_hall_f28379d_CM_single 0 0 -3.4E+38 3.4E+38 ECU_ADDRESS 0x0001EB8C
 /begin IF_DATA XCP
  /begin DAQ_EVENT VARIABLE /begin DEFAULT_EVENT_LIST EVENT 0x0000 /end DEFAULT_EVENT_LIST /end DAQ_EVENT
 /end IF_DATA
/end MEASUREMENT
/begin MEASUREMENT mcb_pmsm_foc_hall_f28379d_B.SpeedControl.DataStoreRead1 "" UBYTE mcb_pmsm_foc_hall_f28379d_CM_logical 0 0 0 1 ECU_ADDRESS 0x0001EBB8
 /begin IF_DATA XCP
  /begin DAQ_EVENT VARIABLE /begin DEFAULT_EVENT_LIST EVENT 0x0000 /end DEFAULT_EVENT_LIST /end DAQ_EVENT
 /end IF_DATA
/end MEASUREMENT
/begin MEASUREMENT mcb_pmsm_foc_hall_f28379d_B.SpeedControl.DataStoreRead2 "" UBYTE mcb_pmsm_foc_hall_f28379d_CM_logical 0 0 0 1 ECU_ADDRESS 0x0001EBBA
 /begin IF_DATA XCP
  /begin DAQ_EVENT VARIABLE /begin DEFAULT_EVENT_LIST EVENT 0x0000 /end DEFAULT_EVENT_LIST /end DAQ_EVENT
 /end IF_DATA
/end MEASUREMENT
/begin MEASUREMENT mcb_pmsm_foc_hall_f28379d_B.SpeedControl.DeadZone "" FLOAT32_IEEE mcb_pmsm_foc_hall_f28379d_CM_single 0 0 -3.4E+38 3.4E+38 ECU_ADDRESS 0x0001EBA4
 /begin IF_DATA XCP
  /begin DAQ_EVENT VARIABLE /begin DEFAULT_EVENT_LIST EVENT 0x0000 /end DEFAULT_EVENT_LIST /end DAQ_EVENT
 /end IF_DATA
/end MEASUREMENT
/begin MEASUREMENT mcb_pmsm_foc_hall_f28379d_B.SpeedControl.Equal1 "" UBYTE mcb_pmsm_foc_hall_f28379d_CM_logical 0 0 0 1 ECU_ADDRESS 0x0001EBC4
 /begin IF_DATA XCP
  /begin DAQ_EVENT VARIABLE /begin DEFAULT_EVENT_LIST EVENT 0x0000 /end DEFAULT_EVENT_LIST /end DAQ_EVENT
 /end IF_DATA
/end MEASUREMENT
/begin MEASUREMENT mcb_pmsm_foc_hall_f28379d_B.SpeedControl.IProdOut "" FLOAT32_IEEE mcb_pmsm_foc_hall_f28379d_CM_single 0 0 -3.4E+38 3.4E+38 ECU_ADDRESS 0x0001EBA8
 /begin IF_DATA XCP
  /begin DAQ_EVENT VARIABLE /begin DEFAULT_EVENT_LIST EVENT 0x0000 /end DEFAULT_EVENT_LIST /end DAQ_EVENT
 /end IF_DATA
/end MEASUREMENT
/begin MEASUREMENT mcb_pmsm_foc_hall_f28379d_B.SpeedControl.Id_ref "" FLOAT32_IEEE mcb_pmsm_foc_hall_f28379d_CM_single 0 0 -3.4E+38 3.4E+38 ECU_ADDRESS 0x0001EB7C
 /begin IF_DATA XCP
  /begin DAQ_EVENT VARIABLE /begin DEFAULT_EVENT_LIST EVENT 0x0000 /end DEFAULT_EVENT_LIST /end DAQ_EVENT
 /end IF_DATA
/end MEASUREMENT
/begin MEASUREMENT mcb_pmsm_foc_hall_f28379d_B.SpeedControl.Integrator "" FLOAT32_IEEE mcb_pmsm_foc_hall_f28379d_CM_single 0 0 -3.4E+38 3.4E+38 ECU_ADDRESS 0x0001EB9C
 /begin IF_DATA XCP
  /begin DAQ_EVENT VARIABLE /begin DEFAULT_EVENT_LIST EVENT 0x0000 /end DEFAULT_EVENT_LIST /end DAQ_EVENT
 /end IF_DATA
/end MEASUREMENT
/begin MEASUREMENT mcb_pmsm_foc_hall_f28379d_B.SpeedControl.Ki2 "" FLOAT32_IEEE mcb_pmsm_foc_hall_f28379d_CM_single 0 0 -3.4E+38 3.4E+38 ECU_ADDRESS 0x0001EB98
 /begin IF_DATA XCP
  /begin DAQ_EVENT VARIABLE /begin DEFAULT_EVENT_LIST EVENT 0x0000 /end DEFAULT_EVENT_LIST /end DAQ_EVENT
 /end IF_DATA
/end MEASUREMENT
/begin MEASUREMENT mcb_pmsm_foc_hall_f28379d_B.SpeedControl.LogicalOperator "" UBYTE mcb_pmsm_foc_hall_f28379d_CM_logical 0 0 0 1 ECU_ADDRESS 0x0001EBBC
 /begin IF_DATA XCP
  /begin DAQ_EVENT VARIABLE /begin DEFAULT_EVENT_LIST EVENT 0x0000 /end DEFAULT_EVENT_LIST /end DAQ_EVENT
 /end IF_DATA
/end MEASUREMENT
/begin MEASUREMENT mcb_pmsm_foc_hall_f28379d_B.SpeedControl.PProdOut "" FLOAT32_IEEE mcb_pmsm_foc_hall_f28379d_CM_single 0 0 -3.4E+38 3.4E+38 ECU_ADDRESS 0x0001EB94
 /begin IF_DATA XCP
  /begin DAQ_EVENT VARIABLE /begin DEFAULT_EVENT_LIST EVENT 0x0000 /end DEFAULT_EVENT_LIST /end DAQ_EVENT
 /end IF_DATA
/end MEASUREMENT
/begin MEASUREMENT mcb_pmsm_foc_hall_f28379d_B.SpeedControl.Product "" FLOAT32_IEEE mcb_pmsm_foc_hall_f28379d_CM_single 0 0 -3.4E+38 3.4E+38 ECU_ADDRESS 0x0001EB80
 /begin IF_DATA XCP
  /begin DAQ_EVENT VARIABLE /begin DEFAULT_EVENT_LIST EVENT 0x0000 /end DEFAULT_EVENT_LIST /end DAQ_EVENT
 /end IF_DATA
/end MEASUREMENT
/begin MEASUREMENT mcb_pmsm_foc_hall_f28379d_B.SpeedControl.Product1 "" FLOAT32_IEEE mcb_pmsm_foc_hall_f28379d_CM_single 0 0 -3.4E+38 3.4E+38 ECU_ADDRESS 0x0001EB88
 /begin IF_DATA XCP
  /begin DAQ_EVENT VARIABLE /begin DEFAULT_EVENT_LIST EVENT 0x0000 /end DEFAULT_EVENT_LIST /end DAQ_EVENT
 /end IF_DATA
/end MEASUREMENT
/begin MEASUREMENT mcb_pmsm_foc_hall_f28379d_B.SpeedControl.RelationalOperator "" UBYTE mcb_pmsm_foc_hall_f28379d_CM_logical 0 0 0 1 ECU_ADDRESS 0x0001EBBE
 /begin IF_DATA XCP
  /begin DAQ_EVENT VARIABLE /begin DEFAULT_EVENT_LIST EVENT 0x0000 /end DEFAULT_EVENT_LIST /end DAQ_EVENT
 /end IF_DATA
/end MEASUREMENT
/begin MEASUREMENT mcb_pmsm_foc_hall_f28379d_B.SpeedControl.Saturation "" FLOAT32_IEEE mcb_pmsm_foc_hall_f28379d_CM_single 0 0 -3.4E+38 3.4E+38 ECU_ADDRESS 0x0001EBB0
 /begin IF_DATA XCP
  /begin DAQ_EVENT VARIABLE /begin DEFAULT_EVENT_LIST EVENT 0x0000 /end DEFAULT_EVENT_LIST /end DAQ_EVENT
 /end IF_DATA
/end MEASUREMENT
/begin MEASUREMENT mcb_pmsm_foc_hall_f28379d_B.SpeedControl.Sum "" FLOAT32_IEEE mcb_pmsm_foc_hall_f28379d_CM_single 0 0 -3.4E+38 3.4E+38 ECU_ADDRESS 0x0001EB90
 /begin IF_DATA XCP
  /begin DAQ_EVENT VARIABLE /begin DEFAULT_EVENT_LIST EVENT 0x0000 /end DEFAULT_EVENT_LIST /end DAQ_EVENT
 /end IF_DATA
/end MEASUREMENT
/begin MEASUREMENT mcb_pmsm_foc_hall_f28379d_B.SpeedControl.Sum_i "" FLOAT32_IEEE mcb_pmsm_foc_hall_f28379d_CM_single 0 0 -3.4E+38 3.4E+38 ECU_ADDRESS 0x0001EBA0
 /begin IF_DATA XCP
  /begin DAQ_EVENT VARIABLE /begin DEFAULT_EVENT_LIST EVENT 0x0000 /end DEFAULT_EVENT_LIST /end DAQ_EVENT
 /end IF_DATA
/end MEASUREMENT
/begin MEASUREMENT mcb_pmsm_foc_hall_f28379d_B.SpeedControl.Switch "" FLOAT32_IEEE mcb_pmsm_foc_hall_f28379d_CM_single 0 0 -3.4E+38 3.4E+38 ECU_ADDRESS 0x0001EB78
 /begin IF_DATA XCP
  /begin DAQ_EVENT VARIABLE /begin DEFAULT_EVENT_LIST EVENT 0x0000 /end DEFAULT_EVENT_LIST /end DAQ_EVENT
 /end IF_DATA
/end MEASUREMENT
/begin MEASUREMENT mcb_pmsm_foc_hall_f28379d_B.SpeedControl.Switch1 "" SBYTE mcb_pmsm_foc_hall_f28379d_CM_int8 0 0 -128 127 ECU_ADDRESS 0x0001EBB4
 /begin IF_DATA XCP
  /begin DAQ_EVENT VARIABLE /begin DEFAULT_EVENT_LIST EVENT 0x0000 /end DEFAULT_EVENT_LIST /end DAQ_EVENT
 /end IF_DATA
/end MEASUREMENT
/begin MEASUREMENT mcb_pmsm_foc_hall_f28379d_B.SpeedControl.Switch2 "" SBYTE mcb_pmsm_foc_hall_f28379d_CM_int8 0 0 -128 127 ECU_ADDRESS 0x0001EBB6
 /begin IF_DATA XCP
  /begin DAQ_EVENT VARIABLE /begin DEFAULT_EVENT_LIST EVENT 0x0000 /end DEFAULT_EVENT_LIST /end DAQ_EVENT
 /end IF_DATA
/end MEASUREMENT
/begin MEASUREMENT mcb_pmsm_foc_hall_f28379d_B.SpeedControl.Switch_b "" FLOAT32_IEEE mcb_pmsm_foc_hall_f28379d_CM_single 0 0 -3.4E+38 3.4E+38 ECU_ADDRESS 0x0001EBAC
 /begin IF_DATA XCP
  /begin DAQ_EVENT VARIABLE /begin DEFAULT_EVENT_LIST EVENT 0x0000 /end DEFAULT_EVENT_LIST /end DAQ_EVENT
 /end IF_DATA
/end MEASUREMENT
/begin MEASUREMENT mcb_pmsm_foc_hall_f28379d_B.SpeedControl.UnitDelay "" FLOAT32_IEEE mcb_pmsm_foc_hall_f28379d_CM_single 0 0 -3.4E+38 3.4E+38 ECU_ADDRESS 0x0001EB84
 /begin IF_DATA XCP
  /begin DAQ_EVENT VARIABLE /begin DEFAULT_EVENT_LIST EVENT 0x0000 /end DEFAULT_EVENT_LIST /end DAQ_EVENT
 /end IF_DATA
/end MEASUREMENT
/begin MEASUREMENT mcb_pmsm_foc_hall_f28379d_B.SpeedControl.fixforDTpropagationissue "" UBYTE mcb_pmsm_foc_hall_f28379d_CM_logical 0 0 0 1 ECU_ADDRESS 0x0001EBC0
 /begin IF_DATA XCP
  /begin DAQ_EVENT VARIABLE /begin DEFAULT_EVENT_LIST EVENT 0x0000 /end DEFAULT_EVENT_LIST /end DAQ_EVENT
 /end IF_DATA
/end MEASUREMENT
/begin MEASUREMENT mcb_pmsm_foc_hall_f28379d_B.SpeedControl.fixforDTpropagationissue1 "" UBYTE mcb_pmsm_foc_hall_f28379d_CM_logical 0 0 0 1 ECU_ADDRESS 0x0001EBC2
 /begin IF_DATA XCP
  /begin DAQ_EVENT VARIABLE /begin DEFAULT_EVENT_LIST EVENT 0x0000 /end DEFAULT_EVENT_LIST /end DAQ_EVENT
 /end IF_DATA
/end MEASUREMENT
/begin MEASUREMENT mcb_pmsm_foc_hall_f28379d_B.SpeedGain "" FLOAT32_IEEE mcb_pmsm_foc_hall_f28379d_CM_single 0 0 -3.4E+38 3.4E+38 ECU_ADDRESS 0x0001E9AC /end MEASUREMENT
/begin MEASUREMENT mcb_pmsm_foc_hall_f28379d_B.Speed_PU "" FLOAT32_IEEE mcb_pmsm_foc_hall_f28379d_CM_single 0 0 -3.4E+38 3.4E+38 ECU_ADDRESS 0x0001E9A0 /end MEASUREMENT
/begin MEASUREMENT mcb_pmsm_foc_hall_f28379d_B.Sqrt "" FLOAT32_IEEE mcb_pmsm_foc_hall_f28379d_CM_single 0 0 -3.4E+38 3.4E+38 ECU_ADDRESS 0x0001EA80 /end MEASUREMENT
/begin MEASUREMENT mcb_pmsm_foc_hall_f28379d_B.SquareRoot "" FLOAT32_IEEE mcb_pmsm_foc_hall_f28379d_CM_single 0 0 -3.4E+38 3.4E+38 ECU_ADDRESS 0x0001EA4C /end MEASUREMENT
/begin MEASUREMENT mcb_pmsm_foc_hall_f28379d_B.Sum "" ULONG mcb_pmsm_foc_hall_f28379d_CM_uint32 0 0 0 4294967295 ARRAY_SIZE 4 ECU_ADDRESS 0x0001E794 /end MEASUREMENT
/begin MEASUREMENT mcb_pmsm_foc_hall_f28379d_B.Sum1 "" FLOAT32_IEEE mcb_pmsm_foc_hall_f28379d_CM_single 0 0 -3.4E+38 3.4E+38 ECU_ADDRESS 0x0001E8EC /end MEASUREMENT
/begin MEASUREMENT mcb_pmsm_foc_hall_f28379d_B.Sum1_i "" FLOAT32_IEEE mcb_pmsm_foc_hall_f28379d_CM_single 0 0 -3.4E+38 3.4E+38 ECU_ADDRESS 0x0001E9E4 /end MEASUREMENT
/begin MEASUREMENT mcb_pmsm_foc_hall_f28379d_B.Sum1_j "" UWORD mcb_pmsm_foc_hall_f28379d_CM_uint16 0 0 0 65535 ECU_ADDRESS 0x0001EAB8 /end MEASUREMENT
/begin MEASUREMENT mcb_pmsm_foc_hall_f28379d_B.Sum2 "" FLOAT32_IEEE mcb_pmsm_foc_hall_f28379d_CM_single 0 0 -3.4E+38 3.4E+38 ECU_ADDRESS 0x0001E894 /end MEASUREMENT
/begin MEASUREMENT mcb_pmsm_foc_hall_f28379d_B.Sum2_p "" FLOAT32_IEEE mcb_pmsm_foc_hall_f28379d_CM_single 0 0 -3.4E+38 3.4E+38 ECU_ADDRESS 0x0001E930 /end MEASUREMENT
/begin MEASUREMENT mcb_pmsm_foc_hall_f28379d_B.Sum3 "" FLOAT32_IEEE mcb_pmsm_foc_hall_f28379d_CM_single 0 0 -3.4E+38 3.4E+38 ECU_ADDRESS 0x0001E88C /end MEASUREMENT
/begin MEASUREMENT mcb_pmsm_foc_hall_f28379d_B.Sum3_c "" FLOAT32_IEEE mcb_pmsm_foc_hall_f28379d_CM_single 0 0 -3.4E+38 3.4E+38 ECU_ADDRESS 0x0001E92C /end MEASUREMENT
/begin MEASUREMENT mcb_pmsm_foc_hall_f28379d_B.Sum4 "" FLOAT32_IEEE mcb_pmsm_foc_hall_f28379d_CM_single 0 0 -3.4E+38 3.4E+38 ECU_ADDRESS 0x0001E89C /end MEASUREMENT
/begin MEASUREMENT mcb_pmsm_foc_hall_f28379d_B.Sum4_j "" FLOAT32_IEEE mcb_pmsm_foc_hall_f28379d_CM_single 0 0 -3.4E+38 3.4E+38 ECU_ADDRESS 0x0001E940 /end MEASUREMENT
/begin MEASUREMENT mcb_pmsm_foc_hall_f28379d_B.Sum5 "" FLOAT32_IEEE mcb_pmsm_foc_hall_f28379d_CM_single 0 0 -3.4E+38 3.4E+38 ECU_ADDRESS 0x0001E8A0 /end MEASUREMENT
/begin MEASUREMENT mcb_pmsm_foc_hall_f28379d_B.Sum5_k "" FLOAT32_IEEE mcb_pmsm_foc_hall_f28379d_CM_single 0 0 -3.4E+38 3.4E+38 ECU_ADDRESS 0x0001E938 /end MEASUREMENT
/begin MEASUREMENT mcb_pmsm_foc_hall_f28379d_B.Sum6 "" FLOAT32_IEEE mcb_pmsm_foc_hall_f28379d_CM_single 0 0 -3.4E+38 3.4E+38 ECU_ADDRESS 0x0001E8A8 /end MEASUREMENT
/begin MEASUREMENT mcb_pmsm_foc_hall_f28379d_B.Sum6_e "" FLOAT32_IEEE mcb_pmsm_foc_hall_f28379d_CM_single 0 0 -3.4E+38 3.4E+38 ECU_ADDRESS 0x0001E944 /end MEASUREMENT
/begin MEASUREMENT mcb_pmsm_foc_hall_f28379d_B.Sum_b "" FLOAT32_IEEE mcb_pmsm_foc_hall_f28379d_CM_single 0 0 -3.4E+38 3.4E+38 ECU_ADDRESS 0x0001E8C4 /end MEASUREMENT
/begin MEASUREMENT mcb_pmsm_foc_hall_f28379d_B.Sum_g "" FLOAT32_IEEE mcb_pmsm_foc_hall_f28379d_CM_single 0 0 -3.4E+38 3.4E+38 ECU_ADDRESS 0x0001E8AC /end MEASUREMENT
/begin MEASUREMENT mcb_pmsm_foc_hall_f28379d_B.Sum_h "" FLOAT32_IEEE mcb_pmsm_foc_hall_f28379d_CM_single 0 0 -3.4E+38 3.4E+38 ECU_ADDRESS 0x0001E8D4 /end MEASUREMENT
/begin MEASUREMENT mcb_pmsm_foc_hall_f28379d_B.Sum_i "" UWORD mcb_pmsm_foc_hall_f28379d_CM_uint16 0 0 0 65535 ECU_ADDRESS 0x0001EAB4 /end MEASUREMENT
/begin MEASUREMENT mcb_pmsm_foc_hall_f28379d_B.Sum_k "" ULONG mcb_pmsm_foc_hall_f28379d_CM_uint32 0 0 0 4294967295 ARRAY_SIZE 4 ECU_ADDRESS 0x0001E7A4 /end MEASUREMENT
/begin MEASUREMENT mcb_pmsm_foc_hall_f28379d_B.Sum_m "" FLOAT32_IEEE mcb_pmsm_foc_hall_f28379d_CM_single 0 0 -3.4E+38 3.4E+38 ECU_ADDRESS 0x0001E8BC /end MEASUREMENT
/begin MEASUREMENT mcb_pmsm_foc_hall_f28379d_B.Sum_m3 "" UWORD mcb_pmsm_foc_hall_f28379d_CM_uint16 0 0 0 65535 ECU_ADDRESS 0x0001EAE2 /end MEASUREMENT
/begin MEASUREMENT mcb_pmsm_foc_hall_f28379d_B.Sum_n "" FLOAT32_IEEE mcb_pmsm_foc_hall_f28379d_CM_single 0 0 -3.4E+38 3.4E+38 ECU_ADDRESS 0x0001E9DC /end MEASUREMENT
/begin MEASUREMENT mcb_pmsm_foc_hall_f28379d_B.Sum_nl "" FLOAT32_IEEE mcb_pmsm_foc_hall_f28379d_CM_single 0 0 -3.4E+38 3.4E+38 ECU_ADDRESS 0x0001EA68 /end MEASUREMENT
/begin MEASUREMENT mcb_pmsm_foc_hall_f28379d_B.Switch "" ULONG mcb_pmsm_foc_hall_f28379d_CM_uint32 0 0 0 4294967295 ECU_ADDRESS 0x0001E72C /end MEASUREMENT
/begin MEASUREMENT mcb_pmsm_foc_hall_f28379d_B.Switch1 "" FLOAT32_IEEE mcb_pmsm_foc_hall_f28379d_CM_single 0 0 -3.4E+38 3.4E+38 ECU_ADDRESS 0x0001EA7C /end MEASUREMENT
/begin MEASUREMENT mcb_pmsm_foc_hall_f28379d_B.Switch1_f "" UWORD mcb_pmsm_foc_hall_f28379d_CM_uint16 0 0 0 65535 ARRAY_SIZE 3 ECU_ADDRESS 0x0001EAF6 /end MEASUREMENT
/begin MEASUREMENT mcb_pmsm_foc_hall_f28379d_B.Switch1_i "" SBYTE mcb_pmsm_foc_hall_f28379d_CM_int8 0 0 -128 127 ECU_ADDRESS 0x0001EB1C /end MEASUREMENT
/begin MEASUREMENT mcb_pmsm_foc_hall_f28379d_B.Switch1_j "" SBYTE mcb_pmsm_foc_hall_f28379d_CM_int8 0 0 -128 127 ECU_ADDRESS 0x0001EB20 /end MEASUREMENT
/begin MEASUREMENT mcb_pmsm_foc_hall_f28379d_B.Switch1_o "" UWORD mcb_pmsm_foc_hall_f28379d_CM_uint16 0 0 0 65535 ECU_ADDRESS 0x0001EAF0 /end MEASUREMENT
/begin MEASUREMENT mcb_pmsm_foc_hall_f28379d_B.Switch2 "" FLOAT32_IEEE mcb_pmsm_foc_hall_f28379d_CM_single 0 0 -3.4E+38 3.4E+38 ECU_ADDRESS 0x0001EA60 /end MEASUREMENT
/begin MEASUREMENT mcb_pmsm_foc_hall_f28379d_B.Switch2_a "" SBYTE mcb_pmsm_foc_hall_f28379d_CM_int8 0 0 -128 127 ECU_ADDRESS 0x0001EB1E /end MEASUREMENT
/begin MEASUREMENT mcb_pmsm_foc_hall_f28379d_B.Switch2_b "" SBYTE mcb_pmsm_foc_hall_f28379d_CM_int8 0 0 -128 127 ECU_ADDRESS 0x0001EB22 /end MEASUREMENT
/begin MEASUREMENT mcb_pmsm_foc_hall_f28379d_B.Switch_a "" UWORD mcb_pmsm_foc_hall_f28379d_CM_uint16 0 0 0 65535 ECU_ADDRESS 0x0001EADA /end MEASUREMENT
/begin MEASUREMENT mcb_pmsm_foc_hall_f28379d_B.Switch_b "" FLOAT32_IEEE mcb_pmsm_foc_hall_f28379d_CM_single 0 0 -3.4E+38 3.4E+38 ECU_ADDRESS 0x0001E900 /end MEASUREMENT
/begin MEASUREMENT mcb_pmsm_foc_hall_f28379d_B.Switch_bt "" UBYTE mcb_pmsm_foc_hall_f28379d_CM_logical 0 0 0 1 ECU_ADDRESS 0x0001EB24 /end MEASUREMENT
/begin MEASUREMENT mcb_pmsm_foc_hall_f28379d_B.Switch_c "" FLOAT32_IEEE mcb_pmsm_foc_hall_f28379d_CM_single 0 0 -3.4E+38 3.4E+38 ECU_ADDRESS 0x0001EA78 /end MEASUREMENT
/begin MEASUREMENT mcb_pmsm_foc_hall_f28379d_B.Switch_e "" ULONG mcb_pmsm_foc_hall_f28379d_CM_uint32 0 0 0 4294967295 ECU_ADDRESS 0x0001E78C /end MEASUREMENT
/begin MEASUREMENT mcb_pmsm_foc_hall_f28379d_B.Switch_f "" FLOAT32_IEEE mcb_pmsm_foc_hall_f28379d_CM_single 0 0 -3.4E+38 3.4E+38 ECU_ADDRESS 0x0001E984 /end MEASUREMENT
/begin MEASUREMENT mcb_pmsm_foc_hall_f28379d_B.Switch_fd "" FLOAT32_IEEE mcb_pmsm_foc_hall_f28379d_CM_single 0 0 -3.4E+38 3.4E+38 ARRAY_SIZE 2 ECU_ADDRESS 0x0001EA0C /end MEASUREMENT
/begin MEASUREMENT mcb_pmsm_foc_hall_f28379d_B.Switch_h "" FLOAT32_IEEE mcb_pmsm_foc_hall_f28379d_CM_single 0 0 -3.4E+38 3.4E+38 ECU_ADDRESS 0x0001E844 /end MEASUREMENT
/begin MEASUREMENT mcb_pmsm_foc_hall_f28379d_B.Switch_hp "" FLOAT32_IEEE mcb_pmsm_foc_hall_f28379d_CM_single 0 0 -3.4E+38 3.4E+38 ARRAY_SIZE 2 ECU_ADDRESS 0x0001EA58 /end MEASUREMENT
/begin MEASUREMENT mcb_pmsm_foc_hall_f28379d_B.Switch_j "" FLOAT32_IEEE mcb_pmsm_foc_hall_f28379d_CM_single 0 0 -3.4E+38 3.4E+38 ECU_ADDRESS 0x0001E8DC /end MEASUREMENT
/begin MEASUREMENT mcb_pmsm_foc_hall_f28379d_B.Switch_k "" FLOAT32_IEEE mcb_pmsm_foc_hall_f28379d_CM_single 0 0 -3.4E+38 3.4E+38 ARRAY_SIZE 2 ECU_ADDRESS 0x0001EA34 /end MEASUREMENT
/begin MEASUREMENT mcb_pmsm_foc_hall_f28379d_B.Switch_l "" ULONG mcb_pmsm_foc_hall_f28379d_CM_uint32 0 0 0 4294967295 ECU_ADDRESS 0x0001E75C /end MEASUREMENT
/begin MEASUREMENT mcb_pmsm_foc_hall_f28379d_B.Switch_ls "" FLOAT32_IEEE mcb_pmsm_foc_hall_f28379d_CM_single 0 0 -3.4E+38 3.4E+38 ECU_ADDRESS 0x0001E90C /end MEASUREMENT
/begin MEASUREMENT mcb_pmsm_foc_hall_f28379d_B.Switch_m "" UWORD mcb_pmsm_foc_hall_f28379d_CM_uint16 0 0 0 65535 ECU_ADDRESS 0x0001EADC /end MEASUREMENT
/begin MEASUREMENT mcb_pmsm_foc_hall_f28379d_B.Switch_o "" FLOAT32_IEEE mcb_pmsm_foc_hall_f28379d_CM_single 0 0 -3.4E+38 3.4E+38 ECU_ADDRESS 0x0001EA50 /end MEASUREMENT
/begin MEASUREMENT mcb_pmsm_foc_hall_f28379d_B.TmpSignalConversionAtTAQSigLogg "" FLOAT32_IEEE mcb_pmsm_foc_hall_f28379d_CM_single 0 0 -3.4E+38 3.4E+38 ARRAY_SIZE 2 ECU_ADDRESS 0x0001E82C /end MEASUREMENT
/begin MEASUREMENT mcb_pmsm_foc_hall_f28379d_B.UnitDelay "" ULONG mcb_pmsm_foc_hall_f28379d_CM_uint32 0 0 0 4294967295 ECU_ADDRESS 0x0001E7BC /end MEASUREMENT
/begin MEASUREMENT mcb_pmsm_foc_hall_f28379d_B.UpperRelop "" UBYTE mcb_pmsm_foc_hall_f28379d_CM_logical 0 0 0 1 ECU_ADDRESS 0x0001EB76 /end MEASUREMENT
/begin MEASUREMENT mcb_pmsm_foc_hall_f28379d_B.ValidHalls.Merge "" UWORD mcb_pmsm_foc_hall_f28379d_CM_uint16 0 0 0 65535 ECU_ADDRESS 0x0001EBE0 /end MEASUREMENT
/begin MEASUREMENT mcb_pmsm_foc_hall_f28379d_B.ValidHalls.Merge1 "" UWORD mcb_pmsm_foc_hall_f28379d_CM_uint16 0 0 0 65535 ECU_ADDRESS 0x0001EBE2 /end MEASUREMENT
/begin MEASUREMENT mcb_pmsm_foc_hall_f28379d_B.ValidHalls.Merge2 "" SWORD mcb_pmsm_foc_hall_f28379d_CM_int16 0 0 -32768 32767 ECU_ADDRESS 0x0001EBE6 /end MEASUREMENT
/begin MEASUREMENT mcb_pmsm_foc_hall_f28379d_B.ValidHalls.Merge3 "" UWORD mcb_pmsm_foc_hall_f28379d_CM_uint16 0 0 0 65535 ECU_ADDRESS 0x0001EBE4 /end MEASUREMENT
/begin MEASUREMENT mcb_pmsm_foc_hall_f28379d_B.ValidHalls.RelationalOperator "" UBYTE mcb_pmsm_foc_hall_f28379d_CM_logical 0 0 0 1 ECU_ADDRESS 0x0001EBE8 /end MEASUREMENT
/begin MEASUREMENT mcb_pmsm_foc_hall_f28379d_B.ValidHalls_h.Merge "" UWORD mcb_pmsm_foc_hall_f28379d_CM_uint16 0 0 0 65535 ECU_ADDRESS 0x0001EBD6 /end MEASUREMENT
/begin MEASUREMENT mcb_pmsm_foc_hall_f28379d_B.ValidHalls_h.Merge1 "" UWORD mcb_pmsm_foc_hall_f28379d_CM_uint16 0 0 0 65535 ECU_ADDRESS 0x0001EBD8 /end MEASUREMENT
/begin MEASUREMENT mcb_pmsm_foc_hall_f28379d_B.ValidHalls_h.Merge2 "" SWORD mcb_pmsm_foc_hall_f28379d_CM_int16 0 0 -32768 32767 ECU_ADDRESS 0x0001EBDC /end MEASUREMENT
/begin MEASUREMENT mcb_pmsm_foc_hall_f28379d_B.ValidHalls_h.Merge3 "" UWORD mcb_pmsm_foc_hall_f28379d_CM_uint16 0 0 0 65535 ECU_ADDRESS 0x0001EBDA /end MEASUREMENT
/begin MEASUREMENT mcb_pmsm_foc_hall_f28379d_B.ValidHalls_h.RelationalOperator "" UBYTE mcb_pmsm_foc_hall_f28379d_CM_logical 0 0 0 1 ECU_ADDRESS 0x0001EBDE /end MEASUREMENT
/begin MEASUREMENT mcb_pmsm_foc_hall_f28379d_B.ValidHalls_hi.Merge "" UWORD mcb_pmsm_foc_hall_f28379d_CM_uint16 0 0 0 65535 ECU_ADDRESS 0x0001EBCC /end MEASUREMENT
/begin MEASUREMENT mcb_pmsm_foc_hall_f28379d_B.ValidHalls_hi.Merge1 "" UWORD mcb_pmsm_foc_hall_f28379d_CM_uint16 0 0 0 65535 ECU_ADDRESS 0x0001EBCE /end MEASUREMENT
/begin MEASUREMENT mcb_pmsm_foc_hall_f28379d_B.ValidHalls_hi.Merge2 "" SWORD mcb_pmsm_foc_hall_f28379d_CM_int16 0 0 -32768 32767 ECU_ADDRESS 0x0001EBD2 /end MEASUREMENT
/begin MEASUREMENT mcb_pmsm_foc_hall_f28379d_B.ValidHalls_hi.Merge3 "" UWORD mcb_pmsm_foc_hall_f28379d_CM_uint16 0 0 0 65535 ECU_ADDRESS 0x0001EBD0 /end MEASUREMENT
/begin MEASUREMENT mcb_pmsm_foc_hall_f28379d_B.ValidHalls_hi.RelationalOperator "" UBYTE mcb_pmsm_foc_hall_f28379d_CM_logical 0 0 0 1 ECU_ADDRESS 0x0001EBD4 /end MEASUREMENT
/begin MEASUREMENT mcb_pmsm_foc_hall_f28379d_B.a_plus_2b "" FLOAT32_IEEE mcb_pmsm_foc_hall_f28379d_CM_single 0 0 -3.4E+38 3.4E+38 ECU_ADDRESS 0x0001EA88 /end MEASUREMENT
/begin MEASUREMENT mcb_pmsm_foc_hall_f28379d_B.acos_e "" FLOAT32_IEEE mcb_pmsm_foc_hall_f28379d_CM_single 0 0 -3.4E+38 3.4E+38 ECU_ADDRESS 0x0001E9F4 /end MEASUREMENT
/begin MEASUREMENT mcb_pmsm_foc_hall_f28379d_B.add_b "" FLOAT32_IEEE mcb_pmsm_foc_hall_f28379d_CM_single 0 0 -3.4E+38 3.4E+38 ECU_ADDRESS 0x0001E950 /end MEASUREMENT
/begin MEASUREMENT mcb_pmsm_foc_hall_f28379d_B.add_c "" FLOAT32_IEEE mcb_pmsm_foc_hall_f28379d_CM_single 0 0 -3.4E+38 3.4E+38 ECU_ADDRESS 0x0001E954 /end MEASUREMENT
/begin MEASUREMENT mcb_pmsm_foc_hall_f28379d_B.algDD_o1 "" FLOAT32_IEEE mcb_pmsm_foc_hall_f28379d_CM_single 0 0 -3.4E+38 3.4E+38 ECU_ADDRESS 0x0001EA14 /end MEASUREMENT
/begin MEASUREMENT mcb_pmsm_foc_hall_f28379d_B.algDD_o1_a "" FLOAT32_IEEE mcb_pmsm_foc_hall_f28379d_CM_single 0 0 -3.4E+38 3.4E+38 ECU_ADDRESS 0x0001EA90 /end MEASUREMENT
/begin MEASUREMENT mcb_pmsm_foc_hall_f28379d_B.algDD_o1_c "" FLOAT32_IEEE mcb_pmsm_foc_hall_f28379d_CM_single 0 0 -3.4E+38 3.4E+38 ECU_ADDRESS 0x0001EA3C /end MEASUREMENT
/begin MEASUREMENT mcb_pmsm_foc_hall_f28379d_B.algDD_o2 "" FLOAT32_IEEE mcb_pmsm_foc_hall_f28379d_CM_single 0 0 -3.4E+38 3.4E+38 ECU_ADDRESS 0x0001EA18 /end MEASUREMENT
/begin MEASUREMENT mcb_pmsm_foc_hall_f28379d_B.algDD_o2_e "" FLOAT32_IEEE mcb_pmsm_foc_hall_f28379d_CM_single 0 0 -3.4E+38 3.4E+38 ECU_ADDRESS 0x0001EA40 /end MEASUREMENT
/begin MEASUREMENT mcb_pmsm_foc_hall_f28379d_B.algDD_o2_n "" FLOAT32_IEEE mcb_pmsm_foc_hall_f28379d_CM_single 0 0 -3.4E+38 3.4E+38 ECU_ADDRESS 0x0001EA94 /end MEASUREMENT
/begin MEASUREMENT mcb_pmsm_foc_hall_f28379d_B.asin_j "" FLOAT32_IEEE mcb_pmsm_foc_hall_f28379d_CM_single 0 0 -3.4E+38 3.4E+38 ECU_ADDRESS 0x0001EA04 /end MEASUREMENT
/begin MEASUREMENT mcb_pmsm_foc_hall_f28379d_B.bcos "" FLOAT32_IEEE mcb_pmsm_foc_hall_f28379d_CM_single 0 0 -3.4E+38 3.4E+38 ECU_ADDRESS 0x0001EA00 /end MEASUREMENT
/begin MEASUREMENT mcb_pmsm_foc_hall_f28379d_B.bsin "" FLOAT32_IEEE mcb_pmsm_foc_hall_f28379d_CM_single 0 0 -3.4E+38 3.4E+38 ECU_ADDRESS 0x0001E9F8 /end MEASUREMENT
/begin MEASUREMENT mcb_pmsm_foc_hall_f28379d_B.countData "" FLOAT32_IEEE mcb_pmsm_foc_hall_f28379d_CM_single 0 0 -3.4E+38 3.4E+38 ECU_ADDRESS 0x0001E9BC /end MEASUREMENT
/begin MEASUREMENT mcb_pmsm_foc_hall_f28379d_B.countData_o "" FLOAT32_IEEE mcb_pmsm_foc_hall_f28379d_CM_single 0 0 -3.4E+38 3.4E+38 ECU_ADDRESS 0x0001E9C8 /end MEASUREMENT
/begin MEASUREMENT mcb_pmsm_foc_hall_f28379d_B.currentSpeedData "" FLOAT32_IEEE mcb_pmsm_foc_hall_f28379d_CM_single 0 0 -3.4E+38 3.4E+38 ECU_ADDRESS 0x0001E9A4 /end MEASUREMENT
/begin MEASUREMENT mcb_pmsm_foc_hall_f28379d_B.currentSpeedData_k "" FLOAT32_IEEE mcb_pmsm_foc_hall_f28379d_CM_single 0 0 -3.4E+38 3.4E+38 ECU_ADDRESS 0x0001E9C0 /end MEASUREMENT
/begin MEASUREMENT mcb_pmsm_foc_hall_f28379d_B.currentSpeedData_o "" FLOAT32_IEEE mcb_pmsm_foc_hall_f28379d_CM_single 0 0 -3.4E+38 3.4E+38 ECU_ADDRESS 0x0001E9D4 /end MEASUREMENT
/begin MEASUREMENT mcb_pmsm_foc_hall_f28379d_B.dcos "" FLOAT32_IEEE mcb_pmsm_foc_hall_f28379d_CM_single 0 0 -3.4E+38 3.4E+38 ECU_ADDRESS 0x0001EA28 /end MEASUREMENT
/begin MEASUREMENT mcb_pmsm_foc_hall_f28379d_B.dsin "" FLOAT32_IEEE mcb_pmsm_foc_hall_f28379d_CM_single 0 0 -3.4E+38 3.4E+38 ECU_ADDRESS 0x0001EA20 /end MEASUREMENT
/begin MEASUREMENT mcb_pmsm_foc_hall_f28379d_B.eCAP "" ULONG mcb_pmsm_foc_hall_f28379d_CM_uint32 0 0 0 4294967295 ARRAY_SIZE 2 ECU_ADDRESS 0x0001E724 /end MEASUREMENT
/begin MEASUREMENT mcb_pmsm_foc_hall_f28379d_B.eCAP_c "" ULONG mcb_pmsm_foc_hall_f28379d_CM_uint32 0 0 0 4294967295 ARRAY_SIZE 2 ECU_ADDRESS 0x0001E754 /end MEASUREMENT
/begin MEASUREMENT mcb_pmsm_foc_hall_f28379d_B.eCAP_l "" ULONG mcb_pmsm_foc_hall_f28379d_CM_uint32 0 0 0 4294967295 ARRAY_SIZE 2 ECU_ADDRESS 0x0001E784 /end MEASUREMENT
/begin MEASUREMENT mcb_pmsm_foc_hall_f28379d_B.fixforDTpropagationissue "" UBYTE mcb_pmsm_foc_hall_f28379d_CM_logical 0 0 0 1 ECU_ADDRESS 0x0001EB50 /end MEASUREMENT
/begin MEASUREMENT mcb_pmsm_foc_hall_f28379d_B.fixforDTpropagationissue1 "" UBYTE mcb_pmsm_foc_hall_f28379d_CM_logical 0 0 0 1 ECU_ADDRESS 0x0001EB52 /end MEASUREMENT
/begin MEASUREMENT mcb_pmsm_foc_hall_f28379d_B.fixforDTpropagationissue1_h "" UBYTE mcb_pmsm_foc_hall_f28379d_CM_logical 0 0 0 1 ECU_ADDRESS 0x0001EB5C /end MEASUREMENT
/begin MEASUREMENT mcb_pmsm_foc_hall_f28379d_B.fixforDTpropagationissue_b "" UBYTE mcb_pmsm_foc_hall_f28379d_CM_logical 0 0 0 1 ECU_ADDRESS 0x0001EB5A /end MEASUREMENT
/begin MEASUREMENT mcb_pmsm_foc_hall_f28379d_B.indexing "" FLOAT32_IEEE mcb_pmsm_foc_hall_f28379d_CM_single 0 0 -3.4E+38 3.4E+38 ECU_ADDRESS 0x0001E878 /end MEASUREMENT
/begin MEASUREMENT mcb_pmsm_foc_hall_f28379d_B.indexing_i "" FLOAT32_IEEE mcb_pmsm_foc_hall_f28379d_CM_single 0 0 -3.4E+38 3.4E+38 ECU_ADDRESS 0x0001E914 /end MEASUREMENT
/begin MEASUREMENT mcb_pmsm_foc_hall_f28379d_B.one_by_sqrt3 "" FLOAT32_IEEE mcb_pmsm_foc_hall_f28379d_CM_single 0 0 -3.4E+38 3.4E+38 ECU_ADDRESS 0x0001EA8C /end MEASUREMENT
/begin MEASUREMENT mcb_pmsm_foc_hall_f28379d_B.one_by_two "" FLOAT32_IEEE mcb_pmsm_foc_hall_f28379d_CM_single 0 0 -3.4E+38 3.4E+38 ECU_ADDRESS 0x0001E948 /end MEASUREMENT
/begin MEASUREMENT mcb_pmsm_foc_hall_f28379d_B.one_by_two_b "" FLOAT32_IEEE mcb_pmsm_foc_hall_f28379d_CM_single 0 0 -3.4E+38 3.4E+38 ECU_ADDRESS 0x0001E964 /end MEASUREMENT
/begin MEASUREMENT mcb_pmsm_foc_hall_f28379d_B.previousSpeedData "" FLOAT32_IEEE mcb_pmsm_foc_hall_f28379d_CM_single 0 0 -3.4E+38 3.4E+38 ECU_ADDRESS 0x0001E9CC /end MEASUREMENT
/begin MEASUREMENT mcb_pmsm_foc_hall_f28379d_B.qcos "" FLOAT32_IEEE mcb_pmsm_foc_hall_f28379d_CM_single 0 0 -3.4E+38 3.4E+38 ECU_ADDRESS 0x0001EA1C /end MEASUREMENT
/begin MEASUREMENT mcb_pmsm_foc_hall_f28379d_B.qsin "" FLOAT32_IEEE mcb_pmsm_foc_hall_f28379d_CM_single 0 0 -3.4E+38 3.4E+38 ECU_ADDRESS 0x0001EA2C /end MEASUREMENT
/begin MEASUREMENT mcb_pmsm_foc_hall_f28379d_B.speedCountDelay "" ULONG mcb_pmsm_foc_hall_f28379d_CM_uint32 0 0 0 4294967295 ECU_ADDRESS 0x0001E790 /end MEASUREMENT
/begin MEASUREMENT mcb_pmsm_foc_hall_f28379d_B.speedcheck "" UWORD mcb_pmsm_foc_hall_f28379d_CM_uint16 0 0 0 65535 ECU_ADDRESS 0x0001EB02 /end MEASUREMENT
/begin MEASUREMENT mcb_pmsm_foc_hall_f28379d_B.sqrt3_by_two "" FLOAT32_IEEE mcb_pmsm_foc_hall_f28379d_CM_single 0 0 -3.4E+38 3.4E+38 ECU_ADDRESS 0x0001E94C /end MEASUREMENT
/begin MEASUREMENT mcb_pmsm_foc_hall_f28379d_B.sum_Ds "" FLOAT32_IEEE mcb_pmsm_foc_hall_f28379d_CM_single 0 0 -3.4E+38 3.4E+38 ECU_ADDRESS 0x0001E9FC /end MEASUREMENT
/begin MEASUREMENT mcb_pmsm_foc_hall_f28379d_B.sum_Qs "" FLOAT32_IEEE mcb_pmsm_foc_hall_f28379d_CM_single 0 0 -3.4E+38 3.4E+38 ECU_ADDRESS 0x0001EA08 /end MEASUREMENT
/begin MEASUREMENT mcb_pmsm_foc_hall_f28379d_B.sum_alpha "" FLOAT32_IEEE mcb_pmsm_foc_hall_f28379d_CM_single 0 0 -3.4E+38 3.4E+38 ECU_ADDRESS 0x0001EA30 /end MEASUREMENT
/begin MEASUREMENT mcb_pmsm_foc_hall_f28379d_B.sum_beta "" FLOAT32_IEEE mcb_pmsm_foc_hall_f28379d_CM_single 0 0 -3.4E+38 3.4E+38 ECU_ADDRESS 0x0001EA24 /end MEASUREMENT
/begin MEASUREMENT mcb_pmsm_foc_hall_f28379d_B.validityDelay "" UBYTE mcb_pmsm_foc_hall_f28379d_CM_logical 0 0 0 1 ECU_ADDRESS 0x0001EB3C /end MEASUREMENT
/begin MEASUREMENT mcb_pmsm_foc_hall_f28379d_B.watchdogcheck "" UWORD mcb_pmsm_foc_hall_f28379d_CM_uint16 0 0 0 65535 ECU_ADDRESS 0x0001EAE0 /end MEASUREMENT
/begin MEASUREMENT mcb_pmsm_foc_hall_f28379d_DWork.ADCGainSetting_SubsysRanBC "" SBYTE mcb_pmsm_foc_hall_f28379d_CM_int8 0 0 -128 127 ECU_ADDRESS 0x0001E5FC /end MEASUREMENT
/begin MEASUREMENT mcb_pmsm_foc_hall_f28379d_DWork.Add_DWORK1 "" SLONG mcb_pmsm_foc_hall_f28379d_CM_int32 0 0 -2147483648 2147483647 ARRAY_SIZE 2 ECU_ADDRESS 0x0001E5B8 /end MEASUREMENT
/begin MEASUREMENT mcb_pmsm_foc_hall_f28379d_DWork.Badhallglitchorwrongconnectio_c.Badhallglitchorwrongconnection_ "" SBYTE mcb_pmsm_foc_hall_f28379d_CM_int8 0 0 -128 127 ECU_ADDRESS 0x0001E6A4 /end MEASUREMENT
/begin MEASUREMENT mcb_pmsm_foc_hall_f28379d_DWork.Badhallglitchorwrongconnectio_o.Badhallglitchorwrongconnection_ "" SBYTE mcb_pmsm_foc_hall_f28379d_CM_int8 0 0 -128 127 ECU_ADDRESS 0x0001E688 /end MEASUREMENT
/begin MEASUREMENT mcb_pmsm_foc_hall_f28379d_DWork.Badhallglitchorwrongconnection.Badhallglitchorwrongconnection_ "" SBYTE mcb_pmsm_foc_hall_f28379d_CM_int8 0 0 -128 127 ECU_ADDRESS 0x0001E6C0 /end MEASUREMENT
/begin MEASUREMENT mcb_pmsm_foc_hall_f28379d_DWork.CalculateADCOffset_SubsysRanBC "" SBYTE mcb_pmsm_foc_hall_f28379d_CM_int8 0 0 -128 127 ECU_ADDRESS 0x0001E5FE /end MEASUREMENT
/begin MEASUREMENT mcb_pmsm_foc_hall_f28379d_DWork.CurrentControl_SubsysRanBC "" SBYTE mcb_pmsm_foc_hall_f28379d_CM_int8 0 0 -128 127 ECU_ADDRESS 0x0001E612 /end MEASUREMENT
/begin MEASUREMENT mcb_pmsm_foc_hall_f28379d_DWork.DQAxisPriority_SubsysRanBC "" SBYTE mcb_pmsm_foc_hall_f28379d_CM_int8 0 0 -128 127 ECU_ADDRESS 0x0001E64C /end MEASUREMENT
/begin MEASUREMENT mcb_pmsm_foc_hall_f28379d_DWork.DQEquivalence_SubsysRanBC "" SBYTE mcb_pmsm_foc_hall_f28379d_CM_int8 0 0 -128 127 ECU_ADDRESS 0x0001E646 /end MEASUREMENT
/begin MEASUREMENT mcb_pmsm_foc_hall_f28379d_DWork.DRV830xEnable_FRAC_LEN "" SLONG mcb_pmsm_foc_hall_f28379d_CM_int32 0 0 -2147483648 2147483647 ECU_ADDRESS 0x0001E5B4 /end MEASUREMENT
/begin MEASUREMENT mcb_pmsm_foc_hall_f28379d_DWork.Debug_signals "" UWORD mcb_pmsm_foc_hall_f28379d_CM_uint16 0 0 0 65535 ECU_ADDRESS 0x0001E5F2 /end MEASUREMENT
/begin MEASUREMENT mcb_pmsm_foc_hall_f28379d_DWork.DefaultADCOffset_SubsysRanBC "" SBYTE mcb_pmsm_foc_hall_f28379d_CM_int8 0 0 -128 127 ECU_ADDRESS 0x0001E5FA /end MEASUREMENT
/begin MEASUREMENT mcb_pmsm_foc_hall_f28379d_DWork.DelayOneStep1_DSTATE "" UBYTE mcb_pmsm_foc_hall_f28379d_CM_logical 0 0 0 1 ECU_ADDRESS 0x0001E5F8 /end MEASUREMENT
/begin MEASUREMENT mcb_pmsm_foc_hall_f28379d_DWork.DelayOneStep_DSTATE "" UWORD mcb_pmsm_foc_hall_f28379d_CM_uint16 0 0 0 65535 ECU_ADDRESS 0x0001E5DC /end MEASUREMENT
/begin MEASUREMENT mcb_pmsm_foc_hall_f28379d_DWork.DigitalOutput2_FRAC_LEN "" SLONG mcb_pmsm_foc_hall_f28379d_CM_int32 0 0 -2147483648 2147483647 ECU_ADDRESS 0x0001E5B0
 /begin IF_DATA XCP
  /begin DAQ_EVENT VARIABLE /begin DEFAULT_EVENT_LIST EVENT 0x0001 /end DEFAULT_EVENT_LIST /end DAQ_EVENT
 /end IF_DATA
/end MEASUREMENT
/begin MEASUREMENT mcb_pmsm_foc_hall_f28379d_DWork.Enable "" UBYTE mcb_pmsm_foc_hall_f28379d_CM_logical 0 0 0 1 ECU_ADDRESS 0x0001E652
 /begin IF_DATA XCP
  /begin DAQ_EVENT VARIABLE /begin DEFAULT_EVENT_LIST EVENT 0x0000 /end DEFAULT_EVENT_LIST /end DAQ_EVENT
 /end IF_DATA
/end MEASUREMENT
/begin MEASUREMENT mcb_pmsm_foc_hall_f28379d_DWork.FunctionCallSubsystem1_SubsysRa "" SBYTE mcb_pmsm_foc_hall_f28379d_CM_int8 0 0 -128 127 ECU_ADDRESS 0x0001E642 /end MEASUREMENT
/begin MEASUREMENT mcb_pmsm_foc_hall_f28379d_DWork.FunctionCallSubsystem_SubsysRan "" SBYTE mcb_pmsm_foc_hall_f28379d_CM_int8 0 0 -128 127 ECU_ADDRESS 0x0001E644 /end MEASUREMENT
/begin MEASUREMENT mcb_pmsm_foc_hall_f28379d_DWork.GlobalDirection "" SWORD mcb_pmsm_foc_hall_f28379d_CM_int16 0 0 -32768 32767 ECU_ADDRESS 0x0001E5E8
 /begin IF_DATA XCP
  /begin DAQ_EVENT VARIABLE /begin DEFAULT_EVENT_LIST EVENT 0x0000 /end DEFAULT_EVENT_LIST /end DAQ_EVENT
 /end IF_DATA
/end MEASUREMENT
/begin MEASUREMENT mcb_pmsm_foc_hall_f28379d_DWork.GlobalHallState "" ULONG mcb_pmsm_foc_hall_f28379d_CM_uint32 0 0 0 4294967295 ECU_ADDRESS 0x0001E5C8
 /begin IF_DATA XCP
  /begin DAQ_EVENT VARIABLE /begin DEFAULT_EVENT_LIST EVENT 0x0000 /end DEFAULT_EVENT_LIST /end DAQ_EVENT
 /end IF_DATA
/end MEASUREMENT
/begin MEASUREMENT mcb_pmsm_foc_hall_f28379d_DWork.GlobalSpeedCount "" ULONG mcb_pmsm_foc_hall_f28379d_CM_uint32 0 0 0 4294967295 ECU_ADDRESS 0x0001E5C4
 /begin IF_DATA XCP
  /begin DAQ_EVENT VARIABLE /begin DEFAULT_EVENT_LIST EVENT 0x0000 /end DEFAULT_EVENT_LIST /end DAQ_EVENT
 /end IF_DATA
/end MEASUREMENT
/begin MEASUREMENT mcb_pmsm_foc_hall_f28379d_DWork.GlobalSpeedValidity "" UWORD mcb_pmsm_foc_hall_f28379d_CM_uint16 0 0 0 65535 ECU_ADDRESS 0x0001E5EC
 /begin IF_DATA XCP
  /begin DAQ_EVENT VARIABLE /begin DEFAULT_EVENT_LIST EVENT 0x0000 /end DEFAULT_EVENT_LIST /end DAQ_EVENT
 /end IF_DATA
/end MEASUREMENT
/begin MEASUREMENT mcb_pmsm_foc_hall_f28379d_DWork.HallSensorA_SubsysRanBC "" SBYTE mcb_pmsm_foc_hall_f28379d_CM_int8 0 0 -128 127 ECU_ADDRESS 0x0001E610 /end MEASUREMENT
/begin MEASUREMENT mcb_pmsm_foc_hall_f28379d_DWork.HallSensorB_SubsysRanBC "" SBYTE mcb_pmsm_foc_hall_f28379d_CM_int8 0 0 -128 127 ECU_ADDRESS 0x0001E60E /end MEASUREMENT
/begin MEASUREMENT mcb_pmsm_foc_hall_f28379d_DWork.HallSensorC_SubsysRanBC "" SBYTE mcb_pmsm_foc_hall_f28379d_CM_int8 0 0 -128 127 ECU_ADDRESS 0x0001E60C /end MEASUREMENT
/begin MEASUREMENT mcb_pmsm_foc_hall_f28379d_DWork.HallStateChangeFlag "" UWORD mcb_pmsm_foc_hall_f28379d_CM_uint16 0 0 0 65535 ECU_ADDRESS 0x0001E5EA
 /begin IF_DATA XCP
  /begin DAQ_EVENT VARIABLE /begin DEFAULT_EVENT_LIST EVENT 0x0000 /end DEFAULT_EVENT_LIST /end DAQ_EVENT
 /end IF_DATA
/end MEASUREMENT
/begin MEASUREMENT mcb_pmsm_foc_hall_f28379d_DWork.HallValueof1.HallValueof1_SubsysRanBC "" SBYTE mcb_pmsm_foc_hall_f28379d_CM_int8 0 0 -128 127 ECU_ADDRESS 0x0001E6F6 /end MEASUREMENT
/begin MEASUREMENT mcb_pmsm_foc_hall_f28379d_DWork.HallValueof1_SubsysRanBC "" SBYTE mcb_pmsm_foc_hall_f28379d_CM_int8 0 0 -128 127 ECU_ADDRESS 0x0001E62A /end MEASUREMENT
/begin MEASUREMENT mcb_pmsm_foc_hall_f28379d_DWork.HallValueof1_e.HallValueof7_SubsysRanBC "" SBYTE mcb_pmsm_foc_hall_f28379d_CM_int8 0 0 -128 127 ECU_ADDRESS 0x0001E6EA /end MEASUREMENT
/begin MEASUREMENT mcb_pmsm_foc_hall_f28379d_DWork.HallValueof2.HallValueof2_SubsysRanBC "" SBYTE mcb_pmsm_foc_hall_f28379d_CM_int8 0 0 -128 127 ECU_ADDRESS 0x0001E6F4 /end MEASUREMENT
/begin MEASUREMENT mcb_pmsm_foc_hall_f28379d_DWork.HallValueof2_SubsysRanBC "" SBYTE mcb_pmsm_foc_hall_f28379d_CM_int8 0 0 -128 127 ECU_ADDRESS 0x0001E628 /end MEASUREMENT
/begin MEASUREMENT mcb_pmsm_foc_hall_f28379d_DWork.HallValueof2_o.HallValueof1_SubsysRanBC "" SBYTE mcb_pmsm_foc_hall_f28379d_CM_int8 0 0 -128 127 ECU_ADDRESS 0x0001E6E8 /end MEASUREMENT
/begin MEASUREMENT mcb_pmsm_foc_hall_f28379d_DWork.HallValueof3.HallValueof3_SubsysRanBC "" SBYTE mcb_pmsm_foc_hall_f28379d_CM_int8 0 0 -128 127 ECU_ADDRESS 0x0001E6F2 /end MEASUREMENT
/begin MEASUREMENT mcb_pmsm_foc_hall_f28379d_DWork.HallValueof3_SubsysRanBC "" SBYTE mcb_pmsm_foc_hall_f28379d_CM_int8 0 0 -128 127 ECU_ADDRESS 0x0001E626 /end MEASUREMENT
/begin MEASUREMENT mcb_pmsm_foc_hall_f28379d_DWork.HallValueof3_g.HallValueof2_SubsysRanBC "" SBYTE mcb_pmsm_foc_hall_f28379d_CM_int8 0 0 -128 127 ECU_ADDRESS 0x0001E6E6 /end MEASUREMENT
/begin MEASUREMENT mcb_pmsm_foc_hall_f28379d_DWork.HallValueof4.HallValueof4_SubsysRanBC "" SBYTE mcb_pmsm_foc_hall_f28379d_CM_int8 0 0 -128 127 ECU_ADDRESS 0x0001E6F0 /end MEASUREMENT
/begin MEASUREMENT mcb_pmsm_foc_hall_f28379d_DWork.HallValueof4_SubsysRanBC "" SBYTE mcb_pmsm_foc_hall_f28379d_CM_int8 0 0 -128 127 ECU_ADDRESS 0x0001E624 /end MEASUREMENT
/begin MEASUREMENT mcb_pmsm_foc_hall_f28379d_DWork.HallValueof4_o.HallValueof3_SubsysRanBC "" SBYTE mcb_pmsm_foc_hall_f28379d_CM_int8 0 0 -128 127 ECU_ADDRESS 0x0001E6E4 /end MEASUREMENT
/begin MEASUREMENT mcb_pmsm_foc_hall_f28379d_DWork.HallValueof5.HallValueof5_SubsysRanBC "" SBYTE mcb_pmsm_foc_hall_f28379d_CM_int8 0 0 -128 127 ECU_ADDRESS 0x0001E6EE /end MEASUREMENT
/begin MEASUREMENT mcb_pmsm_foc_hall_f28379d_DWork.HallValueof5_SubsysRanBC "" SBYTE mcb_pmsm_foc_hall_f28379d_CM_int8 0 0 -128 127 ECU_ADDRESS 0x0001E622 /end MEASUREMENT
/begin MEASUREMENT mcb_pmsm_foc_hall_f28379d_DWork.HallValueof5_o.HallValueof4_SubsysRanBC "" SBYTE mcb_pmsm_foc_hall_f28379d_CM_int8 0 0 -128 127 ECU_ADDRESS 0x0001E6E2 /end MEASUREMENT
/begin MEASUREMENT mcb_pmsm_foc_hall_f28379d_DWork.HallValueof6_SubsysRanBC "" SBYTE mcb_pmsm_foc_hall_f28379d_CM_int8 0 0 -128 127 ECU_ADDRESS 0x0001E620 /end MEASUREMENT
/begin MEASUREMENT mcb_pmsm_foc_hall_f28379d_DWork.HallValueof6_SubsysRanBC_d "" SBYTE mcb_pmsm_foc_hall_f28379d_CM_int8 0 0 -128 127 ECU_ADDRESS 0x0001E638 /end MEASUREMENT
/begin MEASUREMENT mcb_pmsm_foc_hall_f28379d_DWork.HallValueof6_c.HallValueof5_SubsysRanBC "" SBYTE mcb_pmsm_foc_hall_f28379d_CM_int8 0 0 -128 127 ECU_ADDRESS 0x0001E6E0 /end MEASUREMENT
/begin MEASUREMENT mcb_pmsm_foc_hall_f28379d_DWork.HallValueof7.HallValueof7_SubsysRanBC "" SBYTE mcb_pmsm_foc_hall_f28379d_CM_int8 0 0 -128 127 ECU_ADDRESS 0x0001E6EC /end MEASUREMENT
/begin MEASUREMENT mcb_pmsm_foc_hall_f28379d_DWork.HallValueof7_b.HallValueof7_SubsysRanBC "" SBYTE mcb_pmsm_foc_hall_f28379d_CM_int8 0 0 -128 127 ECU_ADDRESS 0x0001E6DE /end MEASUREMENT
/begin MEASUREMENT mcb_pmsm_foc_hall_f28379d_DWork.HallValueof7_n.HallValueof7_SubsysRanBC "" SBYTE mcb_pmsm_foc_hall_f28379d_CM_int8 0 0 -128 127 ECU_ADDRESS 0x0001E6DC /end MEASUREMENT
/begin MEASUREMENT mcb_pmsm_foc_hall_f28379d_DWork.IaOffset "" UWORD mcb_pmsm_foc_hall_f28379d_CM_uint16 0 0 0 65535 ECU_ADDRESS 0x0001E5EE /end MEASUREMENT
/begin MEASUREMENT mcb_pmsm_foc_hall_f28379d_DWork.IbOffset "" UWORD mcb_pmsm_foc_hall_f28379d_CM_uint16 0 0 0 65535 ECU_ADDRESS 0x0001E5F0 /end MEASUREMENT
/begin MEASUREMENT mcb_pmsm_foc_hall_f28379d_DWork.IfActionSubsystem.IfActionSubsystem_SubsysRanBC "" SBYTE mcb_pmsm_foc_hall_f28379d_CM_int8 0 0 -128 127 ECU_ADDRESS 0x0001E6FE /end MEASUREMENT
/begin MEASUREMENT mcb_pmsm_foc_hall_f28379d_DWork.IfActionSubsystem1.IfActionSubsystem1_SubsysRanBC "" SBYTE mcb_pmsm_foc_hall_f28379d_CM_int8 0 0 -128 127 ECU_ADDRESS 0x0001E6FC /end MEASUREMENT
/begin MEASUREMENT mcb_pmsm_foc_hall_f28379d_DWork.IfActionSubsystem1_SubsysRanBC "" SBYTE mcb_pmsm_foc_hall_f28379d_CM_int8 0 0 -128 127 ECU_ADDRESS 0x0001E604 /end MEASUREMENT
/begin MEASUREMENT mcb_pmsm_foc_hall_f28379d_DWork.IfActionSubsystem1_SubsysRanB_h "" SBYTE mcb_pmsm_foc_hall_f28379d_CM_int8 0 0 -128 127 ECU_ADDRESS 0x0001E61A /end MEASUREMENT
/begin MEASUREMENT mcb_pmsm_foc_hall_f28379d_DWork.IfActionSubsystem1_SubsysRanB_o "" SBYTE mcb_pmsm_foc_hall_f28379d_CM_int8 0 0 -128 127 ECU_ADDRESS 0x0001E63A /end MEASUREMENT
/begin MEASUREMENT mcb_pmsm_foc_hall_f28379d_DWork.IfActionSubsystem1_i.IfActionSubsystem1_SubsysRanBC "" SBYTE mcb_pmsm_foc_hall_f28379d_CM_int8 0 0 -128 127 ECU_ADDRESS 0x0001E6F8 /end MEASUREMENT
/begin MEASUREMENT mcb_pmsm_foc_hall_f28379d_DWork.IfActionSubsystem2_SubsysRanBC "" SBYTE mcb_pmsm_foc_hall_f28379d_CM_int8 0 0 -128 127 ECU_ADDRESS 0x0001E602 /end MEASUREMENT
/begin MEASUREMENT mcb_pmsm_foc_hall_f28379d_DWork.IfActionSubsystem3_SubsysRanBC "" SBYTE mcb_pmsm_foc_hall_f28379d_CM_int8 0 0 -128 127 ECU_ADDRESS 0x0001E600 /end MEASUREMENT
/begin MEASUREMENT mcb_pmsm_foc_hall_f28379d_DWork.IfActionSubsystem_SubsysRanBC "" SBYTE mcb_pmsm_foc_hall_f28379d_CM_int8 0 0 -128 127 ECU_ADDRESS 0x0001E606 /end MEASUREMENT
/begin MEASUREMENT mcb_pmsm_foc_hall_f28379d_DWork.IfActionSubsystem_SubsysRanBC_b "" SBYTE mcb_pmsm_foc_hall_f28379d_CM_int8 0 0 -128 127 ECU_ADDRESS 0x0001E608 /end MEASUREMENT
/begin MEASUREMENT mcb_pmsm_foc_hall_f28379d_DWork.IfActionSubsystem_SubsysRanBC_c "" SBYTE mcb_pmsm_foc_hall_f28379d_CM_int8 0 0 -128 127 ECU_ADDRESS 0x0001E63C /end MEASUREMENT
/begin MEASUREMENT mcb_pmsm_foc_hall_f28379d_DWork.IfActionSubsystem_SubsysRanBC_d "" SBYTE mcb_pmsm_foc_hall_f28379d_CM_int8 0 0 -128 127 ECU_ADDRESS 0x0001E61C /end MEASUREMENT
/begin MEASUREMENT mcb_pmsm_foc_hall_f28379d_DWork.IfActionSubsystem_n.IfActionSubsystem_SubsysRanBC "" SBYTE mcb_pmsm_foc_hall_f28379d_CM_int8 0 0 -128 127 ECU_ADDRESS 0x0001E6FA /end MEASUREMENT
/begin MEASUREMENT mcb_pmsm_foc_hall_f28379d_DWork.Integrator_DSTATE "" FLOAT32_IEEE mcb_pmsm_foc_hall_f28379d_CM_single 0 0 -3.4E+38 3.4E+38 ECU_ADDRESS 0x0001E580 /end MEASUREMENT
/begin MEASUREMENT mcb_pmsm_foc_hall_f28379d_DWork.Integrator_DSTATE_j "" FLOAT32_IEEE mcb_pmsm_foc_hall_f28379d_CM_single 0 0 -3.4E+38 3.4E+38 ECU_ADDRESS 0x0001E584 /end MEASUREMENT
/begin MEASUREMENT mcb_pmsm_foc_hall_f28379d_DWork.Integrator_PrevResetState "" SBYTE mcb_pmsm_foc_hall_f28379d_CM_int8 0 0 -128 127 ECU_ADDRESS 0x0001E614 /end MEASUREMENT
/begin MEASUREMENT mcb_pmsm_foc_hall_f28379d_DWork.Integrator_PrevResetState_m "" SBYTE mcb_pmsm_foc_hall_f28379d_CM_int8 0 0 -128 127 ECU_ADDRESS 0x0001E616 /end MEASUREMENT
/begin MEASUREMENT mcb_pmsm_foc_hall_f28379d_DWork.InverterEnable_FRAC_LEN "" SLONG mcb_pmsm_foc_hall_f28379d_CM_int32 0 0 -2147483648 2147483647 ECU_ADDRESS 0x0001E5C0 /end MEASUREMENT
/begin MEASUREMENT mcb_pmsm_foc_hall_f28379d_DWork.Limiter_SubsysRanBC "" SBYTE mcb_pmsm_foc_hall_f28379d_CM_int8 0 0 -128 127 ECU_ADDRESS 0x0001E64A /end MEASUREMENT
/begin MEASUREMENT mcb_pmsm_foc_hall_f28379d_DWork.Memory1_PreviousInput "" UWORD mcb_pmsm_foc_hall_f28379d_CM_uint16 0 0 0 65535 ECU_ADDRESS 0x0001E5F6 /end MEASUREMENT
/begin MEASUREMENT mcb_pmsm_foc_hall_f28379d_DWork.Memory_PreviousInput "" UWORD mcb_pmsm_foc_hall_f28379d_CM_uint16 0 0 0 65535 ECU_ADDRESS 0x0001E5F4 /end MEASUREMENT
/begin MEASUREMENT mcb_pmsm_foc_hall_f28379d_DWork.No_Integrity_issue_SubsysRanBC "" SBYTE mcb_pmsm_foc_hall_f28379d_CM_int8 0 0 -128 127 ECU_ADDRESS 0x0001E640 /end MEASUREMENT
/begin MEASUREMENT mcb_pmsm_foc_hall_f28379d_DWork.Output0.Output0_SubsysRanBC "" SBYTE mcb_pmsm_foc_hall_f28379d_CM_int8 0 0 -128 127 ECU_ADDRESS 0x0001E6D8 /end MEASUREMENT
/begin MEASUREMENT mcb_pmsm_foc_hall_f28379d_DWork.Output0_i.Output0_SubsysRanBC "" SBYTE mcb_pmsm_foc_hall_f28379d_CM_int8 0 0 -128 127 ECU_ADDRESS 0x0001E6A0 /end MEASUREMENT
/begin MEASUREMENT mcb_pmsm_foc_hall_f28379d_DWork.Output0_p.Output0_SubsysRanBC "" SBYTE mcb_pmsm_foc_hall_f28379d_CM_int8 0 0 -128 127 ECU_ADDRESS 0x0001E6BC /end MEASUREMENT
/begin MEASUREMENT mcb_pmsm_foc_hall_f28379d_DWork.Output1.Output1_SubsysRanBC "" SBYTE mcb_pmsm_foc_hall_f28379d_CM_int8 0 0 -128 127 ECU_ADDRESS 0x0001E6DA /end MEASUREMENT
/begin MEASUREMENT mcb_pmsm_foc_hall_f28379d_DWork.Output1_g.Output1_SubsysRanBC "" SBYTE mcb_pmsm_foc_hall_f28379d_CM_int8 0 0 -128 127 ECU_ADDRESS 0x0001E6A2 /end MEASUREMENT
/begin MEASUREMENT mcb_pmsm_foc_hall_f28379d_DWork.Output1_n.Output1_SubsysRanBC "" SBYTE mcb_pmsm_foc_hall_f28379d_CM_int8 0 0 -128 127 ECU_ADDRESS 0x0001E6BE /end MEASUREMENT
/begin MEASUREMENT mcb_pmsm_foc_hall_f28379d_DWork.Passthrough_SubsysRanBC "" SBYTE mcb_pmsm_foc_hall_f28379d_CM_int8 0 0 -128 127 ECU_ADDRESS 0x0001E648 /end MEASUREMENT
/begin MEASUREMENT mcb_pmsm_foc_hall_f28379d_DWork.RT1_ActiveBufIdx "" SWORD mcb_pmsm_foc_hall_f28379d_CM_int16 0 0 -32768 32767 ECU_ADDRESS 0x0001E5DE
 /begin IF_DATA XCP
  /begin DAQ_EVENT VARIABLE /begin DEFAULT_EVENT_LIST EVENT 0x0000 /end DEFAULT_EVENT_LIST /end DAQ_EVENT
 /end IF_DATA
/end MEASUREMENT
/begin MEASUREMENT mcb_pmsm_foc_hall_f28379d_DWork.RT1_Buffer "" FLOAT32_IEEE mcb_pmsm_foc_hall_f28379d_CM_single 0 0 -3.4E+38 3.4E+38 ARRAY_SIZE 2 ECU_ADDRESS 0x0001E58C
 /begin IF_DATA XCP
  /begin DAQ_EVENT VARIABLE /begin DEFAULT_EVENT_LIST EVENT 0x0000 /end DEFAULT_EVENT_LIST /end DAQ_EVENT
 /end IF_DATA
/end MEASUREMENT
/begin MEASUREMENT mcb_pmsm_foc_hall_f28379d_DWork.RT1_semaphoreTaken "" SWORD mcb_pmsm_foc_hall_f28379d_CM_int16 0 0 -32768 32767 ECU_ADDRESS 0x0001E5E0
 /begin IF_DATA XCP
  /begin DAQ_EVENT VARIABLE /begin DEFAULT_EVENT_LIST EVENT 0x0000 /end DEFAULT_EVENT_LIST /end DAQ_EVENT
 /end IF_DATA
/end MEASUREMENT
/begin MEASUREMENT mcb_pmsm_foc_hall_f28379d_DWork.RT2_ActiveBufIdx "" SWORD mcb_pmsm_foc_hall_f28379d_CM_int16 0 0 -32768 32767 ECU_ADDRESS 0x0001E5E6
 /begin IF_DATA XCP
  /begin DAQ_EVENT VARIABLE /begin DEFAULT_EVENT_LIST EVENT 0x0000 /end DEFAULT_EVENT_LIST /end DAQ_EVENT
 /end IF_DATA
/end MEASUREMENT
/begin MEASUREMENT mcb_pmsm_foc_hall_f28379d_DWork.RT2_Buffer "" FLOAT32_IEEE mcb_pmsm_foc_hall_f28379d_CM_single 0 0 -3.4E+38 3.4E+38 ARRAY_SIZE 4 ECU_ADDRESS 0x0001E59C
 /begin IF_DATA XCP
  /begin DAQ_EVENT VARIABLE /begin DEFAULT_EVENT_LIST EVENT 0x0000 /end DEFAULT_EVENT_LIST /end DAQ_EVENT
 /end IF_DATA
/end MEASUREMENT
/begin MEASUREMENT mcb_pmsm_foc_hall_f28379d_DWork.RT6_ActiveBufIdx "" SWORD mcb_pmsm_foc_hall_f28379d_CM_int16 0 0 -32768 32767 ECU_ADDRESS 0x0001E5E2
 /begin IF_DATA XCP
  /begin DAQ_EVENT VARIABLE /begin DEFAULT_EVENT_LIST EVENT 0x0000 /end DEFAULT_EVENT_LIST /end DAQ_EVENT
 /end IF_DATA
/end MEASUREMENT
/begin MEASUREMENT mcb_pmsm_foc_hall_f28379d_DWork.RT6_Buffer "" FLOAT32_IEEE mcb_pmsm_foc_hall_f28379d_CM_single 0 0 -3.4E+38 3.4E+38 ARRAY_SIZE 2 ECU_ADDRESS 0x0001E594
 /begin IF_DATA XCP
  /begin DAQ_EVENT VARIABLE /begin DEFAULT_EVENT_LIST EVENT 0x0000 /end DEFAULT_EVENT_LIST /end DAQ_EVENT
 /end IF_DATA
/end MEASUREMENT
/begin MEASUREMENT mcb_pmsm_foc_hall_f28379d_DWork.RT6_semaphoreTaken "" SWORD mcb_pmsm_foc_hall_f28379d_CM_int16 0 0 -32768 32767 ECU_ADDRESS 0x0001E5E4
 /begin IF_DATA XCP
  /begin DAQ_EVENT VARIABLE /begin DEFAULT_EVENT_LIST EVENT 0x0000 /end DEFAULT_EVENT_LIST /end DAQ_EVENT
 /end IF_DATA
/end MEASUREMENT
/begin MEASUREMENT mcb_pmsm_foc_hall_f28379d_DWork.Refresh_Halls_SubsysRanBC "" SBYTE mcb_pmsm_foc_hall_f28379d_CM_int8 0 0 -128 127 ECU_ADDRESS 0x0001E63E /end MEASUREMENT
/begin MEASUREMENT mcb_pmsm_foc_hall_f28379d_DWork.SPIMasterTransfer2.objisempty "" UBYTE mcb_pmsm_foc_hall_f28379d_CM_logical 0 0 0 1 ECU_ADDRESS 0x0001E684 /end MEASUREMENT
/begin MEASUREMENT mcb_pmsm_foc_hall_f28379d_DWork.SPIMasterTransfer3.objisempty "" UBYTE mcb_pmsm_foc_hall_f28379d_CM_logical 0 0 0 1 ECU_ADDRESS 0x0001E670 /end MEASUREMENT
/begin MEASUREMENT mcb_pmsm_foc_hall_f28379d_DWork.SerialReceive_SubsysRanBC "" SBYTE mcb_pmsm_foc_hall_f28379d_CM_int8 0 0 -128 127 ECU_ADDRESS 0x0001E60A /end MEASUREMENT
/begin MEASUREMENT mcb_pmsm_foc_hall_f28379d_DWork.SpeedControl.Integrator_DSTATE "" FLOAT32_IEEE mcb_pmsm_foc_hall_f28379d_CM_single 0 0 -3.4E+38 3.4E+38 ECU_ADDRESS 0x0001E658
 /begin IF_DATA XCP
  /begin DAQ_EVENT VARIABLE /begin DEFAULT_EVENT_LIST EVENT 0x0000 /end DEFAULT_EVENT_LIST /end DAQ_EVENT
 /end IF_DATA
/end MEASUREMENT
/begin MEASUREMENT mcb_pmsm_foc_hall_f28379d_DWork.SpeedControl.Integrator_PrevResetState "" SBYTE mcb_pmsm_foc_hall_f28379d_CM_int8 0 0 -128 127 ECU_ADDRESS 0x0001E65C
 /begin IF_DATA XCP
  /begin DAQ_EVENT VARIABLE /begin DEFAULT_EVENT_LIST EVENT 0x0000 /end DEFAULT_EVENT_LIST /end DAQ_EVENT
 /end IF_DATA
/end MEASUREMENT
/begin MEASUREMENT mcb_pmsm_foc_hall_f28379d_DWork.SpeedControl.UnitDelay_DSTATE "" FLOAT32_IEEE mcb_pmsm_foc_hall_f28379d_CM_single 0 0 -3.4E+38 3.4E+38 ECU_ADDRESS 0x0001E654
 /begin IF_DATA XCP
  /begin DAQ_EVENT VARIABLE /begin DEFAULT_EVENT_LIST EVENT 0x0000 /end DEFAULT_EVENT_LIST /end DAQ_EVENT
 /end IF_DATA
/end MEASUREMENT
/begin MEASUREMENT mcb_pmsm_foc_hall_f28379d_DWork.Speed_ref "" FLOAT32_IEEE mcb_pmsm_foc_hall_f28379d_CM_single 0 0 -3.4E+38 3.4E+38 ECU_ADDRESS 0x0001E5AC /end MEASUREMENT
/begin MEASUREMENT mcb_pmsm_foc_hall_f28379d_DWork.SpeedanddirectionarenotvalidPos "" SBYTE mcb_pmsm_foc_hall_f28379d_CM_int8 0 0 -128 127 ECU_ADDRESS 0x0001E61E /end MEASUREMENT
/begin MEASUREMENT mcb_pmsm_foc_hall_f28379d_DWork.SpeedanddirectionarevalidUsespe "" SBYTE mcb_pmsm_foc_hall_f28379d_CM_int8 0 0 -128 127 ECU_ADDRESS 0x0001E62C /end MEASUREMENT
/begin MEASUREMENT mcb_pmsm_foc_hall_f28379d_DWork.Subsystem1_SubsysRanBC "" SBYTE mcb_pmsm_foc_hall_f28379d_CM_int8 0 0 -128 127 ECU_ADDRESS 0x0001E62E /end MEASUREMENT
/begin MEASUREMENT mcb_pmsm_foc_hall_f28379d_DWork.Subsystem_SubsysRanBC "" SBYTE mcb_pmsm_foc_hall_f28379d_CM_int8 0 0 -128 127 ECU_ADDRESS 0x0001E618 /end MEASUREMENT
/begin MEASUREMENT mcb_pmsm_foc_hall_f28379d_DWork.Sum_DWORK1 "" ULONG mcb_pmsm_foc_hall_f28379d_CM_uint32 0 0 0 4294967295 ARRAY_SIZE 4 ECU_ADDRESS 0x0001E5CC /end MEASUREMENT
/begin MEASUREMENT mcb_pmsm_foc_hall_f28379d_DWork.UnitDelay_DSTATE "" ULONG mcb_pmsm_foc_hall_f28379d_CM_uint32 0 0 0 4294967295 ECU_ADDRESS 0x0001E588 /end MEASUREMENT
/begin MEASUREMENT mcb_pmsm_foc_hall_f28379d_DWork.ValidHalls.IfActionSubsystem1_SubsysRanBC "" SBYTE mcb_pmsm_foc_hall_f28379d_CM_int8 0 0 -128 127 ECU_ADDRESS 0x0001E6CE /end MEASUREMENT
/begin MEASUREMENT mcb_pmsm_foc_hall_f28379d_DWork.ValidHalls.IfActionSubsystem2_SubsysRanBC "" SBYTE mcb_pmsm_foc_hall_f28379d_CM_int8 0 0 -128 127 ECU_ADDRESS 0x0001E6CC /end MEASUREMENT
/begin MEASUREMENT mcb_pmsm_foc_hall_f28379d_DWork.ValidHalls.IfActionSubsystem3_SubsysRanBC "" SBYTE mcb_pmsm_foc_hall_f28379d_CM_int8 0 0 -128 127 ECU_ADDRESS 0x0001E6CA /end MEASUREMENT
/begin MEASUREMENT mcb_pmsm_foc_hall_f28379d_DWork.ValidHalls.IfActionSubsystem4_SubsysRanBC "" SBYTE mcb_pmsm_foc_hall_f28379d_CM_int8 0 0 -128 127 ECU_ADDRESS 0x0001E6C8 /end MEASUREMENT
/begin MEASUREMENT mcb_pmsm_foc_hall_f28379d_DWork.ValidHalls.IfActionSubsystem5_SubsysRanBC "" SBYTE mcb_pmsm_foc_hall_f28379d_CM_int8 0 0 -128 127 ECU_ADDRESS 0x0001E6C6 /end MEASUREMENT
/begin MEASUREMENT mcb_pmsm_foc_hall_f28379d_DWork.ValidHalls.IfActionSubsystem6_SubsysRanBC "" SBYTE mcb_pmsm_foc_hall_f28379d_CM_int8 0 0 -128 127 ECU_ADDRESS 0x0001E6D6 /end MEASUREMENT
/begin MEASUREMENT mcb_pmsm_foc_hall_f28379d_DWork.ValidHalls.IfActionSubsystem7_SubsysRanBC "" SBYTE mcb_pmsm_foc_hall_f28379d_CM_int8 0 0 -128 127 ECU_ADDRESS 0x0001E6D4 /end MEASUREMENT
/begin MEASUREMENT mcb_pmsm_foc_hall_f28379d_DWork.ValidHalls.IfActionSubsystem8_SubsysRanBC "" SBYTE mcb_pmsm_foc_hall_f28379d_CM_int8 0 0 -128 127 ECU_ADDRESS 0x0001E6D2 /end MEASUREMENT
/begin MEASUREMENT mcb_pmsm_foc_hall_f28379d_DWork.ValidHalls.IfActionSubsystem_SubsysRanBC "" SBYTE mcb_pmsm_foc_hall_f28379d_CM_int8 0 0 -128 127 ECU_ADDRESS 0x0001E6D0 /end MEASUREMENT
/begin MEASUREMENT mcb_pmsm_foc_hall_f28379d_DWork.ValidHalls.SwitchCaseActionSubsystem_Subsy "" SBYTE mcb_pmsm_foc_hall_f28379d_CM_int8 0 0 -128 127 ECU_ADDRESS 0x0001E6C4 /end MEASUREMENT
/begin MEASUREMENT mcb_pmsm_foc_hall_f28379d_DWork.ValidHalls.ValidHalls_SubsysRanBC "" SBYTE mcb_pmsm_foc_hall_f28379d_CM_int8 0 0 -128 127 ECU_ADDRESS 0x0001E6C2 /end MEASUREMENT
/begin MEASUREMENT mcb_pmsm_foc_hall_f28379d_DWork.ValidHalls_h.IfActionSubsystem1_SubsysRanBC "" SBYTE mcb_pmsm_foc_hall_f28379d_CM_int8 0 0 -128 127 ECU_ADDRESS 0x0001E6B2 /end MEASUREMENT
/begin MEASUREMENT mcb_pmsm_foc_hall_f28379d_DWork.ValidHalls_h.IfActionSubsystem2_SubsysRanBC "" SBYTE mcb_pmsm_foc_hall_f28379d_CM_int8 0 0 -128 127 ECU_ADDRESS 0x0001E6B0 /end MEASUREMENT
/begin MEASUREMENT mcb_pmsm_foc_hall_f28379d_DWork.ValidHalls_h.IfActionSubsystem3_SubsysRanBC "" SBYTE mcb_pmsm_foc_hall_f28379d_CM_int8 0 0 -128 127 ECU_ADDRESS 0x0001E6AE /end MEASUREMENT
/begin MEASUREMENT mcb_pmsm_foc_hall_f28379d_DWork.ValidHalls_h.IfActionSubsystem4_SubsysRanBC "" SBYTE mcb_pmsm_foc_hall_f28379d_CM_int8 0 0 -128 127 ECU_ADDRESS 0x0001E6AC /end MEASUREMENT
/begin MEASUREMENT mcb_pmsm_foc_hall_f28379d_DWork.ValidHalls_h.IfActionSubsystem5_SubsysRanBC "" SBYTE mcb_pmsm_foc_hall_f28379d_CM_int8 0 0 -128 127 ECU_ADDRESS 0x0001E6AA /end MEASUREMENT
/begin MEASUREMENT mcb_pmsm_foc_hall_f28379d_DWork.ValidHalls_h.IfActionSubsystem6_SubsysRanBC "" SBYTE mcb_pmsm_foc_hall_f28379d_CM_int8 0 0 -128 127 ECU_ADDRESS 0x0001E6BA /end MEASUREMENT
/begin MEASUREMENT mcb_pmsm_foc_hall_f28379d_DWork.ValidHalls_h.IfActionSubsystem7_SubsysRanBC "" SBYTE mcb_pmsm_foc_hall_f28379d_CM_int8 0 0 -128 127 ECU_ADDRESS 0x0001E6B8 /end MEASUREMENT
/begin MEASUREMENT mcb_pmsm_foc_hall_f28379d_DWork.ValidHalls_h.IfActionSubsystem8_SubsysRanBC "" SBYTE mcb_pmsm_foc_hall_f28379d_CM_int8 0 0 -128 127 ECU_ADDRESS 0x0001E6B6 /end MEASUREMENT
/begin MEASUREMENT mcb_pmsm_foc_hall_f28379d_DWork.ValidHalls_h.IfActionSubsystem_SubsysRanBC "" SBYTE mcb_pmsm_foc_hall_f28379d_CM_int8 0 0 -128 127 ECU_ADDRESS 0x0001E6B4 /end MEASUREMENT
/begin MEASUREMENT mcb_pmsm_foc_hall_f28379d_DWork.ValidHalls_h.SwitchCaseActionSubsystem_Subsy "" SBYTE mcb_pmsm_foc_hall_f28379d_CM_int8 0 0 -128 127 ECU_ADDRESS 0x0001E6A8 /end MEASUREMENT
/begin MEASUREMENT mcb_pmsm_foc_hall_f28379d_DWork.ValidHalls_h.ValidHalls_SubsysRanBC "" SBYTE mcb_pmsm_foc_hall_f28379d_CM_int8 0 0 -128 127 ECU_ADDRESS 0x0001E6A6 /end MEASUREMENT
/begin MEASUREMENT mcb_pmsm_foc_hall_f28379d_DWork.ValidHalls_hi.IfActionSubsystem1_SubsysRanBC "" SBYTE mcb_pmsm_foc_hall_f28379d_CM_int8 0 0 -128 127 ECU_ADDRESS 0x0001E696 /end MEASUREMENT
/begin MEASUREMENT mcb_pmsm_foc_hall_f28379d_DWork.ValidHalls_hi.IfActionSubsystem2_SubsysRanBC "" SBYTE mcb_pmsm_foc_hall_f28379d_CM_int8 0 0 -128 127 ECU_ADDRESS 0x0001E694 /end MEASUREMENT
/begin MEASUREMENT mcb_pmsm_foc_hall_f28379d_DWork.ValidHalls_hi.IfActionSubsystem3_SubsysRanBC "" SBYTE mcb_pmsm_foc_hall_f28379d_CM_int8 0 0 -128 127 ECU_ADDRESS 0x0001E692 /end MEASUREMENT
/begin MEASUREMENT mcb_pmsm_foc_hall_f28379d_DWork.ValidHalls_hi.IfActionSubsystem4_SubsysRanBC "" SBYTE mcb_pmsm_foc_hall_f28379d_CM_int8 0 0 -128 127 ECU_ADDRESS 0x0001E690 /end MEASUREMENT
/begin MEASUREMENT mcb_pmsm_foc_hall_f28379d_DWork.ValidHalls_hi.IfActionSubsystem5_SubsysRanBC "" SBYTE mcb_pmsm_foc_hall_f28379d_CM_int8 0 0 -128 127 ECU_ADDRESS 0x0001E68E /end MEASUREMENT
/begin MEASUREMENT mcb_pmsm_foc_hall_f28379d_DWork.ValidHalls_hi.IfActionSubsystem6_SubsysRanBC "" SBYTE mcb_pmsm_foc_hall_f28379d_CM_int8 0 0 -128 127 ECU_ADDRESS 0x0001E69E /end MEASUREMENT
/begin MEASUREMENT mcb_pmsm_foc_hall_f28379d_DWork.ValidHalls_hi.IfActionSubsystem7_SubsysRanBC "" SBYTE mcb_pmsm_foc_hall_f28379d_CM_int8 0 0 -128 127 ECU_ADDRESS 0x0001E69C /end MEASUREMENT
/begin MEASUREMENT mcb_pmsm_foc_hall_f28379d_DWork.ValidHalls_hi.IfActionSubsystem8_SubsysRanBC "" SBYTE mcb_pmsm_foc_hall_f28379d_CM_int8 0 0 -128 127 ECU_ADDRESS 0x0001E69A /end MEASUREMENT
/begin MEASUREMENT mcb_pmsm_foc_hall_f28379d_DWork.ValidHalls_hi.IfActionSubsystem_SubsysRanBC "" SBYTE mcb_pmsm_foc_hall_f28379d_CM_int8 0 0 -128 127 ECU_ADDRESS 0x0001E698 /end MEASUREMENT
/begin MEASUREMENT mcb_pmsm_foc_hall_f28379d_DWork.ValidHalls_hi.SwitchCaseActionSubsystem_Subsy "" SBYTE mcb_pmsm_foc_hall_f28379d_CM_int8 0 0 -128 127 ECU_ADDRESS 0x0001E68C /end MEASUREMENT
/begin MEASUREMENT mcb_pmsm_foc_hall_f28379d_DWork.ValidHalls_hi.ValidHalls_SubsysRanBC "" SBYTE mcb_pmsm_foc_hall_f28379d_CM_int8 0 0 -128 127 ECU_ADDRESS 0x0001E68A /end MEASUREMENT
/begin MEASUREMENT mcb_pmsm_foc_hall_f28379d_DWork.first_order_SubsysRanBC "" SBYTE mcb_pmsm_foc_hall_f28379d_CM_int8 0 0 -128 127 ECU_ADDRESS 0x0001E630 /end MEASUREMENT
/begin MEASUREMENT mcb_pmsm_foc_hall_f28379d_DWork.limitRef2_SubsysRanBC "" SBYTE mcb_pmsm_foc_hall_f28379d_CM_int8 0 0 -128 127 ECU_ADDRESS 0x0001E64E /end MEASUREMENT
/begin MEASUREMENT mcb_pmsm_foc_hall_f28379d_DWork.passThrough_SubsysRanBC "" SBYTE mcb_pmsm_foc_hall_f28379d_CM_int8 0 0 -128 127 ECU_ADDRESS 0x0001E650 /end MEASUREMENT
/begin MEASUREMENT mcb_pmsm_foc_hall_f28379d_DWork.second_order_SubsysRanBC "" SBYTE mcb_pmsm_foc_hall_f28379d_CM_int8 0 0 -128 127 ECU_ADDRESS 0x0001E632 /end MEASUREMENT
/begin MEASUREMENT mcb_pmsm_foc_hall_f28379d_DWork.veDirection_SubsysRanBC "" SBYTE mcb_pmsm_foc_hall_f28379d_CM_int8 0 0 -128 127 ECU_ADDRESS 0x0001E634 /end MEASUREMENT
/begin MEASUREMENT mcb_pmsm_foc_hall_f28379d_DWork.veDirection_SubsysRanBC_b "" SBYTE mcb_pmsm_foc_hall_f28379d_CM_int8 0 0 -128 127 ECU_ADDRESS 0x0001E636 /end MEASUREMENT
/begin FUNCTION Badhallglitchorwrongconnect ""
 /begin IN_MEASUREMENT mcb_pmsm_foc_hall_f28379d_B.DataStoreRead1_o mcb_pmsm_foc_hall_f28379d_B.Merge_k mcb_pmsm_foc_hall_f28379d_B.Merge1_kl mcb_pmsm_foc_hall_f28379d_B.Merge3_m /end IN_MEASUREMENT
/end FUNCTION
/begin FUNCTION mcb_pmsm_IfActionSubsystem1 ""
 /begin IN_MEASUREMENT mcb_pmsm_foc_hall_f28379d_B.Add mcb_pmsm_foc_hall_f28379d_B.Merge_p /end IN_MEASUREMENT
/end FUNCTION
/begin FUNCTION mcb_pmsm__IfActionSubsystem ""
 /begin IN_MEASUREMENT mcb_pmsm_foc_hall_f28379d_B.Add mcb_pmsm_foc_hall_f28379d_B.Merge_p /end IN_MEASUREMENT
/end FUNCTION
/begin FUNCTION mcb_pmsm_foc_h_HallValueof1 "" /begin IN_MEASUREMENT mcb_pmsm_foc_hall_f28379d_B.Merge1_d /end IN_MEASUREMENT /end FUNCTION
/begin FUNCTION mcb_pmsm_foc_h_HallValueof2 "" /begin IN_MEASUREMENT mcb_pmsm_foc_hall_f28379d_B.Merge1_d /end IN_MEASUREMENT /end FUNCTION
/begin FUNCTION mcb_pmsm_foc_h_HallValueof3 "" /begin IN_MEASUREMENT mcb_pmsm_foc_hall_f28379d_B.Merge1_d /end IN_MEASUREMENT /end FUNCTION
/begin FUNCTION mcb_pmsm_foc_h_HallValueof4 "" /begin IN_MEASUREMENT mcb_pmsm_foc_hall_f28379d_B.Merge1_d /end IN_MEASUREMENT /end FUNCTION
/begin FUNCTION mcb_pmsm_foc_h_HallValueof5 "" /begin IN_MEASUREMENT mcb_pmsm_foc_hall_f28379d_B.Merge1_d /end IN_MEASUREMENT /end FUNCTION
/begin FUNCTION mcb_pmsm_foc_h_HallValueof7 "" /begin IN_MEASUREMENT mcb_pmsm_foc_hall_f28379d_B.Merge1_d /end IN_MEASUREMENT /end FUNCTION
/begin FUNCTION mcb_pmsm_foc_h_SpeedControl ""
 /begin IN_MEASUREMENT mcb_pmsm_foc_hall_f28379d_B.RT6 mcb_pmsm_foc_hall_f28379d_B.RT7 mcb_pmsm_foc_hall_f28379d_DWork.Enable /end IN_MEASUREMENT
/end FUNCTION
/begin FUNCTION mcb_pmsm_foc_hal_ValidHalls ""
 /begin IN_MEASUREMENT mcb_pmsm_foc_hall_f28379d_B.DataTypeConversion1_d mcb_pmsm_foc_hall_f28379d_B.DataTypeConversion2_c mcb_pmsm_foc_hall_f28379d_B.DataStoreRead1_o mcb_pmsm_foc_hall_f28379d_B.Merge3_m mcb_pmsm_foc_hall_f28379d_B.Merge1_kl mcb_pmsm_foc_hall_f28379d_B.Merge_k /end IN_MEASUREMENT
/end FUNCTION
/begin FUNCTION mcb_pmsm_foc_hall_f_Output0 "" /begin IN_MEASUREMENT mcb_pmsm_foc_hall_f28379d_B.Merge_n /end IN_MEASUREMENT /end FUNCTION
/begin FUNCTION mcb_pmsm_foc_hall_f_Output1 "" /begin IN_MEASUREMENT mcb_pmsm_foc_hall_f28379d_B.Merge_n /end IN_MEASUREMENT /end FUNCTION
/begin COMPU_METHOD mcb_pmsm_foc_hall_f28379d_CM_int16 "Q = V" RAT_FUNC "%5.0" "" COEFFS 0 1 0 0 0 1 /end COMPU_METHOD
/begin COMPU_METHOD mcb_pmsm_foc_hall_f28379d_CM_int32 "Q = V" RAT_FUNC "%10.0" "" COEFFS 0 1 0 0 0 1 /end COMPU_METHOD
/begin COMPU_METHOD mcb_pmsm_foc_hall_f28379d_CM_int8 "Q = V" RAT_FUNC "%3.0" "" COEFFS 0 1 0 0 0 1 /end COMPU_METHOD
/begin COMPU_METHOD mcb_pmsm_foc_hall_f28379d_CM_logical "Q = V" RAT_FUNC "%1.0" "" COEFFS 0 1 0 0 0 1 /end COMPU_METHOD
/begin COMPU_METHOD mcb_pmsm_foc_hall_f28379d_CM_single "Q = V" RAT_FUNC "%8.6" "" COEFFS 0 1 0 0 0 1 /end COMPU_METHOD
/begin COMPU_METHOD mcb_pmsm_foc_hall_f28379d_CM_uint16 "Q = V" RAT_FUNC "%5.0" "" COEFFS 0 1 0 0 0 1 /end COMPU_METHOD
/begin COMPU_METHOD mcb_pmsm_foc_hall_f28379d_CM_uint32 "Q = V" RAT_FUNC "%10.0" "" COEFFS 0 1 0 0 0 1 /end COMPU_METHOD
/begin COMPU_METHOD mcb_pmsm_foc_hall_f28379d_CM_uint8 "Q = V" RAT_FUNC "%3.0" "" COEFFS 0 1 0 0 0 1 /end COMPU_METHOD
/begin RECORD_LAYOUT Record_BOOLEAN FNC_VALUES 1 UBYTE COLUMN_DIR DIRECT /end RECORD_LAYOUT
/begin RECORD_LAYOUT Record_FLOAT32_IEEE FNC_VALUES 1 FLOAT32_IEEE COLUMN_DIR DIRECT /end RECORD_LAYOUT
/begin RECORD_LAYOUT Record_SBYTE FNC_VALUES 1 SBYTE COLUMN_DIR DIRECT /end RECORD_LAYOUT
/begin RECORD_LAYOUT Record_SLONG FNC_VALUES 1 SLONG COLUMN_DIR DIRECT /end RECORD_LAYOUT
/begin RECORD_LAYOUT Record_SWORD FNC_VALUES 1 SWORD COLUMN_DIR DIRECT /end RECORD_LAYOUT
/begin RECORD_LAYOUT Record_UBYTE FNC_VALUES 1 UBYTE COLUMN_DIR DIRECT /end RECORD_LAYOUT
/begin RECORD_LAYOUT Record_ULONG FNC_VALUES 1 ULONG COLUMN_DIR DIRECT /end RECORD_LAYOUT
/begin RECORD_LAYOUT Record_UWORD FNC_VALUES 1 UWORD COLUMN_DIR DIRECT /end RECORD_LAYOUT
/begin GROUP mcb_pmsm_foc_hall_f28379d "mcb_pmsm_foc_hall_f28379d" /* Root */ ROOT
 /begin SUB_GROUP mcb_pmsm_foc_hall_f28379d_Current_Control mcb_pmsm_foc_hall_f28379d_Hall_Sensor_A mcb_pmsm_foc_hall_f28379d_Hall_Sensor_B mcb_pmsm_foc_hall_f28379d_Hall_Sensor_C mcb_pmsm_foc_hall_f28379d_Hardware_Init mcb_pmsm_foc_hall_f28379d_Heartbeat_LED mcb_pmsm_foc_hall_f28379d_Serial_Receive mcb_pmsm_foc_hall_f28379d_Speed_Control /end SUB_GROUP
 /begin REF_MEASUREMENT mcb_pmsm_foc_hall_f28379d_B.RT1 mcb_pmsm_foc_hall_f28379d_B.RT2 mcb_pmsm_foc_hall_f28379d_B.RT6 mcb_pmsm_foc_hall_f28379d_B.RT7 mcb_pmsm_foc_hall_f28379d_B.SCIReceive mcb_pmsm_foc_hall_f28379d_B.Speed_PU mcb_pmsm_foc_hall_f28379d_B.TmpSignalConversionAtTAQSigLogg mcb_pmsm_foc_hall_f28379d_DWork.Debug_signals mcb_pmsm_foc_hall_f28379d_DWork.Enable mcb_pmsm_foc_hall_f28379d_DWork.GlobalDirection mcb_pmsm_foc_hall_f28379d_DWork.GlobalHallState mcb_pmsm_foc_hall_f28379d_DWork.GlobalSpeedCount mcb_pmsm_foc_hall_f28379d_DWork.GlobalSpeedValidity mcb_pmsm_foc_hall_f28379d_DWork.HallStateChangeFlag mcb_pmsm_foc_hall_f28379d_DWork.IaOffset mcb_pmsm_foc_hall_f28379d_DWork.IbOffset mcb_pmsm_foc_hall_f28379d_DWork.RT1_ActiveBufIdx mcb_pmsm_foc_hall_f28379d_DWork.RT1_Buffer mcb_pmsm_foc_hall_f28379d_DWork.RT1_semaphoreTaken mcb_pmsm_foc_hall_f28379d_DWork.RT2_ActiveBufIdx mcb_pmsm_foc_hall_f28379d_DWork.RT2_Buffer mcb_pmsm_foc_hall_f28379d_DWork.RT6_ActiveBufIdx mcb_pmsm_foc_hall_f28379d_DWork.RT6_Buffer mcb_pmsm_foc_hall_f28379d_DWork.RT6_semaphoreTaken mcb_pmsm_foc_hall_f28379d_DWork.Speed_ref /end REF_MEASUREMENT
/end GROUP
/begin GROUP mcb_pmsm_foc_hall_f28379d_Current_Control "mcb_pmsm_foc_hall_f28379d/Current Control"
 /begin SUB_GROUP mcb_pmsm_foc_hall_f28379d_Current_Control_Control_System mcb_pmsm_foc_hall_f28379d_Current_Control_Input_Scaling mcb_pmsm_foc_hall_f28379d_Current_Control_Inverter mcb_pmsm_foc_hall_f28379d_Current_Control_Output_Scaling mcb_pmsm_foc_hall_f28379d_Current_Control_Sensor_Driver_Blocks /end SUB_GROUP
 /begin REF_MEASUREMENT mcb_pmsm_foc_hall_f28379d_B.Add mcb_pmsm_foc_hall_f28379d_B.Speed_PU /end REF_MEASUREMENT
/end GROUP
/begin GROUP mcb_pmsm_foc_hall_f28379d_Current_Control_Control_System "mcb_pmsm_foc_hall_f28379d/Current Control/Control_System"
 /begin SUB_GROUP mcb_pmsm_foc_hall_f28379d_Current_Control_Control_System_Clarke_Transform mcb_pmsm_foc_hall_f28379d_Current_Control_Control_System_Current_Controllers mcb_pmsm_foc_hall_f28379d_Current_Control_Control_System_Inverse_Park_Transform mcb_pmsm_foc_hall_f28379d_Current_Control_Control_System_Park_Transform mcb_pmsm_foc_hall_f28379d_Current_Control_Control_System_Space_Vector_Generator /end SUB_GROUP
/end GROUP
/begin GROUP mcb_pmsm_foc_hall_f28379d_Current_Control_Control_System_Clarke_Transform "mcb_pmsm_foc_hall_f28379d/Current Control/Control_System/Clarke Transform"
 /begin SUB_GROUP mcb_pmsm_foc_hall_f28379d_Current_Control_Control_System_Clarke_Transform_Two_phase_input /end SUB_GROUP
/end GROUP
/begin GROUP mcb_pmsm_foc_hall_f28379d_Current_Control_Control_System_Clarke_Transform_Two_phase_input "mcb_pmsm_foc_hall_f28379d/Current Control/Control_System/Clarke Transform/Two phase input"
 /begin SUB_GROUP mcb_pmsm_foc_hall_f28379d_Current_Control_Control_System_Clarke_Transform_Two_phase_input_Two_phase_CRL_wrap /end SUB_GROUP
/end GROUP
/begin GROUP mcb_pmsm_foc_hall_f28379d_Current_Control_Control_System_Clarke_Transform_Two_phase_input_Two_phase_CRL_wrap "mcb_pmsm_foc_hall_f28379d/Current Control/Control_System/Clarke Transform/Two phase input/Two phase CRL wrap"
 /begin REF_MEASUREMENT mcb_pmsm_foc_hall_f28379d_B.InvertingNoninvertingCurrentmea mcb_pmsm_foc_hall_f28379d_B.a_plus_2b mcb_pmsm_foc_hall_f28379d_B.one_by_sqrt3 /end REF_MEASUREMENT
/end GROUP
/begin GROUP mcb_pmsm_foc_hall_f28379d_Current_Control_Control_System_Current_Controllers "mcb_pmsm_foc_hall_f28379d/Current Control/Control_System/Current_Controllers"
 /begin SUB_GROUP mcb_pmsm_foc_hall_f28379d_Current_Control_Control_System_Current_Controllers_DQ_Limiter mcb_pmsm_foc_hall_f28379d_Current_Control_Control_System_Current_Controllers_PI_Controller_Id mcb_pmsm_foc_hall_f28379d_Current_Control_Control_System_Current_Controllers_PI_Controller_Iq /end SUB_GROUP
/end GROUP
/begin GROUP mcb_pmsm_foc_hall_f28379d_Current_Control_Control_System_Current_Controllers_DQ_Limiter "mcb_pmsm_foc_hall_f28379d/Current Control/Control_System/Current_Controllers/DQ Limiter"
 /begin SUB_GROUP mcb_pmsm_foc_hall_f28379d_Current_Control_Control_System_Current_Controllers_DQ_Limiter_D_Q_Equivalence mcb_pmsm_foc_hall_f28379d_Current_Control_Control_System_Current_Controllers_DQ_Limiter_D__Q_Axis_Priority mcb_pmsm_foc_hall_f28379d_Current_Control_Control_System_Current_Controllers_DQ_Limiter_Inport__Dialog_Selection mcb_pmsm_foc_hall_f28379d_Current_Control_Control_System_Current_Controllers_DQ_Limiter_Magnitude_calc /end SUB_GROUP
 /begin REF_MEASUREMENT mcb_pmsm_foc_hall_f28379d_B.Merge_do mcb_pmsm_foc_hall_f28379d_B.Switch1_o /end REF_MEASUREMENT
/end GROUP
/begin GROUP mcb_pmsm_foc_hall_f28379d_Current_Control_Control_System_Current_Controllers_DQ_Limiter_D_Q_Equivalence "mcb_pmsm_foc_hall_f28379d/Current Control/Control_System/Current_Controllers/DQ Limiter/D-Q Equivalence"
 /begin SUB_GROUP mcb_pmsm_foc_hall_f28379d_Current_Control_Control_System_Current_Controllers_DQ_Limiter_D_Q_Equivalence_Limiter mcb_pmsm_foc_hall_f28379d_Current_Control_Control_System_Current_Controllers_DQ_Limiter_D_Q_Equivalence_Passthrough /end SUB_GROUP
 /begin REF_MEASUREMENT mcb_pmsm_foc_hall_f28379d_B.DataTypeConversion_jg mcb_pmsm_foc_hall_f28379d_B.Merge_do mcb_pmsm_foc_hall_f28379d_B.Product_b mcb_pmsm_foc_hall_f28379d_B.RelationalOperator_h mcb_pmsm_foc_hall_f28379d_B.Sum1 /end REF_MEASUREMENT
/end GROUP
/begin GROUP mcb_pmsm_foc_hall_f28379d_Current_Control_Control_System_Current_Controllers_DQ_Limiter_D_Q_Equivalence_Limiter "mcb_pmsm_foc_hall_f28379d/Current Control/Control_System/Current_Controllers/DQ Limiter/D-Q Equivalence/Limiter"
 /begin REF_MEASUREMENT mcb_pmsm_foc_hall_f28379d_B.Merge_do mcb_pmsm_foc_hall_f28379d_B.Product_ie mcb_pmsm_foc_hall_f28379d_B.Reciprocal mcb_pmsm_foc_hall_f28379d_B.SquareRoot mcb_pmsm_foc_hall_f28379d_B.Sum1 mcb_pmsm_foc_hall_f28379d_B.Switch_j mcb_pmsm_foc_hall_f28379d_B.Switch_o /end REF_MEASUREMENT
/end GROUP
/begin GROUP mcb_pmsm_foc_hall_f28379d_Current_Control_Control_System_Current_Controllers_DQ_Limiter_D_Q_Equivalence_Passthrough "mcb_pmsm_foc_hall_f28379d/Current Control/Control_System/Current_Controllers/DQ Limiter/D-Q Equivalence/Passthrough" /begin REF_MEASUREMENT mcb_pmsm_foc_hall_f28379d_B.Merge_do /end REF_MEASUREMENT /end GROUP
/begin GROUP mcb_pmsm_foc_hall_f28379d_Current_Control_Control_System_Current_Controllers_DQ_Limiter_D__Q_Axis_Priority "mcb_pmsm_foc_hall_f28379d/Current Control/Control_System/Current_Controllers/DQ Limiter/D//Q Axis Priority"
 /begin SUB_GROUP mcb_pmsm_foc_hall_f28379d_Current_Control_Control_System_Current_Controllers_DQ_Limiter_D__Q_Axis_Priority_Compare_To_Constant mcb_pmsm_foc_hall_f28379d_Current_Control_Control_System_Current_Controllers_DQ_Limiter_D__Q_Axis_Priority_Compare_To_Constant1 mcb_pmsm_foc_hall_f28379d_Current_Control_Control_System_Current_Controllers_DQ_Limiter_D__Q_Axis_Priority_limiter /end SUB_GROUP
 /begin REF_MEASUREMENT mcb_pmsm_foc_hall_f28379d_B.Compare_h mcb_pmsm_foc_hall_f28379d_B.Compare_nfz mcb_pmsm_foc_hall_f28379d_B.Merge_do mcb_pmsm_foc_hall_f28379d_B.Switch_hp /end REF_MEASUREMENT
/end GROUP
/begin GROUP mcb_pmsm_foc_hall_f28379d_Current_Control_Control_System_Current_Controllers_DQ_Limiter_D__Q_Axis_Priority_Compare_To_Constant "mcb_pmsm_foc_hall_f28379d/Current Control/Control_System/Current_Controllers/DQ Limiter/D//Q Axis Priority/Compare\r\nTo Constant"
 /begin REF_MEASUREMENT mcb_pmsm_foc_hall_f28379d_B.Compare_h mcb_pmsm_foc_hall_f28379d_B.Switch1_o /end REF_MEASUREMENT
/end GROUP
/begin GROUP mcb_pmsm_foc_hall_f28379d_Current_Control_Control_System_Current_Controllers_DQ_Limiter_D__Q_Axis_Priority_Compare_To_Constant1 "mcb_pmsm_foc_hall_f28379d/Current Control/Control_System/Current_Controllers/DQ Limiter/D//Q Axis Priority/Compare\r\nTo Constant1"
 /begin REF_MEASUREMENT mcb_pmsm_foc_hall_f28379d_B.Compare_nfz mcb_pmsm_foc_hall_f28379d_B.Switch1_o /end REF_MEASUREMENT
/end GROUP
/begin GROUP mcb_pmsm_foc_hall_f28379d_Current_Control_Control_System_Current_Controllers_DQ_Limiter_D__Q_Axis_Priority_limiter "mcb_pmsm_foc_hall_f28379d/Current Control/Control_System/Current_Controllers/DQ Limiter/D//Q Axis Priority/limiter"
 /begin SUB_GROUP mcb_pmsm_foc_hall_f28379d_Current_Control_Control_System_Current_Controllers_DQ_Limiter_D__Q_Axis_Priority_limiter_limitRef1 mcb_pmsm_foc_hall_f28379d_Current_Control_Control_System_Current_Controllers_DQ_Limiter_D__Q_Axis_Priority_limiter_limitRef2 mcb_pmsm_foc_hall_f28379d_Current_Control_Control_System_Current_Controllers_DQ_Limiter_D__Q_Axis_Priority_limiter_passThrough /end SUB_GROUP
 /begin REF_MEASUREMENT mcb_pmsm_foc_hall_f28379d_B.DataTypeConversion_nl mcb_pmsm_foc_hall_f28379d_B.Gain_e mcb_pmsm_foc_hall_f28379d_B.Merge_me mcb_pmsm_foc_hall_f28379d_B.Product2 mcb_pmsm_foc_hall_f28379d_B.Product_a mcb_pmsm_foc_hall_f28379d_B.Product_b mcb_pmsm_foc_hall_f28379d_B.RelationalOperator_i mcb_pmsm_foc_hall_f28379d_B.Sum_nl mcb_pmsm_foc_hall_f28379d_B.Switch2 mcb_pmsm_foc_hall_f28379d_B.Switch_hp mcb_pmsm_foc_hall_f28379d_B.Switch_j /end REF_MEASUREMENT
/end GROUP
/begin GROUP mcb_pmsm_foc_hall_f28379d_Current_Control_Control_System_Current_Controllers_DQ_Limiter_D__Q_Axis_Priority_limiter_limitRef1 "mcb_pmsm_foc_hall_f28379d/Current Control/Control_System/Current_Controllers/DQ Limiter/D//Q Axis Priority/limiter/limitRef1"
 /begin REF_MEASUREMENT mcb_pmsm_foc_hall_f28379d_B.Gain_e mcb_pmsm_foc_hall_f28379d_B.LowerRelop1 mcb_pmsm_foc_hall_f28379d_B.Switch2 mcb_pmsm_foc_hall_f28379d_B.Switch_c mcb_pmsm_foc_hall_f28379d_B.Switch_hp mcb_pmsm_foc_hall_f28379d_B.Switch_j mcb_pmsm_foc_hall_f28379d_B.UpperRelop /end REF_MEASUREMENT
/end GROUP
/begin GROUP mcb_pmsm_foc_hall_f28379d_Current_Control_Control_System_Current_Controllers_DQ_Limiter_D__Q_Axis_Priority_limiter_limitRef2 "mcb_pmsm_foc_hall_f28379d/Current Control/Control_System/Current_Controllers/DQ Limiter/D//Q Axis Priority/limiter/limitRef2"
 /begin REF_MEASUREMENT mcb_pmsm_foc_hall_f28379d_B.Gain_c mcb_pmsm_foc_hall_f28379d_B.Merge_me mcb_pmsm_foc_hall_f28379d_B.Sqrt mcb_pmsm_foc_hall_f28379d_B.Sum_nl mcb_pmsm_foc_hall_f28379d_B.Switch1 mcb_pmsm_foc_hall_f28379d_B.Switch_hp /end REF_MEASUREMENT
/end GROUP
/begin GROUP mcb_pmsm_foc_hall_f28379d_Current_Control_Control_System_Current_Controllers_DQ_Limiter_D__Q_Axis_Priority_limiter_passThrough "mcb_pmsm_foc_hall_f28379d/Current Control/Control_System/Current_Controllers/DQ Limiter/D//Q Axis Priority/limiter/passThrough" /begin REF_MEASUREMENT mcb_pmsm_foc_hall_f28379d_B.Merge_me /end REF_MEASUREMENT /end GROUP
/begin GROUP mcb_pmsm_foc_hall_f28379d_Current_Control_Control_System_Current_Controllers_DQ_Limiter_Inport__Dialog_Selection "mcb_pmsm_foc_hall_f28379d/Current Control/Control_System/Current_Controllers/DQ Limiter/Inport//Dialog Selection"
 /begin REF_MEASUREMENT mcb_pmsm_foc_hall_f28379d_B.Product_b mcb_pmsm_foc_hall_f28379d_B.Switch1_o mcb_pmsm_foc_hall_f28379d_B.Switch_j /end REF_MEASUREMENT
/end GROUP
/begin GROUP mcb_pmsm_foc_hall_f28379d_Current_Control_Control_System_Current_Controllers_DQ_Limiter_Magnitude_calc "mcb_pmsm_foc_hall_f28379d/Current Control/Control_System/Current_Controllers/DQ Limiter/Magnitude_calc"
 /begin REF_MEASUREMENT mcb_pmsm_foc_hall_f28379d_B.Product1_b mcb_pmsm_foc_hall_f28379d_B.Product_e mcb_pmsm_foc_hall_f28379d_B.Saturation mcb_pmsm_foc_hall_f28379d_B.Saturation_j mcb_pmsm_foc_hall_f28379d_B.Sum1 /end REF_MEASUREMENT
/end GROUP
/begin GROUP mcb_pmsm_foc_hall_f28379d_Current_Control_Control_System_Current_Controllers_PI_Controller_Id "mcb_pmsm_foc_hall_f28379d/Current Control/Control_System/Current_Controllers/PI_Controller_Id"
 /begin SUB_GROUP mcb_pmsm_foc_hall_f28379d_Current_Control_Control_System_Current_Controllers_PI_Controller_Id_Discrete_PI_Controller__with_anti_windup___reset /end SUB_GROUP
 /begin REF_MEASUREMENT mcb_pmsm_foc_hall_f28379d_B.DataStoreRead1_g mcb_pmsm_foc_hall_f28379d_B.Ki1 mcb_pmsm_foc_hall_f28379d_B.LogicalOperator_j mcb_pmsm_foc_hall_f28379d_B.RT2 mcb_pmsm_foc_hall_f28379d_B.Sum_b mcb_pmsm_foc_hall_f28379d_B.algDD_o1 mcb_pmsm_foc_hall_f28379d_DWork.Enable /end REF_MEASUREMENT
/end GROUP
/begin GROUP mcb_pmsm_foc_hall_f28379d_Current_Control_Control_System_Current_Controllers_PI_Controller_Id_Discrete_PI_Controller__with_anti_windup___reset "mcb_pmsm_foc_hall_f28379d/Current Control/Control_System/Current_Controllers/PI_Controller_Id/Discrete PI Controller \r\nwith anti-windup & reset"
 /begin SUB_GROUP mcb_pmsm_foc_hall_f28379d_Current_Control_Control_System_Current_Controllers_PI_Controller_Id_Discrete_PI_Controller__with_anti_windup___reset_Anti_windup mcb_pmsm_foc_hall_f28379d_Current_Control_Control_System_Current_Controllers_PI_Controller_Id_Discrete_PI_Controller__with_anti_windup___reset_I_Gain mcb_pmsm_foc_hall_f28379d_Current_Control_Control_System_Current_Controllers_PI_Controller_Id_Discrete_PI_Controller__with_anti_windup___reset_Integrator mcb_pmsm_foc_hall_f28379d_Current_Control_Control_System_Current_Controllers_PI_Controller_Id_Discrete_PI_Controller__with_anti_windup___reset_Parallel_P_Gain mcb_pmsm_foc_hall_f28379d_Current_Control_Control_System_Current_Controllers_PI_Controller_Id_Discrete_PI_Controller__with_anti_windup___reset_Saturation mcb_pmsm_foc_hall_f28379d_Current_Control_Control_System_Current_Controllers_PI_Controller_Id_Discrete_PI_Controller__with_anti_windup___reset_Sum /end SUB_GROUP
/end GROUP
/begin GROUP mcb_pmsm_foc_hall_f28379d_Current_Control_Control_System_Current_Controllers_PI_Controller_Id_Discrete_PI_Controller__with_anti_windup___reset_Anti_windup "mcb_pmsm_foc_hall_f28379d/Current Control/Control_System/Current_Controllers/PI_Controller_Id/Discrete PI Controller \r\nwith anti-windup & reset/Anti-windup"
 /begin SUB_GROUP mcb_pmsm_foc_hall_f28379d_Current_Control_Control_System_Current_Controllers_PI_Controller_Id_Discrete_PI_Controller__with_anti_windup___reset_Anti_windup_Disc__Clamping_Parallel /end SUB_GROUP
/end GROUP
/begin GROUP mcb_pmsm_foc_hall_f28379d_Current_Control_Control_System_Current_Controllers_PI_Controller_Id_Discrete_PI_Controller__with_anti_windup___reset_Anti_windup_Disc__Clamping_Parallel "mcb_pmsm_foc_hall_f28379d/Current Control/Control_System/Current_Controllers/PI_Controller_Id/Discrete PI Controller \r\nwith anti-windup & reset/Anti-windup/Disc. Clamping Parallel"
 /begin SUB_GROUP mcb_pmsm_foc_hall_f28379d_Current_Control_Control_System_Current_Controllers_PI_Controller_Id_Discrete_PI_Controller__with_anti_windup___reset_Anti_windup_Disc__Clamping_Parallel_Dead_Zone /end SUB_GROUP
 /begin REF_MEASUREMENT mcb_pmsm_foc_hall_f28379d_B.AND3 mcb_pmsm_foc_hall_f28379d_B.DeadZone mcb_pmsm_foc_hall_f28379d_B.Equal1 mcb_pmsm_foc_hall_f28379d_B.IProdOut mcb_pmsm_foc_hall_f28379d_B.RelationalOperator mcb_pmsm_foc_hall_f28379d_B.Switch1_i mcb_pmsm_foc_hall_f28379d_B.Switch2_a mcb_pmsm_foc_hall_f28379d_B.Switch_b mcb_pmsm_foc_hall_f28379d_B.fixforDTpropagationissue mcb_pmsm_foc_hall_f28379d_B.fixforDTpropagationissue1 /end REF_MEASUREMENT
/end GROUP
/begin GROUP mcb_pmsm_foc_hall_f28379d_Current_Control_Control_System_Current_Controllers_PI_Controller_Id_Discrete_PI_Controller__with_anti_windup___reset_Anti_windup_Disc__Clamping_Parallel_Dead_Zone "mcb_pmsm_foc_hall_f28379d/Current Control/Control_System/Current_Controllers/PI_Controller_Id/Discrete PI Controller \r\nwith anti-windup & reset/Anti-windup/Disc. Clamping Parallel/Dead Zone"
 /begin SUB_GROUP mcb_pmsm_foc_hall_f28379d_Current_Control_Control_System_Current_Controllers_PI_Controller_Id_Discrete_PI_Controller__with_anti_windup___reset_Anti_windup_Disc__Clamping_Parallel_Dead_Zone_Enabled /end SUB_GROUP
/end GROUP
/begin GROUP mcb_pmsm_foc_hall_f28379d_Current_Control_Control_System_Current_Controllers_PI_Controller_Id_Discrete_PI_Controller__with_anti_windup___reset_Anti_windup_Disc__Clamping_Parallel_Dead_Zone_Enabled "mcb_pmsm_foc_hall_f28379d/Current Control/Control_System/Current_Controllers/PI_Controller_Id/Discrete PI Controller \r\nwith anti-windup & reset/Anti-windup/Disc. Clamping Parallel/Dead Zone/Enabled"
 /begin REF_MEASUREMENT mcb_pmsm_foc_hall_f28379d_B.DeadZone mcb_pmsm_foc_hall_f28379d_B.Sum_h /end REF_MEASUREMENT
/end GROUP
/begin GROUP mcb_pmsm_foc_hall_f28379d_Current_Control_Control_System_Current_Controllers_PI_Controller_Id_Discrete_PI_Controller__with_anti_windup___reset_I_Gain "mcb_pmsm_foc_hall_f28379d/Current Control/Control_System/Current_Controllers/PI_Controller_Id/Discrete PI Controller \r\nwith anti-windup & reset/I Gain"
 /begin SUB_GROUP mcb_pmsm_foc_hall_f28379d_Current_Control_Control_System_Current_Controllers_PI_Controller_Id_Discrete_PI_Controller__with_anti_windup___reset_I_Gain_External_Parameters /end SUB_GROUP
/end GROUP
/begin GROUP mcb_pmsm_foc_hall_f28379d_Current_Control_Control_System_Current_Controllers_PI_Controller_Id_Discrete_PI_Controller__with_anti_windup___reset_I_Gain_External_Parameters "mcb_pmsm_foc_hall_f28379d/Current Control/Control_System/Current_Controllers/PI_Controller_Id/Discrete PI Controller \r\nwith anti-windup & reset/I Gain/External Parameters"
 /begin REF_MEASUREMENT mcb_pmsm_foc_hall_f28379d_B.IProdOut mcb_pmsm_foc_hall_f28379d_B.Sum_b /end REF_MEASUREMENT
/end GROUP
/begin GROUP mcb_pmsm_foc_hall_f28379d_Current_Control_Control_System_Current_Controllers_PI_Controller_Id_Discrete_PI_Controller__with_anti_windup___reset_Integrator "mcb_pmsm_foc_hall_f28379d/Current Control/Control_System/Current_Controllers/PI_Controller_Id/Discrete PI Controller \r\nwith anti-windup & reset/Integrator"
 /begin SUB_GROUP mcb_pmsm_foc_hall_f28379d_Current_Control_Control_System_Current_Controllers_PI_Controller_Id_Discrete_PI_Controller__with_anti_windup___reset_Integrator_Discrete /end SUB_GROUP
/end GROUP
/begin GROUP mcb_pmsm_foc_hall_f28379d_Current_Control_Control_System_Current_Controllers_PI_Controller_Id_Discrete_PI_Controller__with_anti_windup___reset_Integrator_Discrete "mcb_pmsm_foc_hall_f28379d/Current Control/Control_System/Current_Controllers/PI_Controller_Id/Discrete PI Controller \r\nwith anti-windup & reset/Integrator/Discrete"
 /begin REF_MEASUREMENT mcb_pmsm_foc_hall_f28379d_B.Integrator_o mcb_pmsm_foc_hall_f28379d_B.Ki1 mcb_pmsm_foc_hall_f28379d_B.LogicalOperator_j mcb_pmsm_foc_hall_f28379d_B.Switch_b mcb_pmsm_foc_hall_f28379d_DWork.Integrator_DSTATE_j mcb_pmsm_foc_hall_f28379d_DWork.Integrator_PrevResetState_m /end REF_MEASUREMENT
/end GROUP
/begin GROUP mcb_pmsm_foc_hall_f28379d_Current_Control_Control_System_Current_Controllers_PI_Controller_Id_Discrete_PI_Controller__with_anti_windup___reset_Parallel_P_Gain "mcb_pmsm_foc_hall_f28379d/Current Control/Control_System/Current_Controllers/PI_Controller_Id/Discrete PI Controller \r\nwith anti-windup & reset/Parallel P Gain"
 /begin SUB_GROUP mcb_pmsm_foc_hall_f28379d_Current_Control_Control_System_Current_Controllers_PI_Controller_Id_Discrete_PI_Controller__with_anti_windup___reset_Parallel_P_Gain_External_Parameters /end SUB_GROUP
/end GROUP
/begin GROUP mcb_pmsm_foc_hall_f28379d_Current_Control_Control_System_Current_Controllers_PI_Controller_Id_Discrete_PI_Controller__with_anti_windup___reset_Parallel_P_Gain_External_Parameters "mcb_pmsm_foc_hall_f28379d/Current Control/Control_System/Current_Controllers/PI_Controller_Id/Discrete PI Controller \r\nwith anti-windup & reset/Parallel P Gain/External Parameters"
 /begin REF_MEASUREMENT mcb_pmsm_foc_hall_f28379d_B.PProdOut_b mcb_pmsm_foc_hall_f28379d_B.Sum_b /end REF_MEASUREMENT
/end GROUP
/begin GROUP mcb_pmsm_foc_hall_f28379d_Current_Control_Control_System_Current_Controllers_PI_Controller_Id_Discrete_PI_Controller__with_anti_windup___reset_Saturation "mcb_pmsm_foc_hall_f28379d/Current Control/Control_System/Current_Controllers/PI_Controller_Id/Discrete PI Controller \r\nwith anti-windup & reset/Saturation"
 /begin SUB_GROUP mcb_pmsm_foc_hall_f28379d_Current_Control_Control_System_Current_Controllers_PI_Controller_Id_Discrete_PI_Controller__with_anti_windup___reset_Saturation_Enabled /end SUB_GROUP
/end GROUP
/begin GROUP mcb_pmsm_foc_hall_f28379d_Current_Control_Control_System_Current_Controllers_PI_Controller_Id_Discrete_PI_Controller__with_anti_windup___reset_Saturation_Enabled "mcb_pmsm_foc_hall_f28379d/Current Control/Control_System/Current_Controllers/PI_Controller_Id/Discrete PI Controller \r\nwith anti-windup & reset/Saturation/Enabled"
 /begin REF_MEASUREMENT mcb_pmsm_foc_hall_f28379d_B.Saturation_j mcb_pmsm_foc_hall_f28379d_B.Sum_h /end REF_MEASUREMENT
/end GROUP
/begin GROUP mcb_pmsm_foc_hall_f28379d_Current_Control_Control_System_Current_Controllers_PI_Controller_Id_Discrete_PI_Controller__with_anti_windup___reset_Sum "mcb_pmsm_foc_hall_f28379d/Current Control/Control_System/Current_Controllers/PI_Controller_Id/Discrete PI Controller \r\nwith anti-windup & reset/Sum"
 /begin SUB_GROUP mcb_pmsm_foc_hall_f28379d_Current_Control_Control_System_Current_Controllers_PI_Controller_Id_Discrete_PI_Controller__with_anti_windup___reset_Sum_Sum_PI /end SUB_GROUP
/end GROUP
/begin GROUP mcb_pmsm_foc_hall_f28379d_Current_Control_Control_System_Current_Controllers_PI_Controller_Id_Discrete_PI_Controller__with_anti_windup___reset_Sum_Sum_PI "mcb_pmsm_foc_hall_f28379d/Current Control/Control_System/Current_Controllers/PI_Controller_Id/Discrete PI Controller \r\nwith anti-windup & reset/Sum/Sum_PI"
 /begin REF_MEASUREMENT mcb_pmsm_foc_hall_f28379d_B.Integrator_o mcb_pmsm_foc_hall_f28379d_B.PProdOut_b mcb_pmsm_foc_hall_f28379d_B.Sum_h /end REF_MEASUREMENT
/end GROUP
/begin GROUP mcb_pmsm_foc_hall_f28379d_Current_Control_Control_System_Current_Controllers_PI_Controller_Iq "mcb_pmsm_foc_hall_f28379d/Current Control/Control_System/Current_Controllers/PI_Controller_Iq"
 /begin SUB_GROUP mcb_pmsm_foc_hall_f28379d_Current_Control_Control_System_Current_Controllers_PI_Controller_Iq_Discrete_PI_Controller__with_anti_windup___reset /end SUB_GROUP
 /begin REF_MEASUREMENT mcb_pmsm_foc_hall_f28379d_B.DataStoreRead1_b mcb_pmsm_foc_hall_f28379d_B.Kp1 mcb_pmsm_foc_hall_f28379d_B.LogicalOperator mcb_pmsm_foc_hall_f28379d_B.RT2 mcb_pmsm_foc_hall_f28379d_B.Sum_g mcb_pmsm_foc_hall_f28379d_B.algDD_o2 mcb_pmsm_foc_hall_f28379d_DWork.Enable /end REF_MEASUREMENT
/end GROUP
/begin GROUP mcb_pmsm_foc_hall_f28379d_Current_Control_Control_System_Current_Controllers_PI_Controller_Iq_Discrete_PI_Controller__with_anti_windup___reset "mcb_pmsm_foc_hall_f28379d/Current Control/Control_System/Current_Controllers/PI_Controller_Iq/Discrete PI Controller \r\nwith anti-windup & reset"
 /begin SUB_GROUP mcb_pmsm_foc_hall_f28379d_Current_Control_Control_System_Current_Controllers_PI_Controller_Iq_Discrete_PI_Controller__with_anti_windup___reset_Anti_windup mcb_pmsm_foc_hall_f28379d_Current_Control_Control_System_Current_Controllers_PI_Controller_Iq_Discrete_PI_Controller__with_anti_windup___reset_I_Gain mcb_pmsm_foc_hall_f28379d_Current_Control_Control_System_Current_Controllers_PI_Controller_Iq_Discrete_PI_Controller__with_anti_windup___reset_Integrator mcb_pmsm_foc_hall_f28379d_Current_Control_Control_System_Current_Controllers_PI_Controller_Iq_Discrete_PI_Controller__with_anti_windup___reset_Parallel_P_Gain mcb_pmsm_foc_hall_f28379d_Current_Control_Control_System_Current_Controllers_PI_Controller_Iq_Discrete_PI_Controller__with_anti_windup___reset_Saturation mcb_pmsm_foc_hall_f28379d_Current_Control_Control_System_Current_Controllers_PI_Controller_Iq_Discrete_PI_Controller__with_anti_windup___reset_Sum /end SUB_GROUP
/end GROUP
/begin GROUP mcb_pmsm_foc_hall_f28379d_Current_Control_Control_System_Current_Controllers_PI_Controller_Iq_Discrete_PI_Controller__with_anti_windup___reset_Anti_windup "mcb_pmsm_foc_hall_f28379d/Current Control/Control_System/Current_Controllers/PI_Controller_Iq/Discrete PI Controller \r\nwith anti-windup & reset/Anti-windup"
 /begin SUB_GROUP mcb_pmsm_foc_hall_f28379d_Current_Control_Control_System_Current_Controllers_PI_Controller_Iq_Discrete_PI_Controller__with_anti_windup___reset_Anti_windup_Disc__Clamping_Parallel /end SUB_GROUP
/end GROUP
/begin GROUP mcb_pmsm_foc_hall_f28379d_Current_Control_Control_System_Current_Controllers_PI_Controller_Iq_Discrete_PI_Controller__with_anti_windup___reset_Anti_windup_Disc__Clamping_Parallel "mcb_pmsm_foc_hall_f28379d/Current Control/Control_System/Current_Controllers/PI_Controller_Iq/Discrete PI Controller \r\nwith anti-windup & reset/Anti-windup/Disc. Clamping Parallel"
 /begin SUB_GROUP mcb_pmsm_foc_hall_f28379d_Current_Control_Control_System_Current_Controllers_PI_Controller_Iq_Discrete_PI_Controller__with_anti_windup___reset_Anti_windup_Disc__Clamping_Parallel_Dead_Zone /end SUB_GROUP
 /begin REF_MEASUREMENT mcb_pmsm_foc_hall_f28379d_B.AND3_f mcb_pmsm_foc_hall_f28379d_B.DeadZone_g mcb_pmsm_foc_hall_f28379d_B.Equal1_d mcb_pmsm_foc_hall_f28379d_B.IProdOut_h mcb_pmsm_foc_hall_f28379d_B.RelationalOperator_m mcb_pmsm_foc_hall_f28379d_B.Switch1_j mcb_pmsm_foc_hall_f28379d_B.Switch2_b mcb_pmsm_foc_hall_f28379d_B.Switch_ls mcb_pmsm_foc_hall_f28379d_B.fixforDTpropagationissue1_h mcb_pmsm_foc_hall_f28379d_B.fixforDTpropagationissue_b /end REF_MEASUREMENT
/end GROUP
/begin GROUP mcb_pmsm_foc_hall_f28379d_Current_Control_Control_System_Current_Controllers_PI_Controller_Iq_Discrete_PI_Controller__with_anti_windup___reset_Anti_windup_Disc__Clamping_Parallel_Dead_Zone "mcb_pmsm_foc_hall_f28379d/Current Control/Control_System/Current_Controllers/PI_Controller_Iq/Discrete PI Controller \r\nwith anti-windup & reset/Anti-windup/Disc. Clamping Parallel/Dead Zone"
 /begin SUB_GROUP mcb_pmsm_foc_hall_f28379d_Current_Control_Control_System_Current_Controllers_PI_Controller_Iq_Discrete_PI_Controller__with_anti_windup___reset_Anti_windup_Disc__Clamping_Parallel_Dead_Zone_Enabled /end SUB_GROUP
/end GROUP
/begin GROUP mcb_pmsm_foc_hall_f28379d_Current_Control_Control_System_Current_Controllers_PI_Controller_Iq_Discrete_PI_Controller__with_anti_windup___reset_Anti_windup_Disc__Clamping_Parallel_Dead_Zone_Enabled "mcb_pmsm_foc_hall_f28379d/Current Control/Control_System/Current_Controllers/PI_Controller_Iq/Discrete PI Controller \r\nwith anti-windup & reset/Anti-windup/Disc. Clamping Parallel/Dead Zone/Enabled"
 /begin REF_MEASUREMENT mcb_pmsm_foc_hall_f28379d_B.DeadZone_g mcb_pmsm_foc_hall_f28379d_B.Sum_m /end REF_MEASUREMENT
/end GROUP
/begin GROUP mcb_pmsm_foc_hall_f28379d_Current_Control_Control_System_Current_Controllers_PI_Controller_Iq_Discrete_PI_Controller__with_anti_windup___reset_I_Gain "mcb_pmsm_foc_hall_f28379d/Current Control/Control_System/Current_Controllers/PI_Controller_Iq/Discrete PI Controller \r\nwith anti-windup & reset/I Gain"
 /begin SUB_GROUP mcb_pmsm_foc_hall_f28379d_Current_Control_Control_System_Current_Controllers_PI_Controller_Iq_Discrete_PI_Controller__with_anti_windup___reset_I_Gain_External_Parameters /end SUB_GROUP
/end GROUP
/begin GROUP mcb_pmsm_foc_hall_f28379d_Current_Control_Control_System_Current_Controllers_PI_Controller_Iq_Discrete_PI_Controller__with_anti_windup___reset_I_Gain_External_Parameters "mcb_pmsm_foc_hall_f28379d/Current Control/Control_System/Current_Controllers/PI_Controller_Iq/Discrete PI Controller \r\nwith anti-windup & reset/I Gain/External Parameters"
 /begin REF_MEASUREMENT mcb_pmsm_foc_hall_f28379d_B.IProdOut_h mcb_pmsm_foc_hall_f28379d_B.Sum_g /end REF_MEASUREMENT
/end GROUP
/begin GROUP mcb_pmsm_foc_hall_f28379d_Current_Control_Control_System_Current_Controllers_PI_Controller_Iq_Discrete_PI_Controller__with_anti_windup___reset_Integrator "mcb_pmsm_foc_hall_f28379d/Current Control/Control_System/Current_Controllers/PI_Controller_Iq/Discrete PI Controller \r\nwith anti-windup & reset/Integrator"
 /begin SUB_GROUP mcb_pmsm_foc_hall_f28379d_Current_Control_Control_System_Current_Controllers_PI_Controller_Iq_Discrete_PI_Controller__with_anti_windup___reset_Integrator_Discrete /end SUB_GROUP
/end GROUP
/begin GROUP mcb_pmsm_foc_hall_f28379d_Current_Control_Control_System_Current_Controllers_PI_Controller_Iq_Discrete_PI_Controller__with_anti_windup___reset_Integrator_Discrete "mcb_pmsm_foc_hall_f28379d/Current Control/Control_System/Current_Controllers/PI_Controller_Iq/Discrete PI Controller \r\nwith anti-windup & reset/Integrator/Discrete"
 /begin REF_MEASUREMENT mcb_pmsm_foc_hall_f28379d_B.Integrator mcb_pmsm_foc_hall_f28379d_B.Kp1 mcb_pmsm_foc_hall_f28379d_B.LogicalOperator mcb_pmsm_foc_hall_f28379d_B.Switch_ls mcb_pmsm_foc_hall_f28379d_DWork.Integrator_DSTATE mcb_pmsm_foc_hall_f28379d_DWork.Integrator_PrevResetState /end REF_MEASUREMENT
/end GROUP
/begin GROUP mcb_pmsm_foc_hall_f28379d_Current_Control_Control_System_Current_Controllers_PI_Controller_Iq_Discrete_PI_Controller__with_anti_windup___reset_Parallel_P_Gain "mcb_pmsm_foc_hall_f28379d/Current Control/Control_System/Current_Controllers/PI_Controller_Iq/Discrete PI Controller \r\nwith anti-windup & reset/Parallel P Gain"
 /begin SUB_GROUP mcb_pmsm_foc_hall_f28379d_Current_Control_Control_System_Current_Controllers_PI_Controller_Iq_Discrete_PI_Controller__with_anti_windup___reset_Parallel_P_Gain_External_Parameters /end SUB_GROUP
/end GROUP
/begin GROUP mcb_pmsm_foc_hall_f28379d_Current_Control_Control_System_Current_Controllers_PI_Controller_Iq_Discrete_PI_Controller__with_anti_windup___reset_Parallel_P_Gain_External_Parameters "mcb_pmsm_foc_hall_f28379d/Current Control/Control_System/Current_Controllers/PI_Controller_Iq/Discrete PI Controller \r\nwith anti-windup & reset/Parallel P Gain/External Parameters"
 /begin REF_MEASUREMENT mcb_pmsm_foc_hall_f28379d_B.PProdOut mcb_pmsm_foc_hall_f28379d_B.Sum_g /end REF_MEASUREMENT
/end GROUP
/begin GROUP mcb_pmsm_foc_hall_f28379d_Current_Control_Control_System_Current_Controllers_PI_Controller_Iq_Discrete_PI_Controller__with_anti_windup___reset_Saturation "mcb_pmsm_foc_hall_f28379d/Current Control/Control_System/Current_Controllers/PI_Controller_Iq/Discrete PI Controller \r\nwith anti-windup & reset/Saturation"
 /begin SUB_GROUP mcb_pmsm_foc_hall_f28379d_Current_Control_Control_System_Current_Controllers_PI_Controller_Iq_Discrete_PI_Controller__with_anti_windup___reset_Saturation_Enabled /end SUB_GROUP
/end GROUP
/begin GROUP mcb_pmsm_foc_hall_f28379d_Current_Control_Control_System_Current_Controllers_PI_Controller_Iq_Discrete_PI_Controller__with_anti_windup___reset_Saturation_Enabled "mcb_pmsm_foc_hall_f28379d/Current Control/Control_System/Current_Controllers/PI_Controller_Iq/Discrete PI Controller \r\nwith anti-windup & reset/Saturation/Enabled"
 /begin REF_MEASUREMENT mcb_pmsm_foc_hall_f28379d_B.Saturation mcb_pmsm_foc_hall_f28379d_B.Sum_m /end REF_MEASUREMENT
/end GROUP
/begin GROUP mcb_pmsm_foc_hall_f28379d_Current_Control_Control_System_Current_Controllers_PI_Controller_Iq_Discrete_PI_Controller__with_anti_windup___reset_Sum "mcb_pmsm_foc_hall_f28379d/Current Control/Control_System/Current_Controllers/PI_Controller_Iq/Discrete PI Controller \r\nwith anti-windup & reset/Sum"
 /begin SUB_GROUP mcb_pmsm_foc_hall_f28379d_Current_Control_Control_System_Current_Controllers_PI_Controller_Iq_Discrete_PI_Controller__with_anti_windup___reset_Sum_Sum_PI /end SUB_GROUP
/end GROUP
/begin GROUP mcb_pmsm_foc_hall_f28379d_Current_Control_Control_System_Current_Controllers_PI_Controller_Iq_Discrete_PI_Controller__with_anti_windup___reset_Sum_Sum_PI "mcb_pmsm_foc_hall_f28379d/Current Control/Control_System/Current_Controllers/PI_Controller_Iq/Discrete PI Controller \r\nwith anti-windup & reset/Sum/Sum_PI"
 /begin REF_MEASUREMENT mcb_pmsm_foc_hall_f28379d_B.Integrator mcb_pmsm_foc_hall_f28379d_B.PProdOut mcb_pmsm_foc_hall_f28379d_B.Sum_m /end REF_MEASUREMENT
/end GROUP
/begin GROUP mcb_pmsm_foc_hall_f28379d_Current_Control_Control_System_Inverse_Park_Transform "mcb_pmsm_foc_hall_f28379d/Current Control/Control_System/Inverse Park Transform"
 /begin SUB_GROUP mcb_pmsm_foc_hall_f28379d_Current_Control_Control_System_Inverse_Park_Transform_Sine_Cosine mcb_pmsm_foc_hall_f28379d_Current_Control_Control_System_Inverse_Park_Transform_Two_inputs_CRL /end SUB_GROUP
/end GROUP
/begin GROUP mcb_pmsm_foc_hall_f28379d_Current_Control_Control_System_Inverse_Park_Transform_Sine_Cosine "mcb_pmsm_foc_hall_f28379d/Current Control/Control_System/Inverse Park Transform/Sine Cosine"
 /begin SUB_GROUP mcb_pmsm_foc_hall_f28379d_Current_Control_Control_System_Inverse_Park_Transform_Sine_Cosine_Interpolation mcb_pmsm_foc_hall_f28379d_Current_Control_Control_System_Inverse_Park_Transform_Sine_Cosine_WrapUp /end SUB_GROUP
 /begin REF_MEASUREMENT mcb_pmsm_foc_hall_f28379d_B.DataTypeConversion1_f mcb_pmsm_foc_hall_f28379d_B.Get_Integer_f mcb_pmsm_foc_hall_f28379d_B.Lookup_f mcb_pmsm_foc_hall_f28379d_B.Merge_p mcb_pmsm_foc_hall_f28379d_B.Sum2_p mcb_pmsm_foc_hall_f28379d_B.Sum_k mcb_pmsm_foc_hall_f28379d_B.indexing_i mcb_pmsm_foc_hall_f28379d_DWork.Sum_DWORK1 /end REF_MEASUREMENT
/end GROUP
/begin GROUP mcb_pmsm_foc_hall_f28379d_Current_Control_Control_System_Inverse_Park_Transform_Sine_Cosine_Interpolation "mcb_pmsm_foc_hall_f28379d/Current Control/Control_System/Inverse Park Transform/Sine Cosine/Interpolation"
 /begin REF_MEASUREMENT mcb_pmsm_foc_hall_f28379d_B.Lookup_f mcb_pmsm_foc_hall_f28379d_B.Product1_p mcb_pmsm_foc_hall_f28379d_B.Product_d mcb_pmsm_foc_hall_f28379d_B.Sum2_p mcb_pmsm_foc_hall_f28379d_B.Sum3_c mcb_pmsm_foc_hall_f28379d_B.Sum4_j mcb_pmsm_foc_hall_f28379d_B.Sum5_k mcb_pmsm_foc_hall_f28379d_B.Sum6_e /end REF_MEASUREMENT
/end GROUP
/begin GROUP mcb_pmsm_foc_hall_f28379d_Current_Control_Control_System_Inverse_Park_Transform_Sine_Cosine_WrapUp "mcb_pmsm_foc_hall_f28379d/Current Control/Control_System/Inverse Park Transform/Sine Cosine/WrapUp"
 /begin SUB_GROUP mcb_pmsm_foc_hall_f28379d_Current_Control_Control_System_Inverse_Park_Transform_Sine_Cosine_WrapUp_Compare_To_Zero mcb_pmsm_foc_hall_f28379d_Current_Control_Control_System_Inverse_Park_Transform_Sine_Cosine_WrapUp_If_Action_Subsystem mcb_pmsm_foc_hall_f28379d_Current_Control_Control_System_Inverse_Park_Transform_Sine_Cosine_WrapUp_If_Action_Subsystem1 /end SUB_GROUP
 /begin REF_MEASUREMENT mcb_pmsm_foc_hall_f28379d_B.Compare_nf mcb_pmsm_foc_hall_f28379d_B.DataTypeConversion_e mcb_pmsm_foc_hall_f28379d_B.Merge_p /end REF_MEASUREMENT
/end GROUP
/begin GROUP mcb_pmsm_foc_hall_f28379d_Current_Control_Control_System_Inverse_Park_Transform_Sine_Cosine_WrapUp_Compare_To_Zero "mcb_pmsm_foc_hall_f28379d/Current Control/Control_System/Inverse Park Transform/Sine Cosine/WrapUp/Compare\r\nTo Zero"
 /begin REF_MEASUREMENT mcb_pmsm_foc_hall_f28379d_B.Add mcb_pmsm_foc_hall_f28379d_B.Compare_nf /end REF_MEASUREMENT
/end GROUP
/begin GROUP mcb_pmsm_foc_hall_f28379d_Current_Control_Control_System_Inverse_Park_Transform_Sine_Cosine_WrapUp_If_Action_Subsystem "mcb_pmsm_foc_hall_f28379d/Current Control/Control_System/Inverse Park Transform/Sine Cosine/WrapUp/If Action\r\nSubsystem"
 /begin REF_MEASUREMENT mcb_pmsm_foc_hall_f28379d_B.Add mcb_pmsm_foc_hall_f28379d_B.Merge_p /end REF_MEASUREMENT
/end GROUP
/begin GROUP mcb_pmsm_foc_hall_f28379d_Current_Control_Control_System_Inverse_Park_Transform_Sine_Cosine_WrapUp_If_Action_Subsystem1 "mcb_pmsm_foc_hall_f28379d/Current Control/Control_System/Inverse Park Transform/Sine Cosine/WrapUp/If Action\r\nSubsystem1"
 /begin REF_MEASUREMENT mcb_pmsm_foc_hall_f28379d_B.Add mcb_pmsm_foc_hall_f28379d_B.Merge_p /end REF_MEASUREMENT
/end GROUP
/begin GROUP mcb_pmsm_foc_hall_f28379d_Current_Control_Control_System_Inverse_Park_Transform_Two_inputs_CRL "mcb_pmsm_foc_hall_f28379d/Current Control/Control_System/Inverse Park Transform/Two inputs CRL"
 /begin SUB_GROUP mcb_pmsm_foc_hall_f28379d_Current_Control_Control_System_Inverse_Park_Transform_Two_inputs_CRL_Switch_Axis /end SUB_GROUP
 /begin REF_MEASUREMENT mcb_pmsm_foc_hall_f28379d_B.Merge_do mcb_pmsm_foc_hall_f28379d_B.Sum4_j mcb_pmsm_foc_hall_f28379d_B.Sum6_e mcb_pmsm_foc_hall_f28379d_B.dcos mcb_pmsm_foc_hall_f28379d_B.dsin mcb_pmsm_foc_hall_f28379d_B.qcos mcb_pmsm_foc_hall_f28379d_B.qsin mcb_pmsm_foc_hall_f28379d_B.sum_alpha mcb_pmsm_foc_hall_f28379d_B.sum_beta /end REF_MEASUREMENT
/end GROUP
/begin GROUP mcb_pmsm_foc_hall_f28379d_Current_Control_Control_System_Inverse_Park_Transform_Two_inputs_CRL_Switch_Axis "mcb_pmsm_foc_hall_f28379d/Current Control/Control_System/Inverse Park Transform/Two inputs CRL/Switch_Axis" /begin REF_MEASUREMENT mcb_pmsm_foc_hall_f28379d_B.Switch_k /end REF_MEASUREMENT /end GROUP
/begin GROUP mcb_pmsm_foc_hall_f28379d_Current_Control_Control_System_Park_Transform "mcb_pmsm_foc_hall_f28379d/Current Control/Control_System/Park Transform"
 /begin SUB_GROUP mcb_pmsm_foc_hall_f28379d_Current_Control_Control_System_Park_Transform_Sine_Cosine mcb_pmsm_foc_hall_f28379d_Current_Control_Control_System_Park_Transform_Two_inputs_CRL /end SUB_GROUP
/end GROUP
/begin GROUP mcb_pmsm_foc_hall_f28379d_Current_Control_Control_System_Park_Transform_Sine_Cosine "mcb_pmsm_foc_hall_f28379d/Current Control/Control_System/Park Transform/Sine Cosine"
 /begin SUB_GROUP mcb_pmsm_foc_hall_f28379d_Current_Control_Control_System_Park_Transform_Sine_Cosine_Sine_Cosine_Lookup /end SUB_GROUP
/end GROUP
/begin GROUP mcb_pmsm_foc_hall_f28379d_Current_Control_Control_System_Park_Transform_Sine_Cosine_Sine_Cosine_Lookup "mcb_pmsm_foc_hall_f28379d/Current Control/Control_System/Park Transform/Sine Cosine/Sine-Cosine Lookup"
 /begin SUB_GROUP mcb_pmsm_foc_hall_f28379d_Current_Control_Control_System_Park_Transform_Sine_Cosine_Sine_Cosine_Lookup_Interpolation mcb_pmsm_foc_hall_f28379d_Current_Control_Control_System_Park_Transform_Sine_Cosine_Sine_Cosine_Lookup_WrapUp /end SUB_GROUP
 /begin REF_MEASUREMENT mcb_pmsm_foc_hall_f28379d_B.DataTypeConversion1 mcb_pmsm_foc_hall_f28379d_B.Get_Integer mcb_pmsm_foc_hall_f28379d_B.Lookup mcb_pmsm_foc_hall_f28379d_B.Merge_mm mcb_pmsm_foc_hall_f28379d_B.Sum mcb_pmsm_foc_hall_f28379d_B.Sum2 mcb_pmsm_foc_hall_f28379d_B.indexing mcb_pmsm_foc_hall_f28379d_DWork.Sum_DWORK1 /end REF_MEASUREMENT
/end GROUP
/begin GROUP mcb_pmsm_foc_hall_f28379d_Current_Control_Control_System_Park_Transform_Sine_Cosine_Sine_Cosine_Lookup_Interpolation "mcb_pmsm_foc_hall_f28379d/Current Control/Control_System/Park Transform/Sine Cosine/Sine-Cosine Lookup/Interpolation"
 /begin REF_MEASUREMENT mcb_pmsm_foc_hall_f28379d_B.Lookup mcb_pmsm_foc_hall_f28379d_B.Product mcb_pmsm_foc_hall_f28379d_B.Product1 mcb_pmsm_foc_hall_f28379d_B.Sum2 mcb_pmsm_foc_hall_f28379d_B.Sum3 mcb_pmsm_foc_hall_f28379d_B.Sum4 mcb_pmsm_foc_hall_f28379d_B.Sum5 mcb_pmsm_foc_hall_f28379d_B.Sum6 /end REF_MEASUREMENT
/end GROUP
/begin GROUP mcb_pmsm_foc_hall_f28379d_Current_Control_Control_System_Park_Transform_Sine_Cosine_Sine_Cosine_Lookup_WrapUp "mcb_pmsm_foc_hall_f28379d/Current Control/Control_System/Park Transform/Sine Cosine/Sine-Cosine Lookup/WrapUp"
 /begin SUB_GROUP mcb_pmsm_foc_hall_f28379d_Current_Control_Control_System_Park_Transform_Sine_Cosine_Sine_Cosine_Lookup_WrapUp_Compare_To_Zero mcb_pmsm_foc_hall_f28379d_Current_Control_Control_System_Park_Transform_Sine_Cosine_Sine_Cosine_Lookup_WrapUp_If_Action_Subsystem mcb_pmsm_foc_hall_f28379d_Current_Control_Control_System_Park_Transform_Sine_Cosine_Sine_Cosine_Lookup_WrapUp_If_Action_Subsystem1 /end SUB_GROUP
 /begin REF_MEASUREMENT mcb_pmsm_foc_hall_f28379d_B.Compare_d mcb_pmsm_foc_hall_f28379d_B.DataTypeConversion_m mcb_pmsm_foc_hall_f28379d_B.Merge_mm /end REF_MEASUREMENT
/end GROUP
/begin GROUP mcb_pmsm_foc_hall_f28379d_Current_Control_Control_System_Park_Transform_Sine_Cosine_Sine_Cosine_Lookup_WrapUp_Compare_To_Zero "mcb_pmsm_foc_hall_f28379d/Current Control/Control_System/Park Transform/Sine Cosine/Sine-Cosine Lookup/WrapUp/Compare\r\nTo Zero"
 /begin REF_MEASUREMENT mcb_pmsm_foc_hall_f28379d_B.Add mcb_pmsm_foc_hall_f28379d_B.Compare_d /end REF_MEASUREMENT
/end GROUP
/begin GROUP mcb_pmsm_foc_hall_f28379d_Current_Control_Control_System_Park_Transform_Sine_Cosine_Sine_Cosine_Lookup_WrapUp_If_Action_Subsystem "mcb_pmsm_foc_hall_f28379d/Current Control/Control_System/Park Transform/Sine Cosine/Sine-Cosine Lookup/WrapUp/If Action\r\nSubsystem"
 /begin REF_MEASUREMENT mcb_pmsm_foc_hall_f28379d_B.Add mcb_pmsm_foc_hall_f28379d_B.Merge_mm /end REF_MEASUREMENT
/end GROUP
/begin GROUP mcb_pmsm_foc_hall_f28379d_Current_Control_Control_System_Park_Transform_Sine_Cosine_Sine_Cosine_Lookup_WrapUp_If_Action_Subsystem1 "mcb_pmsm_foc_hall_f28379d/Current Control/Control_System/Park Transform/Sine Cosine/Sine-Cosine Lookup/WrapUp/If Action\r\nSubsystem1"
 /begin REF_MEASUREMENT mcb_pmsm_foc_hall_f28379d_B.Add mcb_pmsm_foc_hall_f28379d_B.Merge_mm /end REF_MEASUREMENT
/end GROUP
/begin GROUP mcb_pmsm_foc_hall_f28379d_Current_Control_Control_System_Park_Transform_Two_inputs_CRL "mcb_pmsm_foc_hall_f28379d/Current Control/Control_System/Park Transform/Two inputs CRL"
 /begin SUB_GROUP mcb_pmsm_foc_hall_f28379d_Current_Control_Control_System_Park_Transform_Two_inputs_CRL_Switch_Axis /end SUB_GROUP
 /begin REF_MEASUREMENT mcb_pmsm_foc_hall_f28379d_B.Sum4 mcb_pmsm_foc_hall_f28379d_B.Sum6 mcb_pmsm_foc_hall_f28379d_B.acos_e mcb_pmsm_foc_hall_f28379d_B.algDD_o1 mcb_pmsm_foc_hall_f28379d_B.algDD_o1_a mcb_pmsm_foc_hall_f28379d_B.algDD_o2 mcb_pmsm_foc_hall_f28379d_B.algDD_o2_n mcb_pmsm_foc_hall_f28379d_B.asin_j mcb_pmsm_foc_hall_f28379d_B.bcos mcb_pmsm_foc_hall_f28379d_B.bsin mcb_pmsm_foc_hall_f28379d_B.sum_Ds mcb_pmsm_foc_hall_f28379d_B.sum_Qs /end REF_MEASUREMENT
/end GROUP
/begin GROUP mcb_pmsm_foc_hall_f28379d_Current_Control_Control_System_Park_Transform_Two_inputs_CRL_Switch_Axis "mcb_pmsm_foc_hall_f28379d/Current Control/Control_System/Park Transform/Two inputs CRL/Switch_Axis" /begin REF_MEASUREMENT mcb_pmsm_foc_hall_f28379d_B.Switch_fd /end REF_MEASUREMENT /end GROUP
/begin GROUP mcb_pmsm_foc_hall_f28379d_Current_Control_Control_System_Space_Vector_Generator "mcb_pmsm_foc_hall_f28379d/Current Control/Control_System/Space Vector Generator"
 /begin SUB_GROUP mcb_pmsm_foc_hall_f28379d_Current_Control_Control_System_Space_Vector_Generator_Modulation_method mcb_pmsm_foc_hall_f28379d_Current_Control_Control_System_Space_Vector_Generator_Voltage_Input /end SUB_GROUP
/end GROUP
/begin GROUP mcb_pmsm_foc_hall_f28379d_Current_Control_Control_System_Space_Vector_Generator_Modulation_method "mcb_pmsm_foc_hall_f28379d/Current Control/Control_System/Space Vector Generator/Modulation method"
 /begin SUB_GROUP mcb_pmsm_foc_hall_f28379d_Current_Control_Control_System_Space_Vector_Generator_Modulation_method_SVPWM /end SUB_GROUP
/end GROUP
/begin GROUP mcb_pmsm_foc_hall_f28379d_Current_Control_Control_System_Space_Vector_Generator_Modulation_method_SVPWM "mcb_pmsm_foc_hall_f28379d/Current Control/Control_System/Space Vector Generator/Modulation method/SVPWM"
 /begin SUB_GROUP mcb_pmsm_foc_hall_f28379d_Current_Control_Control_System_Space_Vector_Generator_Modulation_method_SVPWM_Half_Vmin_Vmax_ /end SUB_GROUP
 /begin REF_MEASUREMENT mcb_pmsm_foc_hall_f28379d_B.Add1 mcb_pmsm_foc_hall_f28379d_B.Add2 mcb_pmsm_foc_hall_f28379d_B.Add3 mcb_pmsm_foc_hall_f28379d_B.Gain mcb_pmsm_foc_hall_f28379d_B.add_b mcb_pmsm_foc_hall_f28379d_B.add_c mcb_pmsm_foc_hall_f28379d_B.algDD_o1_c mcb_pmsm_foc_hall_f28379d_B.one_by_two_b /end REF_MEASUREMENT
/end GROUP
/begin GROUP mcb_pmsm_foc_hall_f28379d_Current_Control_Control_System_Space_Vector_Generator_Modulation_method_SVPWM_Half_Vmin_Vmax_ "mcb_pmsm_foc_hall_f28379d/Current Control/Control_System/Space Vector Generator/Modulation method/SVPWM/Half(Vmin+Vmax)"
 /begin REF_MEASUREMENT mcb_pmsm_foc_hall_f28379d_B.Add_i mcb_pmsm_foc_hall_f28379d_B.Max_h mcb_pmsm_foc_hall_f28379d_B.Min_a mcb_pmsm_foc_hall_f28379d_B.add_b mcb_pmsm_foc_hall_f28379d_B.add_c mcb_pmsm_foc_hall_f28379d_B.algDD_o1_c mcb_pmsm_foc_hall_f28379d_B.one_by_two_b /end REF_MEASUREMENT
/end GROUP
/begin GROUP mcb_pmsm_foc_hall_f28379d_Current_Control_Control_System_Space_Vector_Generator_Voltage_Input "mcb_pmsm_foc_hall_f28379d/Current Control/Control_System/Space Vector Generator/Voltage Input"
 /begin SUB_GROUP mcb_pmsm_foc_hall_f28379d_Current_Control_Control_System_Space_Vector_Generator_Voltage_Input_Valphabeta /end SUB_GROUP
/end GROUP
/begin GROUP mcb_pmsm_foc_hall_f28379d_Current_Control_Control_System_Space_Vector_Generator_Voltage_Input_Valphabeta "mcb_pmsm_foc_hall_f28379d/Current Control/Control_System/Space Vector Generator/Voltage Input/Valphabeta"
 /begin SUB_GROUP mcb_pmsm_foc_hall_f28379d_Current_Control_Control_System_Space_Vector_Generator_Voltage_Input_Valphabeta_Inverse_Clarke_Transform /end SUB_GROUP
/end GROUP
/begin GROUP mcb_pmsm_foc_hall_f28379d_Current_Control_Control_System_Space_Vector_Generator_Voltage_Input_Valphabeta_Inverse_Clarke_Transform "mcb_pmsm_foc_hall_f28379d/Current Control/Control_System/Space Vector Generator/Voltage Input/Valphabeta/Inverse Clarke Transform"
 /begin SUB_GROUP mcb_pmsm_foc_hall_f28379d_Current_Control_Control_System_Space_Vector_Generator_Voltage_Input_Valphabeta_Inverse_Clarke_Transform_Two_phase_input /end SUB_GROUP
/end GROUP
/begin GROUP mcb_pmsm_foc_hall_f28379d_Current_Control_Control_System_Space_Vector_Generator_Voltage_Input_Valphabeta_Inverse_Clarke_Transform_Two_phase_input "mcb_pmsm_foc_hall_f28379d/Current Control/Control_System/Space Vector Generator/Voltage Input/Valphabeta/Inverse Clarke Transform/Two phase input"
 /begin REF_MEASUREMENT mcb_pmsm_foc_hall_f28379d_B.add_b mcb_pmsm_foc_hall_f28379d_B.add_c mcb_pmsm_foc_hall_f28379d_B.algDD_o1_c mcb_pmsm_foc_hall_f28379d_B.algDD_o2_e mcb_pmsm_foc_hall_f28379d_B.one_by_two mcb_pmsm_foc_hall_f28379d_B.sqrt3_by_two /end REF_MEASUREMENT
/end GROUP
/begin GROUP mcb_pmsm_foc_hall_f28379d_Current_Control_Input_Scaling "mcb_pmsm_foc_hall_f28379d/Current Control/Input Scaling"
 /begin SUB_GROUP mcb_pmsm_foc_hall_f28379d_Current_Control_Input_Scaling_Read_Sensor__codegen_ /end SUB_GROUP
/end GROUP
/begin GROUP mcb_pmsm_foc_hall_f28379d_Current_Control_Input_Scaling_Read_Sensor__codegen_ "mcb_pmsm_foc_hall_f28379d/Current Control/Input Scaling/Read_Sensor (codegen)"
 /begin SUB_GROUP mcb_pmsm_foc_hall_f28379d_Current_Control_Input_Scaling_Read_Sensor__codegen__Calculate_Position_from_Hall mcb_pmsm_foc_hall_f28379d_Current_Control_Input_Scaling_Read_Sensor__codegen__Convert_ADC_value_to_PU /end SUB_GROUP
/end GROUP
/begin GROUP mcb_pmsm_foc_hall_f28379d_Current_Control_Input_Scaling_Read_Sensor__codegen__Calculate_Position_from_Hall "mcb_pmsm_foc_hall_f28379d/Current Control/Input Scaling/Read_Sensor (codegen)/Calculate Position from Hall"
 /begin SUB_GROUP mcb_pmsm_foc_hall_f28379d_Current_Control_Input_Scaling_Read_Sensor__codegen__Calculate_Position_from_Hall_Atomic_Hall_Reading mcb_pmsm_foc_hall_f28379d_Current_Control_Input_Scaling_Read_Sensor__codegen__Calculate_Position_from_Hall_Glitch_Filter mcb_pmsm_foc_hall_f28379d_Current_Control_Input_Scaling_Read_Sensor__codegen__Calculate_Position_from_Hall_Hall_Speed_and_Position mcb_pmsm_foc_hall_f28379d_Current_Control_Input_Scaling_Read_Sensor__codegen__Calculate_Position_from_Hall_Mechanical_to_Electrical_Position1 mcb_pmsm_foc_hall_f28379d_Current_Control_Input_Scaling_Read_Sensor__codegen__Calculate_Position_from_Hall_Subsystem /end SUB_GROUP
 /begin REF_MEASUREMENT mcb_pmsm_foc_hall_f28379d_B.Switch_a mcb_pmsm_foc_hall_f28379d_DWork.HallStateChangeFlag /end REF_MEASUREMENT
/end GROUP
/begin GROUP mcb_pmsm_foc_hall_f28379d_Current_Control_Input_Scaling_Read_Sensor__codegen__Calculate_Position_from_Hall_Atomic_Hall_Reading "mcb_pmsm_foc_hall_f28379d/Current Control/Input Scaling/Read_Sensor (codegen)/Calculate Position from Hall/Atomic Hall Reading"
 /begin SUB_GROUP mcb_pmsm_foc_hall_f28379d_Current_Control_Input_Scaling_Read_Sensor__codegen__Calculate_Position_from_Hall_Atomic_Hall_Reading_Function_Call_Subsystem mcb_pmsm_foc_hall_f28379d_Current_Control_Input_Scaling_Read_Sensor__codegen__Calculate_Position_from_Hall_Atomic_Hall_Reading_Function_Call_Subsystem1 mcb_pmsm_foc_hall_f28379d_Current_Control_Input_Scaling_Read_Sensor__codegen__Calculate_Position_from_Hall_Atomic_Hall_Reading_Integrity_Check /end SUB_GROUP
 /begin REF_MEASUREMENT mcb_pmsm_foc_hall_f28379d_B.DataStoreRead2 mcb_pmsm_foc_hall_f28379d_B.DataStoreRead3 mcb_pmsm_foc_hall_f28379d_B.DataStoreRead4 mcb_pmsm_foc_hall_f28379d_B.DataStoreRead5 mcb_pmsm_foc_hall_f28379d_DWork.GlobalDirection mcb_pmsm_foc_hall_f28379d_DWork.GlobalSpeedCount mcb_pmsm_foc_hall_f28379d_DWork.GlobalSpeedValidity mcb_pmsm_foc_hall_f28379d_DWork.HallStateChangeFlag /end REF_MEASUREMENT
/end GROUP
/begin GROUP mcb_pmsm_foc_hall_f28379d_Current_Control_Input_Scaling_Read_Sensor__codegen__Calculate_Position_from_Hall_Atomic_Hall_Reading_Function_Call_Subsystem "mcb_pmsm_foc_hall_f28379d/Current Control/Input Scaling/Read_Sensor (codegen)/Calculate Position from Hall/Atomic Hall Reading/Function-Call\r\nSubsystem"
 /begin SUB_GROUP mcb_pmsm_foc_hall_f28379d_Current_Control_Input_Scaling_Read_Sensor__codegen__Calculate_Position_from_Hall_Atomic_Hall_Reading_Function_Call_Subsystem_Read_Halls /end SUB_GROUP
 /begin REF_MEASUREMENT mcb_pmsm_foc_hall_f28379d_B.BitwiseOperator2_p /end REF_MEASUREMENT
/end GROUP
/begin GROUP mcb_pmsm_foc_hall_f28379d_Current_Control_Input_Scaling_Read_Sensor__codegen__Calculate_Position_from_Hall_Atomic_Hall_Reading_Function_Call_Subsystem1 "mcb_pmsm_foc_hall_f28379d/Current Control/Input Scaling/Read_Sensor (codegen)/Calculate Position from Hall/Atomic Hall Reading/Function-Call\r\nSubsystem1"
 /begin REF_MEASUREMENT mcb_pmsm_foc_hall_f28379d_B.MemoryCopy mcb_pmsm_foc_hall_f28379d_B.MemoryCopy1 mcb_pmsm_foc_hall_f28379d_B.MemoryCopy2 mcb_pmsm_foc_hall_f28379d_B.Min /end REF_MEASUREMENT
/end GROUP
/begin GROUP mcb_pmsm_foc_hall_f28379d_Current_Control_Input_Scaling_Read_Sensor__codegen__Calculate_Position_from_Hall_Atomic_Hall_Reading_Function_Call_Subsystem_Read_Halls "mcb_pmsm_foc_hall_f28379d/Current Control/Input Scaling/Read_Sensor (codegen)/Calculate Position from Hall/Atomic Hall Reading/Function-Call\r\nSubsystem/Read Halls"
 /begin REF_MEASUREMENT mcb_pmsm_foc_hall_f28379d_B.BitwiseOperator2_p mcb_pmsm_foc_hall_f28379d_B.Hall_A_c mcb_pmsm_foc_hall_f28379d_B.Hall_B_f mcb_pmsm_foc_hall_f28379d_B.Hall_C_fc mcb_pmsm_foc_hall_f28379d_B.ReadGPIODATregister_nt mcb_pmsm_foc_hall_f28379d_B.ShiftArithmetic1_h mcb_pmsm_foc_hall_f28379d_B.ShiftArithmetic2_e mcb_pmsm_foc_hall_f28379d_B.ShiftArithmetic_p /end REF_MEASUREMENT
/end GROUP
/begin GROUP mcb_pmsm_foc_hall_f28379d_Current_Control_Input_Scaling_Read_Sensor__codegen__Calculate_Position_from_Hall_Atomic_Hall_Reading_Integrity_Check "mcb_pmsm_foc_hall_f28379d/Current Control/Input Scaling/Read_Sensor (codegen)/Calculate Position from Hall/Atomic Hall Reading/Integrity_Check"
 /begin SUB_GROUP mcb_pmsm_foc_hall_f28379d_Current_Control_Input_Scaling_Read_Sensor__codegen__Calculate_Position_from_Hall_Atomic_Hall_Reading_Integrity_Check_Compare_To_Constant mcb_pmsm_foc_hall_f28379d_Current_Control_Input_Scaling_Read_Sensor__codegen__Calculate_Position_from_Hall_Atomic_Hall_Reading_Integrity_Check_No_Integrity_issue mcb_pmsm_foc_hall_f28379d_Current_Control_Input_Scaling_Read_Sensor__codegen__Calculate_Position_from_Hall_Atomic_Hall_Reading_Integrity_Check_Refresh_Halls /end SUB_GROUP
 /begin REF_MEASUREMENT mcb_pmsm_foc_hall_f28379d_B.BitwiseOperator2_p mcb_pmsm_foc_hall_f28379d_B.Compare mcb_pmsm_foc_hall_f28379d_B.Merge mcb_pmsm_foc_hall_f28379d_B.NOT_b mcb_pmsm_foc_hall_f28379d_B.RelationalOperator_k mcb_pmsm_foc_hall_f28379d_B.UnitDelay mcb_pmsm_foc_hall_f28379d_DWork.UnitDelay_DSTATE /end REF_MEASUREMENT
/end GROUP
/begin GROUP mcb_pmsm_foc_hall_f28379d_Current_Control_Input_Scaling_Read_Sensor__codegen__Calculate_Position_from_Hall_Atomic_Hall_Reading_Integrity_Check_Compare_To_Constant "mcb_pmsm_foc_hall_f28379d/Current Control/Input Scaling/Read_Sensor (codegen)/Calculate Position from Hall/Atomic Hall Reading/Integrity_Check/Compare\r\nTo Constant"
 /begin REF_MEASUREMENT mcb_pmsm_foc_hall_f28379d_B.Compare mcb_pmsm_foc_hall_f28379d_B.Min /end REF_MEASUREMENT
/end GROUP
/begin GROUP mcb_pmsm_foc_hall_f28379d_Current_Control_Input_Scaling_Read_Sensor__codegen__Calculate_Position_from_Hall_Atomic_Hall_Reading_Integrity_Check_No_Integrity_issue "mcb_pmsm_foc_hall_f28379d/Current Control/Input Scaling/Read_Sensor (codegen)/Calculate Position from Hall/Atomic Hall Reading/Integrity_Check/No_Integrity_issue" /begin REF_MEASUREMENT mcb_pmsm_foc_hall_f28379d_B.Merge /end REF_MEASUREMENT /end GROUP
/begin GROUP mcb_pmsm_foc_hall_f28379d_Current_Control_Input_Scaling_Read_Sensor__codegen__Calculate_Position_from_Hall_Atomic_Hall_Reading_Integrity_Check_Refresh_Halls "mcb_pmsm_foc_hall_f28379d/Current Control/Input Scaling/Read_Sensor (codegen)/Calculate Position from Hall/Atomic Hall Reading/Integrity_Check/Refresh_Halls"
 /begin SUB_GROUP mcb_pmsm_foc_hall_f28379d_Current_Control_Input_Scaling_Read_Sensor__codegen__Calculate_Position_from_Hall_Atomic_Hall_Reading_Integrity_Check_Refresh_Halls_Read_Halls /end SUB_GROUP
/end GROUP
/begin GROUP mcb_pmsm_foc_hall_f28379d_Current_Control_Input_Scaling_Read_Sensor__codegen__Calculate_Position_from_Hall_Atomic_Hall_Reading_Integrity_Check_Refresh_Halls_Read_Halls "mcb_pmsm_foc_hall_f28379d/Current Control/Input Scaling/Read_Sensor (codegen)/Calculate Position from Hall/Atomic Hall Reading/Integrity_Check/Refresh_Halls/Read Halls"
 /begin REF_MEASUREMENT mcb_pmsm_foc_hall_f28379d_B.BitwiseOperator2_g mcb_pmsm_foc_hall_f28379d_B.Hall_A_d mcb_pmsm_foc_hall_f28379d_B.Hall_B_e mcb_pmsm_foc_hall_f28379d_B.Hall_C_e mcb_pmsm_foc_hall_f28379d_B.ReadGPIODATregister_p mcb_pmsm_foc_hall_f28379d_B.ShiftArithmetic1_c mcb_pmsm_foc_hall_f28379d_B.ShiftArithmetic2_kn mcb_pmsm_foc_hall_f28379d_B.ShiftArithmetic_l /end REF_MEASUREMENT
/end GROUP
/begin GROUP mcb_pmsm_foc_hall_f28379d_Current_Control_Input_Scaling_Read_Sensor__codegen__Calculate_Position_from_Hall_Glitch_Filter "mcb_pmsm_foc_hall_f28379d/Current Control/Input Scaling/Read_Sensor (codegen)/Calculate Position from Hall/Glitch Filter"
 /begin REF_MEASUREMENT mcb_pmsm_foc_hall_f28379d_B.Compare_e mcb_pmsm_foc_hall_f28379d_B.DataStoreRead2 /end REF_MEASUREMENT
/end GROUP
/begin GROUP mcb_pmsm_foc_hall_f28379d_Current_Control_Input_Scaling_Read_Sensor__codegen__Calculate_Position_from_Hall_Hall_Speed_and_Position "mcb_pmsm_foc_hall_f28379d/Current Control/Input Scaling/Read_Sensor (codegen)/Calculate Position from Hall/Hall Speed and Position"
 /begin SUB_GROUP mcb_pmsm_foc_hall_f28379d_Current_Control_Input_Scaling_Read_Sensor__codegen__Calculate_Position_from_Hall_Hall_Speed_and_Position_ExtrapolationOrder mcb_pmsm_foc_hall_f28379d_Current_Control_Input_Scaling_Read_Sensor__codegen__Calculate_Position_from_Hall_Hall_Speed_and_Position_Software_Watchdog_Timer mcb_pmsm_foc_hall_f28379d_Current_Control_Input_Scaling_Read_Sensor__codegen__Calculate_Position_from_Hall_Hall_Speed_and_Position_Speed_and_direction_are_not_valid_Position_will_be_set_to_the_middle_of_the_Hall_quadrant mcb_pmsm_foc_hall_f28379d_Current_Control_Input_Scaling_Read_Sensor__codegen__Calculate_Position_from_Hall_Hall_Speed_and_Position_Speed_and_direction_are_valid_Use_speed_to_extrapolate_position mcb_pmsm_foc_hall_f28379d_Current_Control_Input_Scaling_Read_Sensor__codegen__Calculate_Position_from_Hall_Hall_Speed_and_Position_VaidityCheck /end SUB_GROUP
 /begin REF_MEASUREMENT mcb_pmsm_foc_hall_f28379d_B.DataStoreRead5 mcb_pmsm_foc_hall_f28379d_B.DataTypeConversion4 mcb_pmsm_foc_hall_f28379d_B.Merge1 mcb_pmsm_foc_hall_f28379d_B.Merge_d mcb_pmsm_foc_hall_f28379d_B.Switch_a mcb_pmsm_foc_hall_f28379d_B.watchdogcheck /end REF_MEASUREMENT
/end GROUP
/begin GROUP mcb_pmsm_foc_hall_f28379d_Current_Control_Input_Scaling_Read_Sensor__codegen__Calculate_Position_from_Hall_Hall_Speed_and_Position_ExtrapolationOrder "mcb_pmsm_foc_hall_f28379d/Current Control/Input Scaling/Read_Sensor (codegen)/Calculate Position from Hall/Hall Speed and Position/ExtrapolationOrder"
 /begin REF_MEASUREMENT mcb_pmsm_foc_hall_f28379d_B.DataStoreRead4 mcb_pmsm_foc_hall_f28379d_B.DataStoreRead5 mcb_pmsm_foc_hall_f28379d_B.DataTypeConversion_nh mcb_pmsm_foc_hall_f28379d_B.Input mcb_pmsm_foc_hall_f28379d_B.LogicalOperator_a mcb_pmsm_foc_hall_f28379d_B.Switch_m mcb_pmsm_foc_hall_f28379d_B.speedCountDelay mcb_pmsm_foc_hall_f28379d_B.validityDelay /end REF_MEASUREMENT
/end GROUP
/begin GROUP mcb_pmsm_foc_hall_f28379d_Current_Control_Input_Scaling_Read_Sensor__codegen__Calculate_Position_from_Hall_Hall_Speed_and_Position_Software_Watchdog_Timer "mcb_pmsm_foc_hall_f28379d/Current Control/Input Scaling/Read_Sensor (codegen)/Calculate Position from Hall/Hall Speed and Position/Software Watchdog Timer"
 /begin SUB_GROUP mcb_pmsm_foc_hall_f28379d_Current_Control_Input_Scaling_Read_Sensor__codegen__Calculate_Position_from_Hall_Hall_Speed_and_Position_Software_Watchdog_Timer_Compare_To_Zero /end SUB_GROUP
 /begin REF_MEASUREMENT mcb_pmsm_foc_hall_f28379d_B.Compare_n mcb_pmsm_foc_hall_f28379d_B.DataTypeConversion4 mcb_pmsm_foc_hall_f28379d_B.DelayOneStep mcb_pmsm_foc_hall_f28379d_B.DelayOneStep1 mcb_pmsm_foc_hall_f28379d_B.OR mcb_pmsm_foc_hall_f28379d_B.Sum_m3 mcb_pmsm_foc_hall_f28379d_DWork.DelayOneStep1_DSTATE mcb_pmsm_foc_hall_f28379d_DWork.DelayOneStep_DSTATE /end REF_MEASUREMENT
/end GROUP
/begin GROUP mcb_pmsm_foc_hall_f28379d_Current_Control_Input_Scaling_Read_Sensor__codegen__Calculate_Position_from_Hall_Hall_Speed_and_Position_Software_Watchdog_Timer_Compare_To_Zero "mcb_pmsm_foc_hall_f28379d/Current Control/Input Scaling/Read_Sensor (codegen)/Calculate Position from Hall/Hall Speed and Position/Software Watchdog Timer/Compare\r\nTo Zero"
 /begin REF_MEASUREMENT mcb_pmsm_foc_hall_f28379d_B.Compare_n mcb_pmsm_foc_hall_f28379d_B.DelayOneStep /end REF_MEASUREMENT
/end GROUP
/begin GROUP mcb_pmsm_foc_hall_f28379d_Current_Control_Input_Scaling_Read_Sensor__codegen__Calculate_Position_from_Hall_Hall_Speed_and_Position_Speed_and_direction_are_not_valid_Position_will_be_set_to_the_middle_of_the_Hall_quadrant "mcb_pmsm_foc_hall_f28379d/Current Control/Input Scaling/Read_Sensor (codegen)/Calculate Position from Hall/Hall Speed and Position/Speed and direction are not valid\r\nPosition will be set to the middle of the Hall quadrant"
 /begin SUB_GROUP mcb_pmsm_foc_hall_f28379d_Current_Control_Input_Scaling_Read_Sensor__codegen__Calculate_Position_from_Hall_Hall_Speed_and_Position_Speed_and_direction_are_not_valid_Position_will_be_set_to_the_middle_of_the_Hall_quadrant_independent_Direction /end SUB_GROUP
/end GROUP
/begin GROUP mcb_pmsm_foc_hall_f28379d_Current_Control_Input_Scaling_Read_Sensor__codegen__Calculate_Position_from_Hall_Hall_Speed_and_Position_Speed_and_direction_are_not_valid_Position_will_be_set_to_the_middle_of_the_Hall_quadrant_independent_Direction "mcb_pmsm_foc_hall_f28379d/Current Control/Input Scaling/Read_Sensor (codegen)/Calculate Position from Hall/Hall Speed and Position/Speed and direction are not valid\r\nPosition will be set to the middle of the Hall quadrant/independent Direction"
 /begin REF_MEASUREMENT mcb_pmsm_foc_hall_f28379d_B.Merge mcb_pmsm_foc_hall_f28379d_B.Merge1 /end REF_MEASUREMENT
/end GROUP
/begin GROUP mcb_pmsm_foc_hall_f28379d_Current_Control_Input_Scaling_Read_Sensor__codegen__Calculate_Position_from_Hall_Hall_Speed_and_Position_Speed_and_direction_are_valid_Use_speed_to_extrapolate_position "mcb_pmsm_foc_hall_f28379d/Current Control/Input Scaling/Read_Sensor (codegen)/Calculate Position from Hall/Hall Speed and Position/Speed and direction are valid\r\nUse speed to extrapolate position"
 /begin SUB_GROUP mcb_pmsm_foc_hall_f28379d_Current_Control_Input_Scaling_Read_Sensor__codegen__Calculate_Position_from_Hall_Hall_Speed_and_Position_Speed_and_direction_are_valid_Use_speed_to_extrapolate_position_If_Action_Subsystem mcb_pmsm_foc_hall_f28379d_Current_Control_Input_Scaling_Read_Sensor__codegen__Calculate_Position_from_Hall_Hall_Speed_and_Position_Speed_and_direction_are_valid_Use_speed_to_extrapolate_position_If_Action_Subsystem1 mcb_pmsm_foc_hall_f28379d_Current_Control_Input_Scaling_Read_Sensor__codegen__Calculate_Position_from_Hall_Hall_Speed_and_Position_Speed_and_direction_are_valid_Use_speed_to_extrapolate_position_Subsystem1 /end SUB_GROUP
 /begin REF_MEASUREMENT mcb_pmsm_foc_hall_f28379d_B.DataStoreRead3 mcb_pmsm_foc_hall_f28379d_B.Divide mcb_pmsm_foc_hall_f28379d_B.Input mcb_pmsm_foc_hall_f28379d_B.Merge_d mcb_pmsm_foc_hall_f28379d_B.SpeedGain mcb_pmsm_foc_hall_f28379d_B.currentSpeedData /end REF_MEASUREMENT
/end GROUP
/begin GROUP mcb_pmsm_foc_hall_f28379d_Current_Control_Input_Scaling_Read_Sensor__codegen__Calculate_Position_from_Hall_Hall_Speed_and_Position_Speed_and_direction_are_valid_Use_speed_to_extrapolate_position_If_Action_Subsystem "mcb_pmsm_foc_hall_f28379d/Current Control/Input Scaling/Read_Sensor (codegen)/Calculate Position from Hall/Hall Speed and Position/Speed and direction are valid\r\nUse speed to extrapolate position/If Action\r\nSubsystem" /begin REF_MEASUREMENT mcb_pmsm_foc_hall_f28379d_B.Merge_d /end REF_MEASUREMENT /end GROUP
/begin GROUP mcb_pmsm_foc_hall_f28379d_Current_Control_Input_Scaling_Read_Sensor__codegen__Calculate_Position_from_Hall_Hall_Speed_and_Position_Speed_and_direction_are_valid_Use_speed_to_extrapolate_position_If_Action_Subsystem1 "mcb_pmsm_foc_hall_f28379d/Current Control/Input Scaling/Read_Sensor (codegen)/Calculate Position from Hall/Hall Speed and Position/Speed and direction are valid\r\nUse speed to extrapolate position/If Action\r\nSubsystem1"
 /begin REF_MEASUREMENT mcb_pmsm_foc_hall_f28379d_B.Merge_d mcb_pmsm_foc_hall_f28379d_B.SpeedGain /end REF_MEASUREMENT
/end GROUP
/begin GROUP mcb_pmsm_foc_hall_f28379d_Current_Control_Input_Scaling_Read_Sensor__codegen__Calculate_Position_from_Hall_Hall_Speed_and_Position_Speed_and_direction_are_valid_Use_speed_to_extrapolate_position_Subsystem1 "mcb_pmsm_foc_hall_f28379d/Current Control/Input Scaling/Read_Sensor (codegen)/Calculate Position from Hall/Hall Speed and Position/Speed and direction are valid\r\nUse speed to extrapolate position/Subsystem1"
 /begin SUB_GROUP mcb_pmsm_foc_hall_f28379d_Current_Control_Input_Scaling_Read_Sensor__codegen__Calculate_Position_from_Hall_Hall_Speed_and_Position_Speed_and_direction_are_valid_Use_speed_to_extrapolate_position_Subsystem1__ve_Direction mcb_pmsm_foc_hall_f28379d_Current_Control_Input_Scaling_Read_Sensor__codegen__Calculate_Position_from_Hall_Hall_Speed_and_Position_Speed_and_direction_are_valid_Use_speed_to_extrapolate_position_Subsystem1_first_order mcb_pmsm_foc_hall_f28379d_Current_Control_Input_Scaling_Read_Sensor__codegen__Calculate_Position_from_Hall_Hall_Speed_and_Position_Speed_and_direction_are_valid_Use_speed_to_extrapolate_position_Subsystem1_second_order /end SUB_GROUP
 /begin REF_MEASUREMENT mcb_pmsm_foc_hall_f28379d_B.DataStoreRead3 mcb_pmsm_foc_hall_f28379d_B.Merge1_l mcb_pmsm_foc_hall_f28379d_B.Merge_c mcb_pmsm_foc_hall_f28379d_B.Saturation_k /end REF_MEASUREMENT
/end GROUP
/begin GROUP mcb_pmsm_foc_hall_f28379d_Current_Control_Input_Scaling_Read_Sensor__codegen__Calculate_Position_from_Hall_Hall_Speed_and_Position_Speed_and_direction_are_valid_Use_speed_to_extrapolate_position_Subsystem1__ve_Direction "mcb_pmsm_foc_hall_f28379d/Current Control/Input Scaling/Read_Sensor (codegen)/Calculate Position from Hall/Hall Speed and Position/Speed and direction are valid\r\nUse speed to extrapolate position/Subsystem1/+ve Direction"
 /begin REF_MEASUREMENT mcb_pmsm_foc_hall_f28379d_B.Merge mcb_pmsm_foc_hall_f28379d_B.Merge1_la mcb_pmsm_foc_hall_f28379d_B.Merge_c mcb_pmsm_foc_hall_f28379d_B.Saturation_k /end REF_MEASUREMENT
/end GROUP
/begin GROUP mcb_pmsm_foc_hall_f28379d_Current_Control_Input_Scaling_Read_Sensor__codegen__Calculate_Position_from_Hall_Hall_Speed_and_Position_Speed_and_direction_are_valid_Use_speed_to_extrapolate_position_Subsystem1_first_order "mcb_pmsm_foc_hall_f28379d/Current Control/Input Scaling/Read_Sensor (codegen)/Calculate Position from Hall/Hall Speed and Position/Speed and direction are valid\r\nUse speed to extrapolate position/Subsystem1/first_order"
 /begin REF_MEASUREMENT mcb_pmsm_foc_hall_f28379d_B.Divide_f mcb_pmsm_foc_hall_f28379d_B.Input mcb_pmsm_foc_hall_f28379d_B.Merge1_l mcb_pmsm_foc_hall_f28379d_B.Min mcb_pmsm_foc_hall_f28379d_B.countData mcb_pmsm_foc_hall_f28379d_B.currentSpeedData_k /end REF_MEASUREMENT
/end GROUP
/begin GROUP mcb_pmsm_foc_hall_f28379d_Current_Control_Input_Scaling_Read_Sensor__codegen__Calculate_Position_from_Hall_Hall_Speed_and_Position_Speed_and_direction_are_valid_Use_speed_to_extrapolate_position_Subsystem1_second_order "mcb_pmsm_foc_hall_f28379d/Current Control/Input Scaling/Read_Sensor (codegen)/Calculate Position from Hall/Hall Speed and Position/Speed and direction are valid\r\nUse speed to extrapolate position/Subsystem1/second_order"
 /begin REF_MEASUREMENT mcb_pmsm_foc_hall_f28379d_B.Divide1 mcb_pmsm_foc_hall_f28379d_B.Divide_i mcb_pmsm_foc_hall_f28379d_B.Gain1 mcb_pmsm_foc_hall_f28379d_B.Input mcb_pmsm_foc_hall_f28379d_B.Merge1_l mcb_pmsm_foc_hall_f28379d_B.Min mcb_pmsm_foc_hall_f28379d_B.Product_i mcb_pmsm_foc_hall_f28379d_B.Sum1_i mcb_pmsm_foc_hall_f28379d_B.Sum_n mcb_pmsm_foc_hall_f28379d_B.countData_o mcb_pmsm_foc_hall_f28379d_B.currentSpeedData_o mcb_pmsm_foc_hall_f28379d_B.previousSpeedData mcb_pmsm_foc_hall_f28379d_B.speedCountDelay /end REF_MEASUREMENT
/end GROUP
/begin GROUP mcb_pmsm_foc_hall_f28379d_Current_Control_Input_Scaling_Read_Sensor__codegen__Calculate_Position_from_Hall_Hall_Speed_and_Position_VaidityCheck "mcb_pmsm_foc_hall_f28379d/Current Control/Input Scaling/Read_Sensor (codegen)/Calculate Position from Hall/Hall Speed and Position/VaidityCheck"
 /begin REF_MEASUREMENT mcb_pmsm_foc_hall_f28379d_B.Compare_n mcb_pmsm_foc_hall_f28379d_B.Input mcb_pmsm_foc_hall_f28379d_B.LogicalOperator_a mcb_pmsm_foc_hall_f28379d_B.Max mcb_pmsm_foc_hall_f28379d_B.Min mcb_pmsm_foc_hall_f28379d_B.speedcheck mcb_pmsm_foc_hall_f28379d_B.watchdogcheck /end REF_MEASUREMENT
/end GROUP
/begin GROUP mcb_pmsm_foc_hall_f28379d_Current_Control_Input_Scaling_Read_Sensor__codegen__Calculate_Position_from_Hall_Mechanical_to_Electrical_Position1 "mcb_pmsm_foc_hall_f28379d/Current Control/Input Scaling/Read_Sensor (codegen)/Calculate Position from Hall/Mechanical to Electrical Position1"
 /begin SUB_GROUP mcb_pmsm_foc_hall_f28379d_Current_Control_Input_Scaling_Read_Sensor__codegen__Calculate_Position_from_Hall_Mechanical_to_Electrical_Position1_MechToElec /end SUB_GROUP
/end GROUP
/begin GROUP mcb_pmsm_foc_hall_f28379d_Current_Control_Input_Scaling_Read_Sensor__codegen__Calculate_Position_from_Hall_Mechanical_to_Electrical_Position1_MechToElec "mcb_pmsm_foc_hall_f28379d/Current Control/Input Scaling/Read_Sensor (codegen)/Calculate Position from Hall/Mechanical to Electrical Position1/MechToElec"
 /begin SUB_GROUP mcb_pmsm_foc_hall_f28379d_Current_Control_Input_Scaling_Read_Sensor__codegen__Calculate_Position_from_Hall_Mechanical_to_Electrical_Position1_MechToElec_floating_point /end SUB_GROUP
/end GROUP
/begin GROUP mcb_pmsm_foc_hall_f28379d_Current_Control_Input_Scaling_Read_Sensor__codegen__Calculate_Position_from_Hall_Mechanical_to_Electrical_Position1_MechToElec_floating_point "mcb_pmsm_foc_hall_f28379d/Current Control/Input Scaling/Read_Sensor (codegen)/Calculate Position from Hall/Mechanical to Electrical Position1/MechToElec/floating-point"
 /begin SUB_GROUP mcb_pmsm_foc_hall_f28379d_Current_Control_Input_Scaling_Read_Sensor__codegen__Calculate_Position_from_Hall_Mechanical_to_Electrical_Position1_MechToElec_floating_point_Compensate_Offset mcb_pmsm_foc_hall_f28379d_Current_Control_Input_Scaling_Read_Sensor__codegen__Calculate_Position_from_Hall_Mechanical_to_Electrical_Position1_MechToElec_floating_point_Mech_To_Elec /end SUB_GROUP
 /begin REF_MEASUREMENT mcb_pmsm_foc_hall_f28379d_B.Switch_h /end REF_MEASUREMENT
/end GROUP
/begin GROUP mcb_pmsm_foc_hall_f28379d_Current_Control_Input_Scaling_Read_Sensor__codegen__Calculate_Position_from_Hall_Mechanical_to_Electrical_Position1_MechToElec_floating_point_Compensate_Offset "mcb_pmsm_foc_hall_f28379d/Current Control/Input Scaling/Read_Sensor (codegen)/Calculate Position from Hall/Mechanical to Electrical Position1/MechToElec/floating-point/Compensate Offset"
 /begin SUB_GROUP mcb_pmsm_foc_hall_f28379d_Current_Control_Input_Scaling_Read_Sensor__codegen__Calculate_Position_from_Hall_Mechanical_to_Electrical_Position1_MechToElec_floating_point_Compensate_Offset_If_Action_Subsystem mcb_pmsm_foc_hall_f28379d_Current_Control_Input_Scaling_Read_Sensor__codegen__Calculate_Position_from_Hall_Mechanical_to_Electrical_Position1_MechToElec_floating_point_Compensate_Offset_If_Action_Subsystem1 /end SUB_GROUP
 /begin REF_MEASUREMENT mcb_pmsm_foc_hall_f28379d_B.Merge1 mcb_pmsm_foc_hall_f28379d_B.Merge_m mcb_pmsm_foc_hall_f28379d_B.Switch_h /end REF_MEASUREMENT
/end GROUP
/begin GROUP mcb_pmsm_foc_hall_f28379d_Current_Control_Input_Scaling_Read_Sensor__codegen__Calculate_Position_from_Hall_Mechanical_to_Electrical_Position1_MechToElec_floating_point_Compensate_Offset_If_Action_Subsystem "mcb_pmsm_foc_hall_f28379d/Current Control/Input Scaling/Read_Sensor (codegen)/Calculate Position from Hall/Mechanical to Electrical Position1/MechToElec/floating-point/Compensate Offset/If Action\r\nSubsystem"
 /begin REF_MEASUREMENT mcb_pmsm_foc_hall_f28379d_B.Merge1 mcb_pmsm_foc_hall_f28379d_B.Merge_m mcb_pmsm_foc_hall_f28379d_B.Switch_h /end REF_MEASUREMENT
/end GROUP
/begin GROUP mcb_pmsm_foc_hall_f28379d_Current_Control_Input_Scaling_Read_Sensor__codegen__Calculate_Position_from_Hall_Mechanical_to_Electrical_Position1_MechToElec_floating_point_Compensate_Offset_If_Action_Subsystem1 "mcb_pmsm_foc_hall_f28379d/Current Control/Input Scaling/Read_Sensor (codegen)/Calculate Position from Hall/Mechanical to Electrical Position1/MechToElec/floating-point/Compensate Offset/If Action\r\nSubsystem1"
 /begin REF_MEASUREMENT mcb_pmsm_foc_hall_f28379d_B.Merge1 mcb_pmsm_foc_hall_f28379d_B.Merge_m mcb_pmsm_foc_hall_f28379d_B.Switch_h /end REF_MEASUREMENT
/end GROUP
/begin GROUP mcb_pmsm_foc_hall_f28379d_Current_Control_Input_Scaling_Read_Sensor__codegen__Calculate_Position_from_Hall_Mechanical_to_Electrical_Position1_MechToElec_floating_point_Mech_To_Elec "mcb_pmsm_foc_hall_f28379d/Current Control/Input Scaling/Read_Sensor (codegen)/Calculate Position from Hall/Mechanical to Electrical Position1/MechToElec/floating-point/Mech To Elec"
 /begin REF_MEASUREMENT mcb_pmsm_foc_hall_f28379d_B.Add mcb_pmsm_foc_hall_f28379d_B.Floor mcb_pmsm_foc_hall_f28379d_B.Merge_m /end REF_MEASUREMENT
/end GROUP
/begin GROUP mcb_pmsm_foc_hall_f28379d_Current_Control_Input_Scaling_Read_Sensor__codegen__Calculate_Position_from_Hall_Subsystem "mcb_pmsm_foc_hall_f28379d/Current Control/Input Scaling/Read_Sensor (codegen)/Calculate Position from Hall/Subsystem" /begin REF_MEASUREMENT mcb_pmsm_foc_hall_f28379d_B.Input /end REF_MEASUREMENT /end GROUP
/begin GROUP mcb_pmsm_foc_hall_f28379d_Current_Control_Input_Scaling_Read_Sensor__codegen__Convert_ADC_value_to_PU "mcb_pmsm_foc_hall_f28379d/Current Control/Input Scaling/Read_Sensor (codegen)/Convert ADC value to PU"
 /begin SUB_GROUP mcb_pmsm_foc_hall_f28379d_Current_Control_Input_Scaling_Read_Sensor__codegen__Convert_ADC_value_to_PU_Data_Type /end SUB_GROUP
 /begin REF_MEASUREMENT mcb_pmsm_foc_hall_f28379d_B.Add_f mcb_pmsm_foc_hall_f28379d_B.DataStoreRead1 mcb_pmsm_foc_hall_f28379d_B.DataStoreRead_k mcb_pmsm_foc_hall_f28379d_B.DataTypeConversion_f mcb_pmsm_foc_hall_f28379d_B.InvertingNoninvertingCurrentmea mcb_pmsm_foc_hall_f28379d_B.PU_Conversion mcb_pmsm_foc_hall_f28379d_DWork.Add_DWORK1 mcb_pmsm_foc_hall_f28379d_DWork.IaOffset mcb_pmsm_foc_hall_f28379d_DWork.IbOffset /end REF_MEASUREMENT
/end GROUP
/begin GROUP mcb_pmsm_foc_hall_f28379d_Current_Control_Input_Scaling_Read_Sensor__codegen__Convert_ADC_value_to_PU_Data_Type "mcb_pmsm_foc_hall_f28379d/Current Control/Input Scaling/Read_Sensor (codegen)/Convert ADC value to PU/Data_Type"
 /begin SUB_GROUP mcb_pmsm_foc_hall_f28379d_Current_Control_Input_Scaling_Read_Sensor__codegen__Convert_ADC_value_to_PU_Data_Type_Data_Type_Float /end SUB_GROUP
/end GROUP
/begin GROUP mcb_pmsm_foc_hall_f28379d_Current_Control_Input_Scaling_Read_Sensor__codegen__Convert_ADC_value_to_PU_Data_Type_Data_Type_Float "mcb_pmsm_foc_hall_f28379d/Current Control/Input Scaling/Read_Sensor (codegen)/Convert ADC value to PU/Data_Type/Data_Type_Float"
 /begin REF_MEASUREMENT mcb_pmsm_foc_hall_f28379d_B.Add_f mcb_pmsm_foc_hall_f28379d_B.GetADCVoltage mcb_pmsm_foc_hall_f28379d_B.GetCurrents mcb_pmsm_foc_hall_f28379d_B.PU_Conversion /end REF_MEASUREMENT
/end GROUP
/begin GROUP mcb_pmsm_foc_hall_f28379d_Current_Control_Inverter "mcb_pmsm_foc_hall_f28379d/Current Control/Inverter"
 /begin SUB_GROUP mcb_pmsm_foc_hall_f28379d_Current_Control_Inverter_Code_Generation /end SUB_GROUP
/end GROUP
/begin GROUP mcb_pmsm_foc_hall_f28379d_Current_Control_Inverter_Code_Generation "mcb_pmsm_foc_hall_f28379d/Current Control/Inverter/Code Generation"
 /begin REF_MEASUREMENT mcb_pmsm_foc_hall_f28379d_B.DataTypeConversion mcb_pmsm_foc_hall_f28379d_B.PWM_Duty_Cycles mcb_pmsm_foc_hall_f28379d_B.Scale_to_PWM_Counter_PRD mcb_pmsm_foc_hall_f28379d_B.Switch1_f mcb_pmsm_foc_hall_f28379d_B.Switch_f mcb_pmsm_foc_hall_f28379d_DWork.InverterEnable_FRAC_LEN /end REF_MEASUREMENT
/end GROUP
/begin GROUP mcb_pmsm_foc_hall_f28379d_Current_Control_Output_Scaling "mcb_pmsm_foc_hall_f28379d/Current Control/Output Scaling"
 /begin REF_MEASUREMENT mcb_pmsm_foc_hall_f28379d_B.DataTypeConversion mcb_pmsm_foc_hall_f28379d_B.Enable mcb_pmsm_foc_hall_f28379d_B.Gain mcb_pmsm_foc_hall_f28379d_B.Gain_m mcb_pmsm_foc_hall_f28379d_B.PWM_Duty_Cycles mcb_pmsm_foc_hall_f28379d_DWork.Enable /end REF_MEASUREMENT
/end GROUP
/begin GROUP mcb_pmsm_foc_hall_f28379d_Current_Control_Sensor_Driver_Blocks "mcb_pmsm_foc_hall_f28379d/Current Control/Sensor Driver Blocks"
 /begin SUB_GROUP mcb_pmsm_foc_hall_f28379d_Current_Control_Sensor_Driver_Blocks_Sensor_Driver_Blocks__codegen_ /end SUB_GROUP
/end GROUP
/begin GROUP mcb_pmsm_foc_hall_f28379d_Current_Control_Sensor_Driver_Blocks_Sensor_Driver_Blocks__codegen_ "mcb_pmsm_foc_hall_f28379d/Current Control/Sensor Driver Blocks/Sensor Driver Blocks (codegen)"
 /begin REF_MEASUREMENT mcb_pmsm_foc_hall_f28379d_B.ADC_B_IN2 mcb_pmsm_foc_hall_f28379d_B.ADC_C_IN2 /end REF_MEASUREMENT
/end GROUP
/begin GROUP mcb_pmsm_foc_hall_f28379d_Hall_Sensor_A "mcb_pmsm_foc_hall_f28379d/Hall Sensor A"
 /begin SUB_GROUP mcb_pmsm_foc_hall_f28379d_Hall_Sensor_A_Capture_Event_Selection mcb_pmsm_foc_hall_f28379d_Hall_Sensor_A_HallValidity mcb_pmsm_foc_hall_f28379d_Hall_Sensor_A_Hall_Validity mcb_pmsm_foc_hall_f28379d_Hall_Sensor_A_eCAP /end SUB_GROUP
 /begin REF_MEASUREMENT mcb_pmsm_foc_hall_f28379d_B.BitwiseOperator2_n mcb_pmsm_foc_hall_f28379d_B.DataStoreRead1_o mcb_pmsm_foc_hall_f28379d_B.DataStoreRead_p mcb_pmsm_foc_hall_f28379d_B.DataTypeConversion_p mcb_pmsm_foc_hall_f28379d_B.Merge1_kl mcb_pmsm_foc_hall_f28379d_B.Merge_n mcb_pmsm_foc_hall_f28379d_B.Switch_e mcb_pmsm_foc_hall_f28379d_B.eCAP_l mcb_pmsm_foc_hall_f28379d_DWork.GlobalDirection mcb_pmsm_foc_hall_f28379d_DWork.GlobalHallState mcb_pmsm_foc_hall_f28379d_DWork.GlobalSpeedCount mcb_pmsm_foc_hall_f28379d_DWork.GlobalSpeedValidity mcb_pmsm_foc_hall_f28379d_DWork.HallStateChangeFlag /end REF_MEASUREMENT
/end GROUP
/begin GROUP mcb_pmsm_foc_hall_f28379d_Hall_Sensor_A_Capture_Event_Selection "mcb_pmsm_foc_hall_f28379d/Hall Sensor A/Capture Event Selection"
 /begin REF_MEASUREMENT mcb_pmsm_foc_hall_f28379d_B.BitwiseOperator2_n mcb_pmsm_foc_hall_f28379d_B.Merge_n /end REF_MEASUREMENT
/end GROUP
/begin GROUP mcb_pmsm_foc_hall_f28379d_Hall_Sensor_A_HallValidity "mcb_pmsm_foc_hall_f28379d/Hall Sensor A/HallValidity"
 /begin SUB_GROUP mcb_pmsm_foc_hall_f28379d_Hall_Sensor_A_HallValidity_CodeGen /end SUB_GROUP
/end GROUP
/begin GROUP mcb_pmsm_foc_hall_f28379d_Hall_Sensor_A_HallValidity_CodeGen "mcb_pmsm_foc_hall_f28379d/Hall Sensor A/HallValidity/CodeGen"
 /begin SUB_GROUP mcb_pmsm_foc_hall_f28379d_Hall_Sensor_A_HallValidity_CodeGen_Read_Halls /end SUB_GROUP
/end GROUP
/begin GROUP mcb_pmsm_foc_hall_f28379d_Hall_Sensor_A_HallValidity_CodeGen_Read_Halls "mcb_pmsm_foc_hall_f28379d/Hall Sensor A/HallValidity/CodeGen/Read Halls"
 /begin REF_MEASUREMENT mcb_pmsm_foc_hall_f28379d_B.BitwiseOperator2_n mcb_pmsm_foc_hall_f28379d_B.Hall_A_k mcb_pmsm_foc_hall_f28379d_B.Hall_B_i mcb_pmsm_foc_hall_f28379d_B.Hall_C_n mcb_pmsm_foc_hall_f28379d_B.ReadGPIODATregister_g mcb_pmsm_foc_hall_f28379d_B.ShiftArithmetic1_jb mcb_pmsm_foc_hall_f28379d_B.ShiftArithmetic2_i mcb_pmsm_foc_hall_f28379d_B.ShiftArithmetic_e /end REF_MEASUREMENT
/end GROUP
/begin GROUP mcb_pmsm_foc_hall_f28379d_Hall_Sensor_A_Hall_Validity "mcb_pmsm_foc_hall_f28379d/Hall Sensor A/Hall Validity"
 /begin SUB_GROUP mcb_pmsm_foc_hall_f28379d_Hall_Sensor_A_Hall_Validity_Subsystem /end SUB_GROUP
 /begin REF_MEASUREMENT mcb_pmsm_foc_hall_f28379d_B.BitwiseOperator2_n mcb_pmsm_foc_hall_f28379d_B.DataStoreRead_p mcb_pmsm_foc_hall_f28379d_B.DataTypeConversion1_d mcb_pmsm_foc_hall_f28379d_B.DataTypeConversion2_c /end REF_MEASUREMENT
/end GROUP
/begin GROUP mcb_pmsm_foc_hall_f28379d_Hall_Sensor_A_Hall_Validity_Subsystem "mcb_pmsm_foc_hall_f28379d/Hall Sensor A/Hall Validity/Subsystem"
 /begin SUB_GROUP mcb_pmsm_foc_hall_f28379d_Hall_Sensor_A_Hall_Validity_Subsystem_Bad_hall__glitch_or_wrong_connection_ mcb_pmsm_foc_hall_f28379d_Hall_Sensor_A_Hall_Validity_Subsystem_Valid_Halls /end SUB_GROUP
 /begin REF_MEASUREMENT mcb_pmsm_foc_hall_f28379d_B.DataTypeConversion_p mcb_pmsm_foc_hall_f28379d_B.Merge1_kl mcb_pmsm_foc_hall_f28379d_B.Merge3_m mcb_pmsm_foc_hall_f28379d_B.Merge_k /end REF_MEASUREMENT
/end GROUP
/begin GROUP mcb_pmsm_foc_hall_f28379d_Hall_Sensor_A_Hall_Validity_Subsystem_Bad_hall__glitch_or_wrong_connection_ "mcb_pmsm_foc_hall_f28379d/Hall Sensor A/Hall Validity/Subsystem/Bad hall\r\n(glitch or wrong connection)"
 /begin REF_MEASUREMENT mcb_pmsm_foc_hall_f28379d_B.DataStoreRead1_o mcb_pmsm_foc_hall_f28379d_B.Merge1_kl /end REF_MEASUREMENT
/end GROUP
/begin GROUP mcb_pmsm_foc_hall_f28379d_Hall_Sensor_A_Hall_Validity_Subsystem_Valid_Halls "mcb_pmsm_foc_hall_f28379d/Hall Sensor A/Hall Validity/Subsystem/Valid Halls"
 /begin REF_MEASUREMENT mcb_pmsm_foc_hall_f28379d_B.DataStoreRead1_o mcb_pmsm_foc_hall_f28379d_B.DataTypeConversion1_d mcb_pmsm_foc_hall_f28379d_B.DataTypeConversion2_c mcb_pmsm_foc_hall_f28379d_B.Merge1_kl mcb_pmsm_foc_hall_f28379d_B.Merge3_m mcb_pmsm_foc_hall_f28379d_B.Merge_k /end REF_MEASUREMENT
/end GROUP
/begin GROUP mcb_pmsm_foc_hall_f28379d_Hall_Sensor_A_eCAP "mcb_pmsm_foc_hall_f28379d/Hall Sensor A/eCAP"
 /begin SUB_GROUP mcb_pmsm_foc_hall_f28379d_Hall_Sensor_A_eCAP_Code_generation /end SUB_GROUP
/end GROUP
/begin GROUP mcb_pmsm_foc_hall_f28379d_Hall_Sensor_A_eCAP_Code_generation "mcb_pmsm_foc_hall_f28379d/Hall Sensor A/eCAP/Code generation" /begin REF_MEASUREMENT mcb_pmsm_foc_hall_f28379d_B.eCAP_l /end REF_MEASUREMENT /end GROUP
/begin GROUP mcb_pmsm_foc_hall_f28379d_Hall_Sensor_B "mcb_pmsm_foc_hall_f28379d/Hall Sensor B"
 /begin SUB_GROUP mcb_pmsm_foc_hall_f28379d_Hall_Sensor_B_Capture_Event_Selection mcb_pmsm_foc_hall_f28379d_Hall_Sensor_B_HallValidity mcb_pmsm_foc_hall_f28379d_Hall_Sensor_B_Hall_Validity mcb_pmsm_foc_hall_f28379d_Hall_Sensor_B_eCAP /end SUB_GROUP
 /begin REF_MEASUREMENT mcb_pmsm_foc_hall_f28379d_B.BitwiseOperator2_m mcb_pmsm_foc_hall_f28379d_B.DataStoreRead1_kl mcb_pmsm_foc_hall_f28379d_B.DataStoreRead_o mcb_pmsm_foc_hall_f28379d_B.DataTypeConversion_j mcb_pmsm_foc_hall_f28379d_B.Merge1_a mcb_pmsm_foc_hall_f28379d_B.Merge_f mcb_pmsm_foc_hall_f28379d_B.Switch_l mcb_pmsm_foc_hall_f28379d_B.eCAP_c mcb_pmsm_foc_hall_f28379d_DWork.GlobalDirection mcb_pmsm_foc_hall_f28379d_DWork.GlobalHallState mcb_pmsm_foc_hall_f28379d_DWork.GlobalSpeedCount mcb_pmsm_foc_hall_f28379d_DWork.GlobalSpeedValidity mcb_pmsm_foc_hall_f28379d_DWork.HallStateChangeFlag /end REF_MEASUREMENT
/end GROUP
/begin GROUP mcb_pmsm_foc_hall_f28379d_Hall_Sensor_B_Capture_Event_Selection "mcb_pmsm_foc_hall_f28379d/Hall Sensor B/Capture Event Selection"
 /begin REF_MEASUREMENT mcb_pmsm_foc_hall_f28379d_B.BitwiseOperator2_m mcb_pmsm_foc_hall_f28379d_B.Merge_f /end REF_MEASUREMENT
/end GROUP
/begin GROUP mcb_pmsm_foc_hall_f28379d_Hall_Sensor_B_HallValidity "mcb_pmsm_foc_hall_f28379d/Hall Sensor B/HallValidity"
 /begin SUB_GROUP mcb_pmsm_foc_hall_f28379d_Hall_Sensor_B_HallValidity_CodeGen /end SUB_GROUP
/end GROUP
/begin GROUP mcb_pmsm_foc_hall_f28379d_Hall_Sensor_B_HallValidity_CodeGen "mcb_pmsm_foc_hall_f28379d/Hall Sensor B/HallValidity/CodeGen"
 /begin SUB_GROUP mcb_pmsm_foc_hall_f28379d_Hall_Sensor_B_HallValidity_CodeGen_Read_Halls /end SUB_GROUP
/end GROUP
/begin GROUP mcb_pmsm_foc_hall_f28379d_Hall_Sensor_B_HallValidity_CodeGen_Read_Halls "mcb_pmsm_foc_hall_f28379d/Hall Sensor B/HallValidity/CodeGen/Read Halls"
 /begin REF_MEASUREMENT mcb_pmsm_foc_hall_f28379d_B.BitwiseOperator2_m mcb_pmsm_foc_hall_f28379d_B.Hall_A_e mcb_pmsm_foc_hall_f28379d_B.Hall_B_m mcb_pmsm_foc_hall_f28379d_B.Hall_C_f mcb_pmsm_foc_hall_f28379d_B.ReadGPIODATregister_n mcb_pmsm_foc_hall_f28379d_B.ShiftArithmetic1_j mcb_pmsm_foc_hall_f28379d_B.ShiftArithmetic2_k mcb_pmsm_foc_hall_f28379d_B.ShiftArithmetic_b /end REF_MEASUREMENT
/end GROUP
/begin GROUP mcb_pmsm_foc_hall_f28379d_Hall_Sensor_B_Hall_Validity "mcb_pmsm_foc_hall_f28379d/Hall Sensor B/Hall Validity"
 /begin SUB_GROUP mcb_pmsm_foc_hall_f28379d_Hall_Sensor_B_Hall_Validity_Subsystem /end SUB_GROUP
 /begin REF_MEASUREMENT mcb_pmsm_foc_hall_f28379d_B.BitwiseOperator2_m mcb_pmsm_foc_hall_f28379d_B.DataStoreRead_o mcb_pmsm_foc_hall_f28379d_B.DataTypeConversion1_n mcb_pmsm_foc_hall_f28379d_B.DataTypeConversion2_g /end REF_MEASUREMENT
/end GROUP
/begin GROUP mcb_pmsm_foc_hall_f28379d_Hall_Sensor_B_Hall_Validity_Subsystem "mcb_pmsm_foc_hall_f28379d/Hall Sensor B/Hall Validity/Subsystem"
 /begin SUB_GROUP mcb_pmsm_foc_hall_f28379d_Hall_Sensor_B_Hall_Validity_Subsystem_Bad_hall__glitch_or_wrong_connection_ mcb_pmsm_foc_hall_f28379d_Hall_Sensor_B_Hall_Validity_Subsystem_Valid_Halls /end SUB_GROUP
 /begin REF_MEASUREMENT mcb_pmsm_foc_hall_f28379d_B.DataTypeConversion_j mcb_pmsm_foc_hall_f28379d_B.Merge1_a mcb_pmsm_foc_hall_f28379d_B.Merge3_o mcb_pmsm_foc_hall_f28379d_B.Merge_j /end REF_MEASUREMENT
/end GROUP
/begin GROUP mcb_pmsm_foc_hall_f28379d_Hall_Sensor_B_Hall_Validity_Subsystem_Bad_hall__glitch_or_wrong_connection_ "mcb_pmsm_foc_hall_f28379d/Hall Sensor B/Hall Validity/Subsystem/Bad hall\r\n(glitch or wrong connection)"
 /begin REF_MEASUREMENT mcb_pmsm_foc_hall_f28379d_B.DataStoreRead1_kl mcb_pmsm_foc_hall_f28379d_B.Merge1_a /end REF_MEASUREMENT
/end GROUP
/begin GROUP mcb_pmsm_foc_hall_f28379d_Hall_Sensor_B_Hall_Validity_Subsystem_Valid_Halls "mcb_pmsm_foc_hall_f28379d/Hall Sensor B/Hall Validity/Subsystem/Valid Halls"
 /begin REF_MEASUREMENT mcb_pmsm_foc_hall_f28379d_B.DataStoreRead1_kl mcb_pmsm_foc_hall_f28379d_B.DataTypeConversion1_n mcb_pmsm_foc_hall_f28379d_B.DataTypeConversion2_g mcb_pmsm_foc_hall_f28379d_B.Merge1_a mcb_pmsm_foc_hall_f28379d_B.Merge3_o mcb_pmsm_foc_hall_f28379d_B.Merge_j /end REF_MEASUREMENT
/end GROUP
/begin GROUP mcb_pmsm_foc_hall_f28379d_Hall_Sensor_B_eCAP "mcb_pmsm_foc_hall_f28379d/Hall Sensor B/eCAP"
 /begin SUB_GROUP mcb_pmsm_foc_hall_f28379d_Hall_Sensor_B_eCAP_Code_generation /end SUB_GROUP
/end GROUP
/begin GROUP mcb_pmsm_foc_hall_f28379d_Hall_Sensor_B_eCAP_Code_generation "mcb_pmsm_foc_hall_f28379d/Hall Sensor B/eCAP/Code generation" /begin REF_MEASUREMENT mcb_pmsm_foc_hall_f28379d_B.eCAP_c /end REF_MEASUREMENT /end GROUP
/begin GROUP mcb_pmsm_foc_hall_f28379d_Hall_Sensor_C "mcb_pmsm_foc_hall_f28379d/Hall Sensor C"
 /begin SUB_GROUP mcb_pmsm_foc_hall_f28379d_Hall_Sensor_C_Capture_Event_Selection mcb_pmsm_foc_hall_f28379d_Hall_Sensor_C_HallValidity mcb_pmsm_foc_hall_f28379d_Hall_Sensor_C_Hall_Validity mcb_pmsm_foc_hall_f28379d_Hall_Sensor_C_eCAP /end SUB_GROUP
 /begin REF_MEASUREMENT mcb_pmsm_foc_hall_f28379d_B.BitwiseOperator2 mcb_pmsm_foc_hall_f28379d_B.DataStoreRead mcb_pmsm_foc_hall_f28379d_B.DataStoreRead1_k mcb_pmsm_foc_hall_f28379d_B.DataTypeConversion_n mcb_pmsm_foc_hall_f28379d_B.Merge1_k mcb_pmsm_foc_hall_f28379d_B.Merge_pt mcb_pmsm_foc_hall_f28379d_B.Switch mcb_pmsm_foc_hall_f28379d_B.eCAP mcb_pmsm_foc_hall_f28379d_DWork.GlobalDirection mcb_pmsm_foc_hall_f28379d_DWork.GlobalHallState mcb_pmsm_foc_hall_f28379d_DWork.GlobalSpeedCount mcb_pmsm_foc_hall_f28379d_DWork.GlobalSpeedValidity mcb_pmsm_foc_hall_f28379d_DWork.HallStateChangeFlag /end REF_MEASUREMENT
/end GROUP
/begin GROUP mcb_pmsm_foc_hall_f28379d_Hall_Sensor_C_Capture_Event_Selection "mcb_pmsm_foc_hall_f28379d/Hall Sensor C/Capture Event Selection"
 /begin REF_MEASUREMENT mcb_pmsm_foc_hall_f28379d_B.BitwiseOperator2 mcb_pmsm_foc_hall_f28379d_B.Merge_pt /end REF_MEASUREMENT
/end GROUP
/begin GROUP mcb_pmsm_foc_hall_f28379d_Hall_Sensor_C_HallValidity "mcb_pmsm_foc_hall_f28379d/Hall Sensor C/HallValidity"
 /begin SUB_GROUP mcb_pmsm_foc_hall_f28379d_Hall_Sensor_C_HallValidity_CodeGen /end SUB_GROUP
/end GROUP
/begin GROUP mcb_pmsm_foc_hall_f28379d_Hall_Sensor_C_HallValidity_CodeGen "mcb_pmsm_foc_hall_f28379d/Hall Sensor C/HallValidity/CodeGen"
 /begin SUB_GROUP mcb_pmsm_foc_hall_f28379d_Hall_Sensor_C_HallValidity_CodeGen_Read_Halls /end SUB_GROUP
/end GROUP
/begin GROUP mcb_pmsm_foc_hall_f28379d_Hall_Sensor_C_HallValidity_CodeGen_Read_Halls "mcb_pmsm_foc_hall_f28379d/Hall Sensor C/HallValidity/CodeGen/Read Halls"
 /begin REF_MEASUREMENT mcb_pmsm_foc_hall_f28379d_B.BitwiseOperator2 mcb_pmsm_foc_hall_f28379d_B.Hall_A mcb_pmsm_foc_hall_f28379d_B.Hall_B mcb_pmsm_foc_hall_f28379d_B.Hall_C mcb_pmsm_foc_hall_f28379d_B.ReadGPIODATregister mcb_pmsm_foc_hall_f28379d_B.ShiftArithmetic mcb_pmsm_foc_hall_f28379d_B.ShiftArithmetic1 mcb_pmsm_foc_hall_f28379d_B.ShiftArithmetic2 /end REF_MEASUREMENT
/end GROUP
/begin GROUP mcb_pmsm_foc_hall_f28379d_Hall_Sensor_C_Hall_Validity "mcb_pmsm_foc_hall_f28379d/Hall Sensor C/Hall Validity"
 /begin SUB_GROUP mcb_pmsm_foc_hall_f28379d_Hall_Sensor_C_Hall_Validity_Subsystem /end SUB_GROUP
 /begin REF_MEASUREMENT mcb_pmsm_foc_hall_f28379d_B.BitwiseOperator2 mcb_pmsm_foc_hall_f28379d_B.DataStoreRead mcb_pmsm_foc_hall_f28379d_B.DataTypeConversion1_o mcb_pmsm_foc_hall_f28379d_B.DataTypeConversion2_p /end REF_MEASUREMENT
/end GROUP
/begin GROUP mcb_pmsm_foc_hall_f28379d_Hall_Sensor_C_Hall_Validity_Subsystem "mcb_pmsm_foc_hall_f28379d/Hall Sensor C/Hall Validity/Subsystem"
 /begin SUB_GROUP mcb_pmsm_foc_hall_f28379d_Hall_Sensor_C_Hall_Validity_Subsystem_Bad_hall__glitch_or_wrong_connection_ mcb_pmsm_foc_hall_f28379d_Hall_Sensor_C_Hall_Validity_Subsystem_Valid_Halls /end SUB_GROUP
 /begin REF_MEASUREMENT mcb_pmsm_foc_hall_f28379d_B.DataTypeConversion_n mcb_pmsm_foc_hall_f28379d_B.Merge1_k mcb_pmsm_foc_hall_f28379d_B.Merge3 mcb_pmsm_foc_hall_f28379d_B.Merge_pc /end REF_MEASUREMENT
/end GROUP
/begin GROUP mcb_pmsm_foc_hall_f28379d_Hall_Sensor_C_Hall_Validity_Subsystem_Bad_hall__glitch_or_wrong_connection_ "mcb_pmsm_foc_hall_f28379d/Hall Sensor C/Hall Validity/Subsystem/Bad hall\r\n(glitch or wrong connection)"
 /begin REF_MEASUREMENT mcb_pmsm_foc_hall_f28379d_B.DataStoreRead1_k mcb_pmsm_foc_hall_f28379d_B.Merge1_k /end REF_MEASUREMENT
/end GROUP
/begin GROUP mcb_pmsm_foc_hall_f28379d_Hall_Sensor_C_Hall_Validity_Subsystem_Valid_Halls "mcb_pmsm_foc_hall_f28379d/Hall Sensor C/Hall Validity/Subsystem/Valid Halls"
 /begin REF_MEASUREMENT mcb_pmsm_foc_hall_f28379d_B.DataStoreRead1_k mcb_pmsm_foc_hall_f28379d_B.DataTypeConversion1_o mcb_pmsm_foc_hall_f28379d_B.DataTypeConversion2_p mcb_pmsm_foc_hall_f28379d_B.Merge1_k mcb_pmsm_foc_hall_f28379d_B.Merge3 mcb_pmsm_foc_hall_f28379d_B.Merge_pc /end REF_MEASUREMENT
/end GROUP
/begin GROUP mcb_pmsm_foc_hall_f28379d_Hall_Sensor_C_eCAP "mcb_pmsm_foc_hall_f28379d/Hall Sensor C/eCAP"
 /begin SUB_GROUP mcb_pmsm_foc_hall_f28379d_Hall_Sensor_C_eCAP_Code_generation /end SUB_GROUP
/end GROUP
/begin GROUP mcb_pmsm_foc_hall_f28379d_Hall_Sensor_C_eCAP_Code_generation "mcb_pmsm_foc_hall_f28379d/Hall Sensor C/eCAP/Code generation" /begin REF_MEASUREMENT mcb_pmsm_foc_hall_f28379d_B.eCAP /end REF_MEASUREMENT /end GROUP
/begin GROUP mcb_pmsm_foc_hall_f28379d_Hardware_Init "mcb_pmsm_foc_hall_f28379d/Hardware Init" /begin SUB_GROUP mcb_pmsm_foc_hall_f28379d_Hardware_Init_Variant_Subsystem /end SUB_GROUP /end GROUP
/begin GROUP mcb_pmsm_foc_hall_f28379d_Hardware_Init_Variant_Subsystem "mcb_pmsm_foc_hall_f28379d/Hardware Init/Variant Subsystem"
 /begin SUB_GROUP mcb_pmsm_foc_hall_f28379d_Hardware_Init_Variant_Subsystem_Code_Generation /end SUB_GROUP
/end GROUP
/begin GROUP mcb_pmsm_foc_hall_f28379d_Hardware_Init_Variant_Subsystem_Code_Generation "mcb_pmsm_foc_hall_f28379d/Hardware Init/Variant Subsystem/Code Generation"
 /begin SUB_GROUP mcb_pmsm_foc_hall_f28379d_Hardware_Init_Variant_Subsystem_Code_Generation_Calculate_ADC_Offset_ mcb_pmsm_foc_hall_f28379d_Hardware_Init_Variant_Subsystem_Code_Generation_DRV_Enable mcb_pmsm_foc_hall_f28379d_Hardware_Init_Variant_Subsystem_Code_Generation_Default_ADC_Offset /end SUB_GROUP
 /begin REF_MEASUREMENT mcb_pmsm_foc_hall_f28379d_B.NOT /end REF_MEASUREMENT
/end GROUP
/begin GROUP mcb_pmsm_foc_hall_f28379d_Hardware_Init_Variant_Subsystem_Code_Generation_Calculate_ADC_Offset_ "mcb_pmsm_foc_hall_f28379d/Hardware Init/Variant Subsystem/Code Generation/Calculate ADC Offset\r\n"
 /begin SUB_GROUP mcb_pmsm_foc_hall_f28379d_Hardware_Init_Variant_Subsystem_Code_Generation_Calculate_ADC_Offset__For_Iterator_Subsystem mcb_pmsm_foc_hall_f28379d_Hardware_Init_Variant_Subsystem_Code_Generation_Calculate_ADC_Offset__If_Action_Subsystem mcb_pmsm_foc_hall_f28379d_Hardware_Init_Variant_Subsystem_Code_Generation_Calculate_ADC_Offset__If_Action_Subsystem1 mcb_pmsm_foc_hall_f28379d_Hardware_Init_Variant_Subsystem_Code_Generation_Calculate_ADC_Offset__If_Action_Subsystem2 mcb_pmsm_foc_hall_f28379d_Hardware_Init_Variant_Subsystem_Code_Generation_Calculate_ADC_Offset__If_Action_Subsystem3 /end SUB_GROUP
 /begin REF_MEASUREMENT mcb_pmsm_foc_hall_f28379d_B.Divide1_e mcb_pmsm_foc_hall_f28379d_B.Divide_ir mcb_pmsm_foc_hall_f28379d_B.Sum1_j mcb_pmsm_foc_hall_f28379d_B.Sum_i /end REF_MEASUREMENT
/end GROUP
/begin GROUP mcb_pmsm_foc_hall_f28379d_Hardware_Init_Variant_Subsystem_Code_Generation_Calculate_ADC_Offset__For_Iterator_Subsystem "mcb_pmsm_foc_hall_f28379d/Hardware Init/Variant Subsystem/Code Generation/Calculate ADC Offset\r\n/For Iterator\r\nSubsystem"
 /begin SUB_GROUP mcb_pmsm_foc_hall_f28379d_Hardware_Init_Variant_Subsystem_Code_Generation_Calculate_ADC_Offset__For_Iterator_Subsystem_If_Action_Subsystem /end SUB_GROUP
 /begin REF_MEASUREMENT mcb_pmsm_foc_hall_f28379d_B.ADC_A_IN0 mcb_pmsm_foc_hall_f28379d_B.ADC_B_IN0 mcb_pmsm_foc_hall_f28379d_B.ForIterator /end REF_MEASUREMENT
/end GROUP
/begin GROUP mcb_pmsm_foc_hall_f28379d_Hardware_Init_Variant_Subsystem_Code_Generation_Calculate_ADC_Offset__For_Iterator_Subsystem_If_Action_Subsystem "mcb_pmsm_foc_hall_f28379d/Hardware Init/Variant Subsystem/Code Generation/Calculate ADC Offset\r\n/For Iterator\r\nSubsystem/If Action\r\nSubsystem"
 /begin REF_MEASUREMENT mcb_pmsm_foc_hall_f28379d_B.ADC_A_IN0 mcb_pmsm_foc_hall_f28379d_B.ADC_B_IN0 mcb_pmsm_foc_hall_f28379d_B.Memory mcb_pmsm_foc_hall_f28379d_B.Memory1 mcb_pmsm_foc_hall_f28379d_B.Sum1_j mcb_pmsm_foc_hall_f28379d_B.Sum_i mcb_pmsm_foc_hall_f28379d_DWork.Memory1_PreviousInput mcb_pmsm_foc_hall_f28379d_DWork.Memory_PreviousInput /end REF_MEASUREMENT
/end GROUP
/begin GROUP mcb_pmsm_foc_hall_f28379d_Hardware_Init_Variant_Subsystem_Code_Generation_Calculate_ADC_Offset__If_Action_Subsystem "mcb_pmsm_foc_hall_f28379d/Hardware Init/Variant Subsystem/Code Generation/Calculate ADC Offset\r\n/If Action\r\nSubsystem"
 /begin REF_MEASUREMENT mcb_pmsm_foc_hall_f28379d_B.Divide_ir mcb_pmsm_foc_hall_f28379d_DWork.IaOffset /end REF_MEASUREMENT
/end GROUP
/begin GROUP mcb_pmsm_foc_hall_f28379d_Hardware_Init_Variant_Subsystem_Code_Generation_Calculate_ADC_Offset__If_Action_Subsystem1 "mcb_pmsm_foc_hall_f28379d/Hardware Init/Variant Subsystem/Code Generation/Calculate ADC Offset\r\n/If Action\r\nSubsystem1" /begin REF_MEASUREMENT mcb_pmsm_foc_hall_f28379d_DWork.IaOffset /end REF_MEASUREMENT /end GROUP
/begin GROUP mcb_pmsm_foc_hall_f28379d_Hardware_Init_Variant_Subsystem_Code_Generation_Calculate_ADC_Offset__If_Action_Subsystem2 "mcb_pmsm_foc_hall_f28379d/Hardware Init/Variant Subsystem/Code Generation/Calculate ADC Offset\r\n/If Action\r\nSubsystem2"
 /begin REF_MEASUREMENT mcb_pmsm_foc_hall_f28379d_B.Divide1_e mcb_pmsm_foc_hall_f28379d_DWork.IbOffset /end REF_MEASUREMENT
/end GROUP
/begin GROUP mcb_pmsm_foc_hall_f28379d_Hardware_Init_Variant_Subsystem_Code_Generation_Calculate_ADC_Offset__If_Action_Subsystem3 "mcb_pmsm_foc_hall_f28379d/Hardware Init/Variant Subsystem/Code Generation/Calculate ADC Offset\r\n/If Action\r\nSubsystem3" /begin REF_MEASUREMENT mcb_pmsm_foc_hall_f28379d_DWork.IbOffset /end REF_MEASUREMENT /end GROUP
/begin GROUP mcb_pmsm_foc_hall_f28379d_Hardware_Init_Variant_Subsystem_Code_Generation_DRV_Enable "mcb_pmsm_foc_hall_f28379d/Hardware Init/Variant Subsystem/Code Generation/DRV Enable"
 /begin REF_MEASUREMENT mcb_pmsm_foc_hall_f28379d_B.Switch_bt mcb_pmsm_foc_hall_f28379d_DWork.DRV830xEnable_FRAC_LEN /end REF_MEASUREMENT
/end GROUP
/begin GROUP mcb_pmsm_foc_hall_f28379d_Hardware_Init_Variant_Subsystem_Code_Generation_Default_ADC_Offset "mcb_pmsm_foc_hall_f28379d/Hardware Init/Variant Subsystem/Code Generation/Default ADC Offset"
 /begin REF_MEASUREMENT mcb_pmsm_foc_hall_f28379d_DWork.IaOffset mcb_pmsm_foc_hall_f28379d_DWork.IbOffset /end REF_MEASUREMENT
/end GROUP
/begin GROUP mcb_pmsm_foc_hall_f28379d_Heartbeat_LED "mcb_pmsm_foc_hall_f28379d/Heartbeat LED" /begin SUB_GROUP mcb_pmsm_foc_hall_f28379d_Heartbeat_LED_Heartbeat_LED /end SUB_GROUP /end GROUP
/begin GROUP mcb_pmsm_foc_hall_f28379d_Heartbeat_LED_Heartbeat_LED "mcb_pmsm_foc_hall_f28379d/Heartbeat LED/Heartbeat LED"
 /begin SUB_GROUP mcb_pmsm_foc_hall_f28379d_Heartbeat_LED_Heartbeat_LED_Code_generation /end SUB_GROUP
/end GROUP
/begin GROUP mcb_pmsm_foc_hall_f28379d_Heartbeat_LED_Heartbeat_LED_Code_generation "mcb_pmsm_foc_hall_f28379d/Heartbeat LED/Heartbeat LED/Code generation" /begin REF_MEASUREMENT mcb_pmsm_foc_hall_f28379d_DWork.DigitalOutput2_FRAC_LEN /end REF_MEASUREMENT /end GROUP
/begin GROUP mcb_pmsm_foc_hall_f28379d_Serial_Receive "mcb_pmsm_foc_hall_f28379d/Serial Receive"
 /begin SUB_GROUP mcb_pmsm_foc_hall_f28379d_Serial_Receive_Data_Conditioning_Rx mcb_pmsm_foc_hall_f28379d_Serial_Receive_SCI_Rx mcb_pmsm_foc_hall_f28379d_Serial_Receive_unParse /end SUB_GROUP
 /begin REF_MEASUREMENT mcb_pmsm_foc_hall_f28379d_B.DataTypeConversion3 mcb_pmsm_foc_hall_f28379d_B.SCIReceive mcb_pmsm_foc_hall_f28379d_B.ShiftArithmetic1_d mcb_pmsm_foc_hall_f28379d_DWork.Debug_signals mcb_pmsm_foc_hall_f28379d_DWork.Enable mcb_pmsm_foc_hall_f28379d_DWork.Speed_ref /end REF_MEASUREMENT
/end GROUP
/begin GROUP mcb_pmsm_foc_hall_f28379d_Serial_Receive_Data_Conditioning_Rx "mcb_pmsm_foc_hall_f28379d/Serial Receive/Data_Conditioning_Rx"
 /begin SUB_GROUP mcb_pmsm_foc_hall_f28379d_Serial_Receive_Data_Conditioning_Rx_Data_Type_Float /end SUB_GROUP
/end GROUP
/begin GROUP mcb_pmsm_foc_hall_f28379d_Serial_Receive_Data_Conditioning_Rx_Data_Type_Float "mcb_pmsm_foc_hall_f28379d/Serial Receive/Data_Conditioning_Rx/Data_Type_Float"
 /begin REF_MEASUREMENT mcb_pmsm_foc_hall_f28379d_B.DataTypeConversion2 mcb_pmsm_foc_hall_f28379d_B.SCIReceive /end REF_MEASUREMENT
/end GROUP
/begin GROUP mcb_pmsm_foc_hall_f28379d_Serial_Receive_SCI_Rx "mcb_pmsm_foc_hall_f28379d/Serial Receive/SCI_Rx"
 /begin SUB_GROUP mcb_pmsm_foc_hall_f28379d_Serial_Receive_SCI_Rx_Code_Generation /end SUB_GROUP
/end GROUP
/begin GROUP mcb_pmsm_foc_hall_f28379d_Serial_Receive_SCI_Rx_Code_Generation "mcb_pmsm_foc_hall_f28379d/Serial Receive/SCI_Rx/Code Generation"
 /begin SUB_GROUP mcb_pmsm_foc_hall_f28379d_Serial_Receive_SCI_Rx_Code_Generation_Data_Type_Float /end SUB_GROUP
/end GROUP
/begin GROUP mcb_pmsm_foc_hall_f28379d_Serial_Receive_SCI_Rx_Code_Generation_Data_Type_Float "mcb_pmsm_foc_hall_f28379d/Serial Receive/SCI_Rx/Code Generation/Data_Type_Float" /begin REF_MEASUREMENT mcb_pmsm_foc_hall_f28379d_B.SCIReceive /end REF_MEASUREMENT /end GROUP
/begin GROUP mcb_pmsm_foc_hall_f28379d_Serial_Receive_unParse "mcb_pmsm_foc_hall_f28379d/Serial Receive/unParse"
 /begin REF_MEASUREMENT mcb_pmsm_foc_hall_f28379d_B.BitwiseOperator mcb_pmsm_foc_hall_f28379d_B.BitwiseOperator1 mcb_pmsm_foc_hall_f28379d_B.DataTypeConversion2 mcb_pmsm_foc_hall_f28379d_B.DataTypeConversion3 mcb_pmsm_foc_hall_f28379d_B.ShiftArithmetic1_d /end REF_MEASUREMENT
/end GROUP
/begin GROUP mcb_pmsm_foc_hall_f28379d_Speed_Control "mcb_pmsm_foc_hall_f28379d/Speed Control"
 /begin SUB_GROUP mcb_pmsm_foc_hall_f28379d_Speed_Control_PI_Controller_Speed mcb_pmsm_foc_hall_f28379d_Speed_Control_Speed_Ref_Selector /end SUB_GROUP
/end GROUP
/begin GROUP mcb_pmsm_foc_hall_f28379d_Speed_Control_PI_Controller_Speed "mcb_pmsm_foc_hall_f28379d/Speed Control/PI_Controller_Speed"
 /begin REF_MEASUREMENT mcb_pmsm_foc_hall_f28379d_B.RT7 mcb_pmsm_foc_hall_f28379d_DWork.Enable /end REF_MEASUREMENT
/end GROUP
/begin GROUP mcb_pmsm_foc_hall_f28379d_Speed_Control_Speed_Ref_Selector "mcb_pmsm_foc_hall_f28379d/Speed Control/Speed_Ref_Selector"
 /begin REF_MEASUREMENT mcb_pmsm_foc_hall_f28379d_B.RT6 mcb_pmsm_foc_hall_f28379d_B.RT7 mcb_pmsm_foc_hall_f28379d_DWork.Enable /end REF_MEASUREMENT
/end GROUP
/end MODULE
/end PROJECT
/* (add any file trailer comments here) */
/* EOF mcb_pmsm_foc_hall_f28379d.a2l*/
