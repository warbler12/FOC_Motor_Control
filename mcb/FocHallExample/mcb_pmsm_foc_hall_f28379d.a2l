/******************************************************************************
* ASAP2 file: mcb_pmsm_foc_hall_f28379d.a2l
* Academic License - for use in teaching, academic research, and meeting
* course requirements at degree granting institutions only. Not for
* government, commercial, or other organizational use.
* Code generation for model "mcb_pmsm_foc_hall_f28379d".
* Model version : 29
* Simulink Coder version : 23.2 (R2023b) 01-Aug-2023
* C source code generated on : Thu Nov 20 16:20:40 2025
* Target selection: ert.tlc
* Embedded hardware selection: Texas Instruments->C2000
* Code generation objectives: Unspecified
* Validation result: Not run
* (add additional file header information here)
******************************************************************************/ ASAP2_VERSION 1 31
/* Version 1.31 */
/begin PROJECT ProjectName "Project Comment Goes Here"
/begin HEADER "Header Comments go here" /end HEADER
/begin MODULE ModuleName "Module Comment Goes Here"
/begin MOD_PAR "MOD PAR Comment Goes Here" /end MOD_PAR
/begin MOD_COMMON "Mod Common Comment Here" BYTE_ORDER MSB_LAST ALIGNMENT_BYTE 1 ALIGNMENT_WORD 2 ALIGNMENT_LONG 4 ALIGNMENT_FLOAT32_IEEE 4 ALIGNMENT_FLOAT64_IEEE 4 /end MOD_COMMON
/begin MEASUREMENT mcb_pmsm_foc_hall_f28379d_B.ADC_A_IN0 "" UWORD mcb_pmsm_foc_hall_f28379d_CM_uint16 0 0 0 65535 ECU_ADDRESS 0x0000E2CE /end MEASUREMENT
/begin MEASUREMENT mcb_pmsm_foc_hall_f28379d_B.ADC_B_IN0 "" UWORD mcb_pmsm_foc_hall_f28379d_CM_uint16 0 0 0 65535 ECU_ADDRESS 0x0000E2CF /end MEASUREMENT
/begin MEASUREMENT mcb_pmsm_foc_hall_f28379d_B.ADC_B_IN2 "" UWORD mcb_pmsm_foc_hall_f28379d_CM_uint16 0 0 0 65535 ECU_ADDRESS 0x0000E2EC /end MEASUREMENT
/begin MEASUREMENT mcb_pmsm_foc_hall_f28379d_B.ADC_C_IN2 "" UWORD mcb_pmsm_foc_hall_f28379d_CM_uint16 0 0 0 65535 ECU_ADDRESS 0x0000E2EB /end MEASUREMENT
/begin MEASUREMENT mcb_pmsm_foc_hall_f28379d_B.AND3 "" UBYTE mcb_pmsm_foc_hall_f28379d_CM_logical 0 0 0 1 ECU_ADDRESS 0x0000E322 /end MEASUREMENT
/begin MEASUREMENT mcb_pmsm_foc_hall_f28379d_B.AND3_f "" UBYTE mcb_pmsm_foc_hall_f28379d_CM_logical 0 0 0 1 ECU_ADDRESS 0x0000E327 /end MEASUREMENT
/begin MEASUREMENT mcb_pmsm_foc_hall_f28379d_B.Add "" FLOAT32_IEEE mcb_pmsm_foc_hall_f28379d_CM_single 0 0 -3.4E+38 3.4E+38 ECU_ADDRESS 0x0000E19C /end MEASUREMENT
/begin MEASUREMENT mcb_pmsm_foc_hall_f28379d_B.Add1 "" FLOAT32_IEEE mcb_pmsm_foc_hall_f28379d_CM_single 0 0 -3.4E+38 3.4E+38 ECU_ADDRESS 0x0000E232 /end MEASUREMENT
/begin MEASUREMENT mcb_pmsm_foc_hall_f28379d_B.Add2 "" FLOAT32_IEEE mcb_pmsm_foc_hall_f28379d_CM_single 0 0 -3.4E+38 3.4E+38 ECU_ADDRESS 0x0000E230 /end MEASUREMENT
/begin MEASUREMENT mcb_pmsm_foc_hall_f28379d_B.Add3 "" FLOAT32_IEEE mcb_pmsm_foc_hall_f28379d_CM_single 0 0 -3.4E+38 3.4E+38 ECU_ADDRESS 0x0000E22E /end MEASUREMENT
/begin MEASUREMENT mcb_pmsm_foc_hall_f28379d_B.Add_f "" SLONG mcb_pmsm_foc_hall_f28379d_CM_int32 0 0 -2147483648 2147483647 ARRAY_SIZE 2 ECU_ADDRESS 0x0000E2C4 /end MEASUREMENT
/begin MEASUREMENT mcb_pmsm_foc_hall_f28379d_B.Add_i "" FLOAT32_IEEE mcb_pmsm_foc_hall_f28379d_CM_single 0 0 -3.4E+38 3.4E+38 ECU_ADDRESS 0x0000E22A /end MEASUREMENT
/begin MEASUREMENT mcb_pmsm_foc_hall_f28379d_B.Bias "" FLOAT32_IEEE mcb_pmsm_foc_hall_f28379d_CM_single 0 0 -3.4E+38 3.4E+38 ECU_ADDRESS 0x0000E17A
 /begin IF_DATA XCP
  /begin DAQ_EVENT VARIABLE /begin DEFAULT_EVENT_LIST EVENT 0x0001 /end DEFAULT_EVENT_LIST /end DAQ_EVENT
 /end IF_DATA
/end MEASUREMENT
/begin MEASUREMENT mcb_pmsm_foc_hall_f28379d_B.Bias1 "" FLOAT32_IEEE mcb_pmsm_foc_hall_f28379d_CM_single 0 0 -3.4E+38 3.4E+38 ECU_ADDRESS 0x0000E18C
 /begin IF_DATA XCP
  /begin DAQ_EVENT VARIABLE /begin DEFAULT_EVENT_LIST EVENT 0x0001 /end DEFAULT_EVENT_LIST /end DAQ_EVENT
 /end IF_DATA
/end MEASUREMENT
/begin MEASUREMENT mcb_pmsm_foc_hall_f28379d_B.BitwiseOperator "" UWORD mcb_pmsm_foc_hall_f28379d_CM_uint16 0 0 0 65535 ECU_ADDRESS 0x0000E2D5 /end MEASUREMENT
/begin MEASUREMENT mcb_pmsm_foc_hall_f28379d_B.BitwiseOperator1 "" UWORD mcb_pmsm_foc_hall_f28379d_CM_uint16 0 0 0 65535 ECU_ADDRESS 0x0000E2D6 /end MEASUREMENT
/begin MEASUREMENT mcb_pmsm_foc_hall_f28379d_B.BitwiseOperator2 "" ULONG mcb_pmsm_foc_hall_f28379d_CM_uint32 0 0 0 4294967295 ECU_ADDRESS 0x0000E0E4 /end MEASUREMENT
/begin MEASUREMENT mcb_pmsm_foc_hall_f28379d_B.BitwiseOperator2_g "" ULONG mcb_pmsm_foc_hall_f28379d_CM_uint32 0 0 0 4294967295 ECU_ADDRESS 0x0000E146 /end MEASUREMENT
/begin MEASUREMENT mcb_pmsm_foc_hall_f28379d_B.BitwiseOperator2_m "" ULONG mcb_pmsm_foc_hall_f28379d_CM_uint32 0 0 0 4294967295 ECU_ADDRESS 0x0000E0FC /end MEASUREMENT
/begin MEASUREMENT mcb_pmsm_foc_hall_f28379d_B.BitwiseOperator2_n "" ULONG mcb_pmsm_foc_hall_f28379d_CM_uint32 0 0 0 4294967295 ECU_ADDRESS 0x0000E114 /end MEASUREMENT
/begin MEASUREMENT mcb_pmsm_foc_hall_f28379d_B.BitwiseOperator2_p "" ULONG mcb_pmsm_foc_hall_f28379d_CM_uint32 0 0 0 4294967295 ECU_ADDRESS 0x0000E15E /end MEASUREMENT
/begin MEASUREMENT mcb_pmsm_foc_hall_f28379d_B.Compare "" UBYTE mcb_pmsm_foc_hall_f28379d_CM_uint8 0 0 0 255 ECU_ADDRESS 0x0000E304 /end MEASUREMENT
/begin MEASUREMENT mcb_pmsm_foc_hall_f28379d_B.Compare_d "" UBYTE mcb_pmsm_foc_hall_f28379d_CM_logical 0 0 0 1 ECU_ADDRESS 0x0000E319 /end MEASUREMENT
/begin MEASUREMENT mcb_pmsm_foc_hall_f28379d_B.Compare_e "" UBYTE mcb_pmsm_foc_hall_f28379d_CM_logical 0 0 0 1 ECU_ADDRESS 0x0000E312 /end MEASUREMENT
/begin MEASUREMENT mcb_pmsm_foc_hall_f28379d_B.Compare_h "" UBYTE mcb_pmsm_foc_hall_f28379d_CM_logical 0 0 0 1 ECU_ADDRESS 0x0000E32E /end MEASUREMENT
/begin MEASUREMENT mcb_pmsm_foc_hall_f28379d_B.Compare_n "" UBYTE mcb_pmsm_foc_hall_f28379d_CM_logical 0 0 0 1 ECU_ADDRESS 0x0000E318 /end MEASUREMENT
/begin MEASUREMENT mcb_pmsm_foc_hall_f28379d_B.Compare_nf "" UBYTE mcb_pmsm_foc_hall_f28379d_CM_logical 0 0 0 1 ECU_ADDRESS 0x0000E328 /end MEASUREMENT
/begin MEASUREMENT mcb_pmsm_foc_hall_f28379d_B.Compare_nfz "" UBYTE mcb_pmsm_foc_hall_f28379d_CM_logical 0 0 0 1 ECU_ADDRESS 0x0000E32F /end MEASUREMENT
/begin MEASUREMENT mcb_pmsm_foc_hall_f28379d_B.Constant "" FLOAT64_IEEE mcb_pmsm_foc_hall_f28379d_CM_double 0 0 -1.7E+308 1.7E+308 ECU_ADDRESS 0x0000E0D2
 /begin IF_DATA XCP
  /begin DAQ_EVENT VARIABLE /begin DEFAULT_EVENT_LIST EVENT 0x0002 /end DEFAULT_EVENT_LIST /end DAQ_EVENT
 /end IF_DATA
/end MEASUREMENT
/begin MEASUREMENT mcb_pmsm_foc_hall_f28379d_B.DataStoreRead "" ULONG mcb_pmsm_foc_hall_f28379d_CM_uint32 0 0 0 4294967295 ECU_ADDRESS 0x0000E0D4 /end MEASUREMENT
/begin MEASUREMENT mcb_pmsm_foc_hall_f28379d_B.DataStoreRead1 "" UWORD mcb_pmsm_foc_hall_f28379d_CM_uint16 0 0 0 65535 ECU_ADDRESS 0x0000E2EA /end MEASUREMENT
/begin MEASUREMENT mcb_pmsm_foc_hall_f28379d_B.DataStoreRead1_b "" UBYTE mcb_pmsm_foc_hall_f28379d_CM_logical 0 0 0 1 ECU_ADDRESS 0x0000E31A /end MEASUREMENT
/begin MEASUREMENT mcb_pmsm_foc_hall_f28379d_B.DataStoreRead1_g "" UBYTE mcb_pmsm_foc_hall_f28379d_CM_logical 0 0 0 1 ECU_ADDRESS 0x0000E31C /end MEASUREMENT
/begin MEASUREMENT mcb_pmsm_foc_hall_f28379d_B.DataStoreRead1_k "" SWORD mcb_pmsm_foc_hall_f28379d_CM_int16 0 0 -32768 32767 ECU_ADDRESS 0x0000E2FD /end MEASUREMENT
/begin MEASUREMENT mcb_pmsm_foc_hall_f28379d_B.DataStoreRead1_kl "" SWORD mcb_pmsm_foc_hall_f28379d_CM_int16 0 0 -32768 32767 ECU_ADDRESS 0x0000E2FF /end MEASUREMENT
/begin MEASUREMENT mcb_pmsm_foc_hall_f28379d_B.DataStoreRead1_o "" SWORD mcb_pmsm_foc_hall_f28379d_CM_int16 0 0 -32768 32767 ECU_ADDRESS 0x0000E301 /end MEASUREMENT
/begin MEASUREMENT mcb_pmsm_foc_hall_f28379d_B.DataStoreRead2 "" ULONG mcb_pmsm_foc_hall_f28379d_CM_uint32 0 0 0 4294967295 ECU_ADDRESS 0x0000E136 /end MEASUREMENT
/begin MEASUREMENT mcb_pmsm_foc_hall_f28379d_B.DataStoreRead3 "" SWORD mcb_pmsm_foc_hall_f28379d_CM_int16 0 0 -32768 32767 ECU_ADDRESS 0x0000E303 /end MEASUREMENT
/begin MEASUREMENT mcb_pmsm_foc_hall_f28379d_B.DataStoreRead4 "" UWORD mcb_pmsm_foc_hall_f28379d_CM_uint16 0 0 0 65535 ECU_ADDRESS 0x0000E2FA /end MEASUREMENT
/begin MEASUREMENT mcb_pmsm_foc_hall_f28379d_B.DataStoreRead5 "" UWORD mcb_pmsm_foc_hall_f28379d_CM_uint16 0 0 0 65535 ECU_ADDRESS 0x0000E2F9 /end MEASUREMENT
/begin MEASUREMENT mcb_pmsm_foc_hall_f28379d_B.DataStoreRead_k "" UWORD mcb_pmsm_foc_hall_f28379d_CM_uint16 0 0 0 65535 ECU_ADDRESS 0x0000E2E9 /end MEASUREMENT
/begin MEASUREMENT mcb_pmsm_foc_hall_f28379d_B.DataStoreRead_o "" ULONG mcb_pmsm_foc_hall_f28379d_CM_uint32 0 0 0 4294967295 ECU_ADDRESS 0x0000E0EC /end MEASUREMENT
/begin MEASUREMENT mcb_pmsm_foc_hall_f28379d_B.DataStoreRead_p "" ULONG mcb_pmsm_foc_hall_f28379d_CM_uint32 0 0 0 4294967295 ECU_ADDRESS 0x0000E104 /end MEASUREMENT
/begin MEASUREMENT mcb_pmsm_foc_hall_f28379d_B.DataTypeConversion "" FLOAT32_IEEE mcb_pmsm_foc_hall_f28379d_CM_single 0 0 -3.4E+38 3.4E+38 ECU_ADDRESS 0x0000E214 /end MEASUREMENT
/begin MEASUREMENT mcb_pmsm_foc_hall_f28379d_B.DataTypeConversion1 "" FLOAT32_IEEE mcb_pmsm_foc_hall_f28379d_CM_single 0 0 -3.4E+38 3.4E+38 ECU_ADDRESS 0x0000E1B8 /end MEASUREMENT
/begin MEASUREMENT mcb_pmsm_foc_hall_f28379d_B.DataTypeConversion1_d "" UWORD mcb_pmsm_foc_hall_f28379d_CM_uint16 0 0 0 65535 ECU_ADDRESS 0x0000E2E0 /end MEASUREMENT
/begin MEASUREMENT mcb_pmsm_foc_hall_f28379d_B.DataTypeConversion1_f "" FLOAT32_IEEE mcb_pmsm_foc_hall_f28379d_CM_single 0 0 -3.4E+38 3.4E+38 ECU_ADDRESS 0x0000E1FC /end MEASUREMENT
/begin MEASUREMENT mcb_pmsm_foc_hall_f28379d_B.DataTypeConversion1_n "" UWORD mcb_pmsm_foc_hall_f28379d_CM_uint16 0 0 0 65535 ECU_ADDRESS 0x0000E2DC /end MEASUREMENT
/begin MEASUREMENT mcb_pmsm_foc_hall_f28379d_B.DataTypeConversion1_o "" UWORD mcb_pmsm_foc_hall_f28379d_CM_uint16 0 0 0 65535 ECU_ADDRESS 0x0000E2D8 /end MEASUREMENT
/begin MEASUREMENT mcb_pmsm_foc_hall_f28379d_B.DataTypeConversion2 "" UWORD mcb_pmsm_foc_hall_f28379d_CM_uint16 0 0 0 65535 ECU_ADDRESS 0x0000E2C8
 /begin IF_DATA XCP
  /begin DAQ_EVENT VARIABLE /begin DEFAULT_EVENT_LIST EVENT 0x0001 /end DEFAULT_EVENT_LIST /end DAQ_EVENT
 /end IF_DATA
/end MEASUREMENT
/begin MEASUREMENT mcb_pmsm_foc_hall_f28379d_B.DataTypeConversion2_c "" UWORD mcb_pmsm_foc_hall_f28379d_CM_uint16 0 0 0 65535 ECU_ADDRESS 0x0000E2E1 /end MEASUREMENT
/begin MEASUREMENT mcb_pmsm_foc_hall_f28379d_B.DataTypeConversion2_f "" UWORD mcb_pmsm_foc_hall_f28379d_CM_uint16 0 0 0 65535 ECU_ADDRESS 0x0000E2D4 /end MEASUREMENT
/begin MEASUREMENT mcb_pmsm_foc_hall_f28379d_B.DataTypeConversion2_g "" UWORD mcb_pmsm_foc_hall_f28379d_CM_uint16 0 0 0 65535 ECU_ADDRESS 0x0000E2DD /end MEASUREMENT
/begin MEASUREMENT mcb_pmsm_foc_hall_f28379d_B.DataTypeConversion2_p "" UWORD mcb_pmsm_foc_hall_f28379d_CM_uint16 0 0 0 65535 ECU_ADDRESS 0x0000E2D9 /end MEASUREMENT
/begin MEASUREMENT mcb_pmsm_foc_hall_f28379d_B.DataTypeConversion3 "" UWORD mcb_pmsm_foc_hall_f28379d_CM_uint16 0 0 0 65535 ECU_ADDRESS 0x0000E2C9
 /begin IF_DATA XCP
  /begin DAQ_EVENT VARIABLE /begin DEFAULT_EVENT_LIST EVENT 0x0001 /end DEFAULT_EVENT_LIST /end DAQ_EVENT
 /end IF_DATA
/end MEASUREMENT
/begin MEASUREMENT mcb_pmsm_foc_hall_f28379d_B.DataTypeConversion3_h "" UBYTE mcb_pmsm_foc_hall_f28379d_CM_logical 0 0 0 1 ECU_ADDRESS 0x0000E30B /end MEASUREMENT
/begin MEASUREMENT mcb_pmsm_foc_hall_f28379d_B.DataTypeConversion4 "" UWORD mcb_pmsm_foc_hall_f28379d_CM_uint16 0 0 0 65535 ECU_ADDRESS 0x0000E2CA
 /begin IF_DATA XCP
  /begin DAQ_EVENT VARIABLE /begin DEFAULT_EVENT_LIST EVENT 0x0001 /end DEFAULT_EVENT_LIST /end DAQ_EVENT
 /end IF_DATA
/end MEASUREMENT
/begin MEASUREMENT mcb_pmsm_foc_hall_f28379d_B.DataTypeConversion4_k "" UBYTE mcb_pmsm_foc_hall_f28379d_CM_logical 0 0 0 1 ECU_ADDRESS 0x0000E313 /end MEASUREMENT
/begin MEASUREMENT mcb_pmsm_foc_hall_f28379d_B.DataTypeConversion_e "" UWORD mcb_pmsm_foc_hall_f28379d_CM_uint16 0 0 0 65535 ECU_ADDRESS 0x0000E2F0 /end MEASUREMENT
/begin MEASUREMENT mcb_pmsm_foc_hall_f28379d_B.DataTypeConversion_f "" SLONG mcb_pmsm_foc_hall_f28379d_CM_int32 0 0 -2147483648 2147483647 ARRAY_SIZE 2 ECU_ADDRESS 0x0000E2C0 /end MEASUREMENT
/begin MEASUREMENT mcb_pmsm_foc_hall_f28379d_B.DataTypeConversion_j "" UWORD mcb_pmsm_foc_hall_f28379d_CM_uint16 0 0 0 65535 ECU_ADDRESS 0x0000E2DE /end MEASUREMENT
/begin MEASUREMENT mcb_pmsm_foc_hall_f28379d_B.DataTypeConversion_jg "" UWORD mcb_pmsm_foc_hall_f28379d_CM_uint16 0 0 0 65535 ECU_ADDRESS 0x0000E2FB /end MEASUREMENT
/begin MEASUREMENT mcb_pmsm_foc_hall_f28379d_B.DataTypeConversion_m "" UWORD mcb_pmsm_foc_hall_f28379d_CM_uint16 0 0 0 65535 ECU_ADDRESS 0x0000E2EE /end MEASUREMENT
/begin MEASUREMENT mcb_pmsm_foc_hall_f28379d_B.DataTypeConversion_n "" UWORD mcb_pmsm_foc_hall_f28379d_CM_uint16 0 0 0 65535 ECU_ADDRESS 0x0000E2DA /end MEASUREMENT
/begin MEASUREMENT mcb_pmsm_foc_hall_f28379d_B.DataTypeConversion_nh "" UBYTE mcb_pmsm_foc_hall_f28379d_CM_logical 0 0 0 1 ECU_ADDRESS 0x0000E314 /end MEASUREMENT
/begin MEASUREMENT mcb_pmsm_foc_hall_f28379d_B.DataTypeConversion_nl "" UWORD mcb_pmsm_foc_hall_f28379d_CM_uint16 0 0 0 65535 ECU_ADDRESS 0x0000E2FC /end MEASUREMENT
/begin MEASUREMENT mcb_pmsm_foc_hall_f28379d_B.DataTypeConversion_p "" UWORD mcb_pmsm_foc_hall_f28379d_CM_uint16 0 0 0 65535 ECU_ADDRESS 0x0000E2E2 /end MEASUREMENT
/begin MEASUREMENT mcb_pmsm_foc_hall_f28379d_B.DeadZone "" FLOAT32_IEEE mcb_pmsm_foc_hall_f28379d_CM_single 0 0 -3.4E+38 3.4E+38 ECU_ADDRESS 0x0000E1EC /end MEASUREMENT
/begin MEASUREMENT mcb_pmsm_foc_hall_f28379d_B.DeadZone_g "" FLOAT32_IEEE mcb_pmsm_foc_hall_f28379d_CM_single 0 0 -3.4E+38 3.4E+38 ECU_ADDRESS 0x0000E1F2 /end MEASUREMENT
/begin MEASUREMENT mcb_pmsm_foc_hall_f28379d_B.DelayOneStep "" UWORD mcb_pmsm_foc_hall_f28379d_CM_uint16 0 0 0 65535 ECU_ADDRESS 0x0000E2E6 /end MEASUREMENT
/begin MEASUREMENT mcb_pmsm_foc_hall_f28379d_B.DelayOneStep1 "" UBYTE mcb_pmsm_foc_hall_f28379d_CM_logical 0 0 0 1 ECU_ADDRESS 0x0000E316 /end MEASUREMENT
/begin MEASUREMENT mcb_pmsm_foc_hall_f28379d_B.Divide "" FLOAT32_IEEE mcb_pmsm_foc_hall_f28379d_CM_single 0 0 -3.4E+38 3.4E+38 ECU_ADDRESS 0x0000E248 /end MEASUREMENT
/begin MEASUREMENT mcb_pmsm_foc_hall_f28379d_B.Divide1 "" FLOAT32_IEEE mcb_pmsm_foc_hall_f28379d_CM_single 0 0 -3.4E+38 3.4E+38 ECU_ADDRESS 0x0000E260 /end MEASUREMENT
/begin MEASUREMENT mcb_pmsm_foc_hall_f28379d_B.Divide1_e "" UWORD mcb_pmsm_foc_hall_f28379d_CM_uint16 0 0 0 65535 ECU_ADDRESS 0x0000E2CC /end MEASUREMENT
/begin MEASUREMENT mcb_pmsm_foc_hall_f28379d_B.Divide_f "" FLOAT32_IEEE mcb_pmsm_foc_hall_f28379d_CM_single 0 0 -3.4E+38 3.4E+38 ECU_ADDRESS 0x0000E256 /end MEASUREMENT
/begin MEASUREMENT mcb_pmsm_foc_hall_f28379d_B.Divide_i "" FLOAT32_IEEE mcb_pmsm_foc_hall_f28379d_CM_single 0 0 -3.4E+38 3.4E+38 ECU_ADDRESS 0x0000E25C /end MEASUREMENT
/begin MEASUREMENT mcb_pmsm_foc_hall_f28379d_B.Divide_ir "" UWORD mcb_pmsm_foc_hall_f28379d_CM_uint16 0 0 0 65535 ECU_ADDRESS 0x0000E2CB /end MEASUREMENT
/begin MEASUREMENT mcb_pmsm_foc_hall_f28379d_B.Enable "" UBYTE mcb_pmsm_foc_hall_f28379d_CM_logical 0 0 0 1 ECU_ADDRESS 0x0000E329 /end MEASUREMENT
/begin MEASUREMENT mcb_pmsm_foc_hall_f28379d_B.Equal1 "" UBYTE mcb_pmsm_foc_hall_f28379d_CM_logical 0 0 0 1 ECU_ADDRESS 0x0000E321 /end MEASUREMENT
/begin MEASUREMENT mcb_pmsm_foc_hall_f28379d_B.Equal1_d "" UBYTE mcb_pmsm_foc_hall_f28379d_CM_logical 0 0 0 1 ECU_ADDRESS 0x0000E326 /end MEASUREMENT
/begin MEASUREMENT mcb_pmsm_foc_hall_f28379d_B.Floor "" FLOAT32_IEEE mcb_pmsm_foc_hall_f28379d_CM_single 0 0 -3.4E+38 3.4E+38 ECU_ADDRESS 0x0000E19A /end MEASUREMENT
/begin MEASUREMENT mcb_pmsm_foc_hall_f28379d_B.ForIterator "" UWORD mcb_pmsm_foc_hall_f28379d_CM_uint16 0 0 0 65535 ECU_ADDRESS 0x0000E2CD /end MEASUREMENT
/begin MEASUREMENT mcb_pmsm_foc_hall_f28379d_B.Gain "" FLOAT32_IEEE mcb_pmsm_foc_hall_f28379d_CM_single 0 0 -3.4E+38 3.4E+38 ECU_ADDRESS 0x0000E176
 /begin IF_DATA XCP
  /begin DAQ_EVENT VARIABLE /begin DEFAULT_EVENT_LIST EVENT 0x0001 /end DEFAULT_EVENT_LIST /end DAQ_EVENT
 /end IF_DATA
/end MEASUREMENT
/begin MEASUREMENT mcb_pmsm_foc_hall_f28379d_B.Gain1 "" FLOAT32_IEEE mcb_pmsm_foc_hall_f28379d_CM_single 0 0 -3.4E+38 3.4E+38 ECU_ADDRESS 0x0000E178
 /begin IF_DATA XCP
  /begin DAQ_EVENT VARIABLE /begin DEFAULT_EVENT_LIST EVENT 0x0001 /end DEFAULT_EVENT_LIST /end DAQ_EVENT
 /end IF_DATA
/end MEASUREMENT
/begin MEASUREMENT mcb_pmsm_foc_hall_f28379d_B.Gain1_g "" FLOAT32_IEEE mcb_pmsm_foc_hall_f28379d_CM_single 0 0 -3.4E+38 3.4E+38 ECU_ADDRESS 0x0000E264 /end MEASUREMENT
/begin MEASUREMENT mcb_pmsm_foc_hall_f28379d_B.Gain1_n "" FLOAT32_IEEE mcb_pmsm_foc_hall_f28379d_CM_single 0 0 -3.4E+38 3.4E+38 ECU_ADDRESS 0x0000E17E
 /begin IF_DATA XCP
  /begin DAQ_EVENT VARIABLE /begin DEFAULT_EVENT_LIST EVENT 0x0001 /end DEFAULT_EVENT_LIST /end DAQ_EVENT
 /end IF_DATA
/end MEASUREMENT
/begin MEASUREMENT mcb_pmsm_foc_hall_f28379d_B.Gain2 "" FLOAT32_IEEE mcb_pmsm_foc_hall_f28379d_CM_single 0 0 -3.4E+38 3.4E+38 ECU_ADDRESS 0x0000E180
 /begin IF_DATA XCP
  /begin DAQ_EVENT VARIABLE /begin DEFAULT_EVENT_LIST EVENT 0x0001 /end DEFAULT_EVENT_LIST /end DAQ_EVENT
 /end IF_DATA
/end MEASUREMENT
/begin MEASUREMENT mcb_pmsm_foc_hall_f28379d_B.Gain2_f "" FLOAT32_IEEE mcb_pmsm_foc_hall_f28379d_CM_single 0 0 -3.4E+38 3.4E+38 ECU_ADDRESS 0x0000E184
 /begin IF_DATA XCP
  /begin DAQ_EVENT VARIABLE /begin DEFAULT_EVENT_LIST EVENT 0x0001 /end DEFAULT_EVENT_LIST /end DAQ_EVENT
 /end IF_DATA
/end MEASUREMENT
/begin MEASUREMENT mcb_pmsm_foc_hall_f28379d_B.Gain3 "" FLOAT32_IEEE mcb_pmsm_foc_hall_f28379d_CM_single 0 0 -3.4E+38 3.4E+38 ECU_ADDRESS 0x0000E182
 /begin IF_DATA XCP
  /begin DAQ_EVENT VARIABLE /begin DEFAULT_EVENT_LIST EVENT 0x0001 /end DEFAULT_EVENT_LIST /end DAQ_EVENT
 /end IF_DATA
/end MEASUREMENT
/begin MEASUREMENT mcb_pmsm_foc_hall_f28379d_B.Gain3_o "" FLOAT32_IEEE mcb_pmsm_foc_hall_f28379d_CM_single 0 0 -3.4E+38 3.4E+38 ECU_ADDRESS 0x0000E18A
 /begin IF_DATA XCP
  /begin DAQ_EVENT VARIABLE /begin DEFAULT_EVENT_LIST EVENT 0x0001 /end DEFAULT_EVENT_LIST /end DAQ_EVENT
 /end IF_DATA
/end MEASUREMENT
/begin MEASUREMENT mcb_pmsm_foc_hall_f28379d_B.Gain_c "" FLOAT32_IEEE mcb_pmsm_foc_hall_f28379d_CM_single 0 0 -3.4E+38 3.4E+38 ECU_ADDRESS 0x0000E2B6 /end MEASUREMENT
/begin MEASUREMENT mcb_pmsm_foc_hall_f28379d_B.Gain_e "" FLOAT32_IEEE mcb_pmsm_foc_hall_f28379d_CM_single 0 0 -3.4E+38 3.4E+38 ECU_ADDRESS 0x0000E2AE /end MEASUREMENT
/begin MEASUREMENT mcb_pmsm_foc_hall_f28379d_B.Gain_g "" FLOAT32_IEEE mcb_pmsm_foc_hall_f28379d_CM_single 0 0 -3.4E+38 3.4E+38 ECU_ADDRESS 0x0000E17C
 /begin IF_DATA XCP
  /begin DAQ_EVENT VARIABLE /begin DEFAULT_EVENT_LIST EVENT 0x0001 /end DEFAULT_EVENT_LIST /end DAQ_EVENT
 /end IF_DATA
/end MEASUREMENT
/begin MEASUREMENT mcb_pmsm_foc_hall_f28379d_B.Gain_m "" FLOAT32_IEEE mcb_pmsm_foc_hall_f28379d_CM_single 0 0 -3.4E+38 3.4E+38 ARRAY_SIZE 3 ECU_ADDRESS 0x0000E23A /end MEASUREMENT
/begin MEASUREMENT mcb_pmsm_foc_hall_f28379d_B.Gain_o "" FLOAT32_IEEE mcb_pmsm_foc_hall_f28379d_CM_single 0 0 -3.4E+38 3.4E+38 ARRAY_SIZE 3 ECU_ADDRESS 0x0000E234 /end MEASUREMENT
/begin MEASUREMENT mcb_pmsm_foc_hall_f28379d_B.GetADCVoltage "" FLOAT32_IEEE mcb_pmsm_foc_hall_f28379d_CM_single 0 0 -3.4E+38 3.4E+38 ARRAY_SIZE 2 ECU_ADDRESS 0x0000E19E /end MEASUREMENT
/begin MEASUREMENT mcb_pmsm_foc_hall_f28379d_B.GetCurrents "" FLOAT32_IEEE mcb_pmsm_foc_hall_f28379d_CM_single 0 0 -3.4E+38 3.4E+38 ARRAY_SIZE 2 ECU_ADDRESS 0x0000E1A2 /end MEASUREMENT
/begin MEASUREMENT mcb_pmsm_foc_hall_f28379d_B.Get_Integer "" UWORD mcb_pmsm_foc_hall_f28379d_CM_uint16 0 0 0 65535 ECU_ADDRESS 0x0000E2EF /end MEASUREMENT
/begin MEASUREMENT mcb_pmsm_foc_hall_f28379d_B.Get_Integer_f "" UWORD mcb_pmsm_foc_hall_f28379d_CM_uint16 0 0 0 65535 ECU_ADDRESS 0x0000E2F1 /end MEASUREMENT
/begin MEASUREMENT mcb_pmsm_foc_hall_f28379d_B.Hall_A "" ULONG mcb_pmsm_foc_hall_f28379d_CM_uint32 0 0 0 4294967295 ECU_ADDRESS 0x0000E0E0 /end MEASUREMENT
/begin MEASUREMENT mcb_pmsm_foc_hall_f28379d_B.Hall_A_c "" ULONG mcb_pmsm_foc_hall_f28379d_CM_uint32 0 0 0 4294967295 ECU_ADDRESS 0x0000E15A /end MEASUREMENT
/begin MEASUREMENT mcb_pmsm_foc_hall_f28379d_B.Hall_A_d "" ULONG mcb_pmsm_foc_hall_f28379d_CM_uint32 0 0 0 4294967295 ECU_ADDRESS 0x0000E142 /end MEASUREMENT
/begin MEASUREMENT mcb_pmsm_foc_hall_f28379d_B.Hall_A_e "" ULONG mcb_pmsm_foc_hall_f28379d_CM_uint32 0 0 0 4294967295 ECU_ADDRESS 0x0000E0F8 /end MEASUREMENT
/begin MEASUREMENT mcb_pmsm_foc_hall_f28379d_B.Hall_A_k "" ULONG mcb_pmsm_foc_hall_f28379d_CM_uint32 0 0 0 4294967295 ECU_ADDRESS 0x0000E110 /end MEASUREMENT
/begin MEASUREMENT mcb_pmsm_foc_hall_f28379d_B.Hall_B "" ULONG mcb_pmsm_foc_hall_f28379d_CM_uint32 0 0 0 4294967295 ECU_ADDRESS 0x0000E0DC /end MEASUREMENT
/begin MEASUREMENT mcb_pmsm_foc_hall_f28379d_B.Hall_B_e "" ULONG mcb_pmsm_foc_hall_f28379d_CM_uint32 0 0 0 4294967295 ECU_ADDRESS 0x0000E13E /end MEASUREMENT
/begin MEASUREMENT mcb_pmsm_foc_hall_f28379d_B.Hall_B_f "" ULONG mcb_pmsm_foc_hall_f28379d_CM_uint32 0 0 0 4294967295 ECU_ADDRESS 0x0000E156 /end MEASUREMENT
/begin MEASUREMENT mcb_pmsm_foc_hall_f28379d_B.Hall_B_i "" ULONG mcb_pmsm_foc_hall_f28379d_CM_uint32 0 0 0 4294967295 ECU_ADDRESS 0x0000E10C /end MEASUREMENT
/begin MEASUREMENT mcb_pmsm_foc_hall_f28379d_B.Hall_B_m "" ULONG mcb_pmsm_foc_hall_f28379d_CM_uint32 0 0 0 4294967295 ECU_ADDRESS 0x0000E0F4 /end MEASUREMENT
/begin MEASUREMENT mcb_pmsm_foc_hall_f28379d_B.Hall_C "" ULONG mcb_pmsm_foc_hall_f28379d_CM_uint32 0 0 0 4294967295 ECU_ADDRESS 0x0000E0D8 /end MEASUREMENT
/begin MEASUREMENT mcb_pmsm_foc_hall_f28379d_B.Hall_C_e "" ULONG mcb_pmsm_foc_hall_f28379d_CM_uint32 0 0 0 4294967295 ECU_ADDRESS 0x0000E13A /end MEASUREMENT
/begin MEASUREMENT mcb_pmsm_foc_hall_f28379d_B.Hall_C_f "" ULONG mcb_pmsm_foc_hall_f28379d_CM_uint32 0 0 0 4294967295 ECU_ADDRESS 0x0000E0F0 /end MEASUREMENT
/begin MEASUREMENT mcb_pmsm_foc_hall_f28379d_B.Hall_C_fc "" ULONG mcb_pmsm_foc_hall_f28379d_CM_uint32 0 0 0 4294967295 ECU_ADDRESS 0x0000E152 /end MEASUREMENT
/begin MEASUREMENT mcb_pmsm_foc_hall_f28379d_B.Hall_C_n "" ULONG mcb_pmsm_foc_hall_f28379d_CM_uint32 0 0 0 4294967295 ECU_ADDRESS 0x0000E108 /end MEASUREMENT
/begin MEASUREMENT mcb_pmsm_foc_hall_f28379d_B.IProdOut "" FLOAT32_IEEE mcb_pmsm_foc_hall_f28379d_CM_single 0 0 -3.4E+38 3.4E+38 ECU_ADDRESS 0x0000E1EE /end MEASUREMENT
/begin MEASUREMENT mcb_pmsm_foc_hall_f28379d_B.IProdOut_h "" FLOAT32_IEEE mcb_pmsm_foc_hall_f28379d_CM_single 0 0 -3.4E+38 3.4E+38 ECU_ADDRESS 0x0000E1F4 /end MEASUREMENT
/begin MEASUREMENT mcb_pmsm_foc_hall_f28379d_B.IfActionSubsystem.Convert_back "" FLOAT32_IEEE mcb_pmsm_foc_hall_f28379d_CM_single 0 0 -3.4E+38 3.4E+38 ECU_ADDRESS 0x0000E37A /end MEASUREMENT
/begin MEASUREMENT mcb_pmsm_foc_hall_f28379d_B.IfActionSubsystem.Convert_uint16 "" SWORD mcb_pmsm_foc_hall_f28379d_CM_int16 0 0 -32768 32767 ECU_ADDRESS 0x0000E37C /end MEASUREMENT
/begin MEASUREMENT mcb_pmsm_foc_hall_f28379d_B.IfActionSubsystem1.Convert_back "" FLOAT32_IEEE mcb_pmsm_foc_hall_f28379d_CM_single 0 0 -3.4E+38 3.4E+38 ECU_ADDRESS 0x0000E376 /end MEASUREMENT
/begin MEASUREMENT mcb_pmsm_foc_hall_f28379d_B.IfActionSubsystem1.Convert_uint16 "" SWORD mcb_pmsm_foc_hall_f28379d_CM_int16 0 0 -32768 32767 ECU_ADDRESS 0x0000E378 /end MEASUREMENT
/begin MEASUREMENT mcb_pmsm_foc_hall_f28379d_B.IfActionSubsystem1_i.Convert_back "" FLOAT32_IEEE mcb_pmsm_foc_hall_f28379d_CM_single 0 0 -3.4E+38 3.4E+38 ECU_ADDRESS 0x0000E36E /end MEASUREMENT
/begin MEASUREMENT mcb_pmsm_foc_hall_f28379d_B.IfActionSubsystem1_i.Convert_uint16 "" SWORD mcb_pmsm_foc_hall_f28379d_CM_int16 0 0 -32768 32767 ECU_ADDRESS 0x0000E370 /end MEASUREMENT
/begin MEASUREMENT mcb_pmsm_foc_hall_f28379d_B.IfActionSubsystem_n.Convert_back "" FLOAT32_IEEE mcb_pmsm_foc_hall_f28379d_CM_single 0 0 -3.4E+38 3.4E+38 ECU_ADDRESS 0x0000E372 /end MEASUREMENT
/begin MEASUREMENT mcb_pmsm_foc_hall_f28379d_B.IfActionSubsystem_n.Convert_uint16 "" SWORD mcb_pmsm_foc_hall_f28379d_CM_int16 0 0 -32768 32767 ECU_ADDRESS 0x0000E374 /end MEASUREMENT
/begin MEASUREMENT mcb_pmsm_foc_hall_f28379d_B.Input "" ULONG mcb_pmsm_foc_hall_f28379d_CM_uint32 0 0 0 4294967295 ECU_ADDRESS 0x0000E12E /end MEASUREMENT
/begin MEASUREMENT mcb_pmsm_foc_hall_f28379d_B.Integrator "" FLOAT32_IEEE mcb_pmsm_foc_hall_f28379d_CM_single 0 0 -3.4E+38 3.4E+38 ECU_ADDRESS 0x0000E1CC /end MEASUREMENT
/begin MEASUREMENT mcb_pmsm_foc_hall_f28379d_B.Integrator_o "" FLOAT32_IEEE mcb_pmsm_foc_hall_f28379d_CM_single 0 0 -3.4E+38 3.4E+38 ECU_ADDRESS 0x0000E1D8 /end MEASUREMENT
/begin MEASUREMENT mcb_pmsm_foc_hall_f28379d_B.Ki1 "" FLOAT32_IEEE mcb_pmsm_foc_hall_f28379d_CM_single 0 0 -3.4E+38 3.4E+38 ECU_ADDRESS 0x0000E1D6 /end MEASUREMENT
/begin MEASUREMENT mcb_pmsm_foc_hall_f28379d_B.Kp1 "" FLOAT32_IEEE mcb_pmsm_foc_hall_f28379d_CM_single 0 0 -3.4E+38 3.4E+38 ECU_ADDRESS 0x0000E1CA /end MEASUREMENT
/begin MEASUREMENT mcb_pmsm_foc_hall_f28379d_B.LogicalOperator "" UBYTE mcb_pmsm_foc_hall_f28379d_CM_logical 0 0 0 1 ECU_ADDRESS 0x0000E31B /end MEASUREMENT
/begin MEASUREMENT mcb_pmsm_foc_hall_f28379d_B.LogicalOperator_a "" UBYTE mcb_pmsm_foc_hall_f28379d_CM_logical 0 0 0 1 ECU_ADDRESS 0x0000E32A /end MEASUREMENT
/begin MEASUREMENT mcb_pmsm_foc_hall_f28379d_B.LogicalOperator_j "" UBYTE mcb_pmsm_foc_hall_f28379d_CM_logical 0 0 0 1 ECU_ADDRESS 0x0000E31D /end MEASUREMENT
/begin MEASUREMENT mcb_pmsm_foc_hall_f28379d_B.Lookup "" FLOAT32_IEEE mcb_pmsm_foc_hall_f28379d_CM_single 0 0 -3.4E+38 3.4E+38 ARRAY_SIZE 4 ECU_ADDRESS 0x0000E1AE /end MEASUREMENT
/begin MEASUREMENT mcb_pmsm_foc_hall_f28379d_B.Lookup_f "" FLOAT32_IEEE mcb_pmsm_foc_hall_f28379d_CM_single 0 0 -3.4E+38 3.4E+38 ARRAY_SIZE 4 ECU_ADDRESS 0x0000E1FE /end MEASUREMENT
/begin MEASUREMENT mcb_pmsm_foc_hall_f28379d_B.Loss "" FLOAT32_IEEE mcb_pmsm_foc_hall_f28379d_CM_single 0 0 -3.4E+38 3.4E+38 ECU_ADDRESS 0x0000E188
 /begin IF_DATA XCP
  /begin DAQ_EVENT VARIABLE /begin DEFAULT_EVENT_LIST EVENT 0x0001 /end DEFAULT_EVENT_LIST /end DAQ_EVENT
 /end IF_DATA
/end MEASUREMENT
/begin MEASUREMENT mcb_pmsm_foc_hall_f28379d_B.LowerRelop1 "" UBYTE mcb_pmsm_foc_hall_f28379d_CM_logical 0 0 0 1 ECU_ADDRESS 0x0000E330 /end MEASUREMENT
/begin MEASUREMENT mcb_pmsm_foc_hall_f28379d_B.Max "" ULONG mcb_pmsm_foc_hall_f28379d_CM_uint32 0 0 0 4294967295 ECU_ADDRESS 0x0000E130 /end MEASUREMENT
/begin MEASUREMENT mcb_pmsm_foc_hall_f28379d_B.Max_h "" FLOAT32_IEEE mcb_pmsm_foc_hall_f28379d_CM_single 0 0 -3.4E+38 3.4E+38 ECU_ADDRESS 0x0000E228 /end MEASUREMENT
/begin MEASUREMENT mcb_pmsm_foc_hall_f28379d_B.Memory "" UWORD mcb_pmsm_foc_hall_f28379d_CM_uint16 0 0 0 65535 ECU_ADDRESS 0x0000E2D0 /end MEASUREMENT
/begin MEASUREMENT mcb_pmsm_foc_hall_f28379d_B.Memory1 "" UWORD mcb_pmsm_foc_hall_f28379d_CM_uint16 0 0 0 65535 ECU_ADDRESS 0x0000E2D2 /end MEASUREMENT
/begin MEASUREMENT mcb_pmsm_foc_hall_f28379d_B.MemoryCopy "" ULONG mcb_pmsm_foc_hall_f28379d_CM_uint32 0 0 0 4294967295 ECU_ADDRESS 0x0000E148 /end MEASUREMENT
/begin MEASUREMENT mcb_pmsm_foc_hall_f28379d_B.MemoryCopy1 "" ULONG mcb_pmsm_foc_hall_f28379d_CM_uint32 0 0 0 4294967295 ECU_ADDRESS 0x0000E14A /end MEASUREMENT
/begin MEASUREMENT mcb_pmsm_foc_hall_f28379d_B.MemoryCopy2 "" ULONG mcb_pmsm_foc_hall_f28379d_CM_uint32 0 0 0 4294967295 ECU_ADDRESS 0x0000E14C /end MEASUREMENT
/begin MEASUREMENT mcb_pmsm_foc_hall_f28379d_B.Merge "" ULONG mcb_pmsm_foc_hall_f28379d_CM_uint32 0 0 0 4294967295 ECU_ADDRESS 0x0000E134 /end MEASUREMENT
/begin MEASUREMENT mcb_pmsm_foc_hall_f28379d_B.Merge1 "" FLOAT32_IEEE mcb_pmsm_foc_hall_f28379d_CM_single 0 0 -3.4E+38 3.4E+38 ECU_ADDRESS 0x0000E194 /end MEASUREMENT
/begin MEASUREMENT mcb_pmsm_foc_hall_f28379d_B.Merge1_a "" SWORD mcb_pmsm_foc_hall_f28379d_CM_int16 0 0 -32768 32767 ECU_ADDRESS 0x0000E300 /end MEASUREMENT
/begin MEASUREMENT mcb_pmsm_foc_hall_f28379d_B.Merge1_d "" FLOAT32_IEEE mcb_pmsm_foc_hall_f28379d_CM_single 0 0 -3.4E+38 3.4E+38 ECU_ADDRESS 0x0000E26C /end MEASUREMENT
/begin MEASUREMENT mcb_pmsm_foc_hall_f28379d_B.Merge1_k "" SWORD mcb_pmsm_foc_hall_f28379d_CM_int16 0 0 -32768 32767 ECU_ADDRESS 0x0000E2FE /end MEASUREMENT
/begin MEASUREMENT mcb_pmsm_foc_hall_f28379d_B.Merge1_kl "" SWORD mcb_pmsm_foc_hall_f28379d_CM_int16 0 0 -32768 32767 ECU_ADDRESS 0x0000E302 /end MEASUREMENT
/begin MEASUREMENT mcb_pmsm_foc_hall_f28379d_B.Merge1_l "" FLOAT32_IEEE mcb_pmsm_foc_hall_f28379d_CM_single 0 0 -3.4E+38 3.4E+38 ECU_ADDRESS 0x0000E24C /end MEASUREMENT
/begin MEASUREMENT mcb_pmsm_foc_hall_f28379d_B.Merge1_la "" FLOAT32_IEEE mcb_pmsm_foc_hall_f28379d_CM_single 0 0 -3.4E+38 3.4E+38 ECU_ADDRESS 0x0000E26A /end MEASUREMENT
/begin MEASUREMENT mcb_pmsm_foc_hall_f28379d_B.Merge3 "" UBYTE mcb_pmsm_foc_hall_f28379d_CM_logical 0 0 0 1 ECU_ADDRESS 0x0000E30C /end MEASUREMENT
/begin MEASUREMENT mcb_pmsm_foc_hall_f28379d_B.Merge3_m "" UBYTE mcb_pmsm_foc_hall_f28379d_CM_logical 0 0 0 1 ECU_ADDRESS 0x0000E310 /end MEASUREMENT
/begin MEASUREMENT mcb_pmsm_foc_hall_f28379d_B.Merge3_o "" UBYTE mcb_pmsm_foc_hall_f28379d_CM_logical 0 0 0 1 ECU_ADDRESS 0x0000E30E /end MEASUREMENT
/begin MEASUREMENT mcb_pmsm_foc_hall_f28379d_B.Merge_c "" FLOAT32_IEEE mcb_pmsm_foc_hall_f28379d_CM_single 0 0 -3.4E+38 3.4E+38 ECU_ADDRESS 0x0000E250 /end MEASUREMENT
/begin MEASUREMENT mcb_pmsm_foc_hall_f28379d_B.Merge_d "" FLOAT32_IEEE mcb_pmsm_foc_hall_f28379d_CM_single 0 0 -3.4E+38 3.4E+38 ECU_ADDRESS 0x0000E192 /end MEASUREMENT
/begin MEASUREMENT mcb_pmsm_foc_hall_f28379d_B.Merge_do "" FLOAT32_IEEE mcb_pmsm_foc_hall_f28379d_CM_single 0 0 -3.4E+38 3.4E+38 ARRAY_SIZE 2 ECU_ADDRESS 0x0000E1E8 /end MEASUREMENT
/begin MEASUREMENT mcb_pmsm_foc_hall_f28379d_B.Merge_f "" UBYTE mcb_pmsm_foc_hall_f28379d_CM_logical 0 0 0 1 ECU_ADDRESS 0x0000E30F /end MEASUREMENT
/begin MEASUREMENT mcb_pmsm_foc_hall_f28379d_B.Merge_j "" UWORD mcb_pmsm_foc_hall_f28379d_CM_uint16 0 0 0 65535 ECU_ADDRESS 0x0000E2DF /end MEASUREMENT
/begin MEASUREMENT mcb_pmsm_foc_hall_f28379d_B.Merge_k "" UWORD mcb_pmsm_foc_hall_f28379d_CM_uint16 0 0 0 65535 ECU_ADDRESS 0x0000E2E3 /end MEASUREMENT
/begin MEASUREMENT mcb_pmsm_foc_hall_f28379d_B.Merge_m "" FLOAT32_IEEE mcb_pmsm_foc_hall_f28379d_CM_single 0 0 -3.4E+38 3.4E+38 ECU_ADDRESS 0x0000E198 /end MEASUREMENT
/begin MEASUREMENT mcb_pmsm_foc_hall_f28379d_B.Merge_me "" FLOAT32_IEEE mcb_pmsm_foc_hall_f28379d_CM_single 0 0 -3.4E+38 3.4E+38 ECU_ADDRESS 0x0000E2AC /end MEASUREMENT
/begin MEASUREMENT mcb_pmsm_foc_hall_f28379d_B.Merge_mm "" FLOAT32_IEEE mcb_pmsm_foc_hall_f28379d_CM_single 0 0 -3.4E+38 3.4E+38 ECU_ADDRESS 0x0000E1AA /end MEASUREMENT
/begin MEASUREMENT mcb_pmsm_foc_hall_f28379d_B.Merge_n "" UBYTE mcb_pmsm_foc_hall_f28379d_CM_logical 0 0 0 1 ECU_ADDRESS 0x0000E311 /end MEASUREMENT
/begin MEASUREMENT mcb_pmsm_foc_hall_f28379d_B.Merge_p "" FLOAT32_IEEE mcb_pmsm_foc_hall_f28379d_CM_single 0 0 -3.4E+38 3.4E+38 ECU_ADDRESS 0x0000E1F8 /end MEASUREMENT
/begin MEASUREMENT mcb_pmsm_foc_hall_f28379d_B.Merge_pc "" UWORD mcb_pmsm_foc_hall_f28379d_CM_uint16 0 0 0 65535 ECU_ADDRESS 0x0000E2DB /end MEASUREMENT
/begin MEASUREMENT mcb_pmsm_foc_hall_f28379d_B.Merge_pt "" UBYTE mcb_pmsm_foc_hall_f28379d_CM_logical 0 0 0 1 ECU_ADDRESS 0x0000E30D /end MEASUREMENT
/begin MEASUREMENT mcb_pmsm_foc_hall_f28379d_B.Min "" ULONG mcb_pmsm_foc_hall_f28379d_CM_uint32 0 0 0 4294967295 ECU_ADDRESS 0x0000E14E /end MEASUREMENT
/begin MEASUREMENT mcb_pmsm_foc_hall_f28379d_B.Min_a "" FLOAT32_IEEE mcb_pmsm_foc_hall_f28379d_CM_single 0 0 -3.4E+38 3.4E+38 ECU_ADDRESS 0x0000E226 /end MEASUREMENT
/begin MEASUREMENT mcb_pmsm_foc_hall_f28379d_B.NOT "" UBYTE mcb_pmsm_foc_hall_f28379d_CM_logical 0 0 0 1 ECU_ADDRESS 0x0000E30A /end MEASUREMENT
/begin MEASUREMENT mcb_pmsm_foc_hall_f28379d_B.NOT_b "" UBYTE mcb_pmsm_foc_hall_f28379d_CM_logical 0 0 0 1 ECU_ADDRESS 0x0000E32C /end MEASUREMENT
/begin MEASUREMENT mcb_pmsm_foc_hall_f28379d_B.OR "" UBYTE mcb_pmsm_foc_hall_f28379d_CM_logical 0 0 0 1 ECU_ADDRESS 0x0000E317 /end MEASUREMENT
/begin MEASUREMENT mcb_pmsm_foc_hall_f28379d_B.OutportBufferForV_dq_ref "" FLOAT32_IEEE mcb_pmsm_foc_hall_f28379d_CM_single 0 0 -3.4E+38 3.4E+38 ARRAY_SIZE 2 ECU_ADDRESS 0x0000E21A /end MEASUREMENT
/begin MEASUREMENT mcb_pmsm_foc_hall_f28379d_B.PProdOut "" FLOAT32_IEEE mcb_pmsm_foc_hall_f28379d_CM_single 0 0 -3.4E+38 3.4E+38 ECU_ADDRESS 0x0000E1C8 /end MEASUREMENT
/begin MEASUREMENT mcb_pmsm_foc_hall_f28379d_B.PProdOut_b "" FLOAT32_IEEE mcb_pmsm_foc_hall_f28379d_CM_single 0 0 -3.4E+38 3.4E+38 ECU_ADDRESS 0x0000E1D4 /end MEASUREMENT
/begin MEASUREMENT mcb_pmsm_foc_hall_f28379d_B.PU_Conversion "" FLOAT32_IEEE mcb_pmsm_foc_hall_f28379d_CM_single 0 0 -3.4E+38 3.4E+38 ARRAY_SIZE 2 ECU_ADDRESS 0x0000E1A6 /end MEASUREMENT
/begin MEASUREMENT mcb_pmsm_foc_hall_f28379d_B.PWM_Duty_Cycles "" FLOAT32_IEEE mcb_pmsm_foc_hall_f28379d_CM_single 0 0 -3.4E+38 3.4E+38 ARRAY_SIZE 3 ECU_ADDRESS 0x0000E240 /end MEASUREMENT
/begin MEASUREMENT mcb_pmsm_foc_hall_f28379d_B.Product "" FLOAT32_IEEE mcb_pmsm_foc_hall_f28379d_CM_single 0 0 -3.4E+38 3.4E+38 ECU_ADDRESS 0x0000E1BC /end MEASUREMENT
/begin MEASUREMENT mcb_pmsm_foc_hall_f28379d_B.Product1 "" FLOAT32_IEEE mcb_pmsm_foc_hall_f28379d_CM_single 0 0 -3.4E+38 3.4E+38 ECU_ADDRESS 0x0000E1C2 /end MEASUREMENT
/begin MEASUREMENT mcb_pmsm_foc_hall_f28379d_B.Product1_b "" FLOAT32_IEEE mcb_pmsm_foc_hall_f28379d_CM_single 0 0 -3.4E+38 3.4E+38 ECU_ADDRESS 0x0000E1E4 /end MEASUREMENT
/begin MEASUREMENT mcb_pmsm_foc_hall_f28379d_B.Product1_p "" FLOAT32_IEEE mcb_pmsm_foc_hall_f28379d_CM_single 0 0 -3.4E+38 3.4E+38 ECU_ADDRESS 0x0000E20E /end MEASUREMENT
/begin MEASUREMENT mcb_pmsm_foc_hall_f28379d_B.Product2 "" FLOAT32_IEEE mcb_pmsm_foc_hall_f28379d_CM_single 0 0 -3.4E+38 3.4E+38 ECU_ADDRESS 0x0000E2AA /end MEASUREMENT
/begin MEASUREMENT mcb_pmsm_foc_hall_f28379d_B.Product_a "" FLOAT32_IEEE mcb_pmsm_foc_hall_f28379d_CM_single 0 0 -3.4E+38 3.4E+38 ECU_ADDRESS 0x0000E2A6 /end MEASUREMENT
/begin MEASUREMENT mcb_pmsm_foc_hall_f28379d_B.Product_b "" FLOAT32_IEEE mcb_pmsm_foc_hall_f28379d_CM_single 0 0 -3.4E+38 3.4E+38 ECU_ADDRESS 0x0000E1E0 /end MEASUREMENT
/begin MEASUREMENT mcb_pmsm_foc_hall_f28379d_B.Product_d "" FLOAT32_IEEE mcb_pmsm_foc_hall_f28379d_CM_single 0 0 -3.4E+38 3.4E+38 ECU_ADDRESS 0x0000E20A /end MEASUREMENT
/begin MEASUREMENT mcb_pmsm_foc_hall_f28379d_B.Product_e "" FLOAT32_IEEE mcb_pmsm_foc_hall_f28379d_CM_single 0 0 -3.4E+38 3.4E+38 ECU_ADDRESS 0x0000E1E2 /end MEASUREMENT
/begin MEASUREMENT mcb_pmsm_foc_hall_f28379d_B.Product_i "" FLOAT32_IEEE mcb_pmsm_foc_hall_f28379d_CM_single 0 0 -3.4E+38 3.4E+38 ECU_ADDRESS 0x0000E268 /end MEASUREMENT
/begin MEASUREMENT mcb_pmsm_foc_hall_f28379d_B.Product_ie "" FLOAT32_IEEE mcb_pmsm_foc_hall_f28379d_CM_single 0 0 -3.4E+38 3.4E+38 ARRAY_SIZE 2 ECU_ADDRESS 0x0000E296 /end MEASUREMENT
/begin MEASUREMENT mcb_pmsm_foc_hall_f28379d_B.RT1 "" FLOAT32_IEEE mcb_pmsm_foc_hall_f28379d_CM_single 0 0 -3.4E+38 3.4E+38 ECU_ADDRESS 0x0000E160
 /begin IF_DATA XCP
  /begin DAQ_EVENT VARIABLE /begin DEFAULT_EVENT_LIST EVENT 0x0000 /end DEFAULT_EVENT_LIST /end DAQ_EVENT
 /end IF_DATA
/end MEASUREMENT
/begin MEASUREMENT mcb_pmsm_foc_hall_f28379d_B.RT10 "" FLOAT32_IEEE mcb_pmsm_foc_hall_f28379d_CM_single 0 0 -3.4E+38 3.4E+38 ARRAY_SIZE 2 ECU_ADDRESS 0x0000E16A
 /begin IF_DATA XCP
  /begin DAQ_EVENT VARIABLE /begin DEFAULT_EVENT_LIST EVENT 0x0001 /end DEFAULT_EVENT_LIST /end DAQ_EVENT
 /end IF_DATA
/end MEASUREMENT
/begin MEASUREMENT mcb_pmsm_foc_hall_f28379d_B.RT11 "" FLOAT32_IEEE mcb_pmsm_foc_hall_f28379d_CM_single 0 0 -3.4E+38 3.4E+38 ARRAY_SIZE 2 ECU_ADDRESS 0x0000E16E
 /begin IF_DATA XCP
  /begin DAQ_EVENT VARIABLE /begin DEFAULT_EVENT_LIST EVENT 0x0001 /end DEFAULT_EVENT_LIST /end DAQ_EVENT
 /end IF_DATA
/end MEASUREMENT
/begin MEASUREMENT mcb_pmsm_foc_hall_f28379d_B.RT12 "" FLOAT64_IEEE mcb_pmsm_foc_hall_f28379d_CM_double 0 0 -1.7E+308 1.7E+308 ECU_ADDRESS 0x0000E0D0
 /begin IF_DATA XCP
  /begin DAQ_EVENT VARIABLE /begin DEFAULT_EVENT_LIST EVENT 0x0001 /end DEFAULT_EVENT_LIST /end DAQ_EVENT
 /end IF_DATA
/end MEASUREMENT
/begin MEASUREMENT mcb_pmsm_foc_hall_f28379d_B.RT2 "" FLOAT32_IEEE mcb_pmsm_foc_hall_f28379d_CM_single 0 0 -3.4E+38 3.4E+38 ARRAY_SIZE 2 ECU_ADDRESS 0x0000E172 /end MEASUREMENT
/begin MEASUREMENT mcb_pmsm_foc_hall_f28379d_B.RT6 "" FLOAT32_IEEE mcb_pmsm_foc_hall_f28379d_CM_single 0 0 -3.4E+38 3.4E+38 ECU_ADDRESS 0x0000E162
 /begin IF_DATA XCP
  /begin DAQ_EVENT VARIABLE /begin DEFAULT_EVENT_LIST EVENT 0x0000 /end DEFAULT_EVENT_LIST /end DAQ_EVENT
 /end IF_DATA
/end MEASUREMENT
/begin MEASUREMENT mcb_pmsm_foc_hall_f28379d_B.RT7 "" FLOAT32_IEEE mcb_pmsm_foc_hall_f28379d_CM_single 0 0 -3.4E+38 3.4E+38 ECU_ADDRESS 0x0000E164
 /begin IF_DATA XCP
  /begin DAQ_EVENT VARIABLE /begin DEFAULT_EVENT_LIST EVENT 0x0000 /end DEFAULT_EVENT_LIST /end DAQ_EVENT
 /end IF_DATA
/end MEASUREMENT
/begin MEASUREMENT mcb_pmsm_foc_hall_f28379d_B.RT8 "" FLOAT32_IEEE mcb_pmsm_foc_hall_f28379d_CM_single 0 0 -3.4E+38 3.4E+38 ECU_ADDRESS 0x0000E166
 /begin IF_DATA XCP
  /begin DAQ_EVENT VARIABLE /begin DEFAULT_EVENT_LIST EVENT 0x0001 /end DEFAULT_EVENT_LIST /end DAQ_EVENT
 /end IF_DATA
/end MEASUREMENT
/begin MEASUREMENT mcb_pmsm_foc_hall_f28379d_B.RT9 "" FLOAT32_IEEE mcb_pmsm_foc_hall_f28379d_CM_single 0 0 -3.4E+38 3.4E+38 ECU_ADDRESS 0x0000E168
 /begin IF_DATA XCP
  /begin DAQ_EVENT VARIABLE /begin DEFAULT_EVENT_LIST EVENT 0x0001 /end DEFAULT_EVENT_LIST /end DAQ_EVENT
 /end IF_DATA
/end MEASUREMENT
/begin MEASUREMENT mcb_pmsm_foc_hall_f28379d_B.ReadGPIODATregister "" ULONG mcb_pmsm_foc_hall_f28379d_CM_uint32 0 0 0 4294967295 ECU_ADDRESS 0x0000E0D6 /end MEASUREMENT
/begin MEASUREMENT mcb_pmsm_foc_hall_f28379d_B.ReadGPIODATregister_g "" ULONG mcb_pmsm_foc_hall_f28379d_CM_uint32 0 0 0 4294967295 ECU_ADDRESS 0x0000E106 /end MEASUREMENT
/begin MEASUREMENT mcb_pmsm_foc_hall_f28379d_B.ReadGPIODATregister_n "" ULONG mcb_pmsm_foc_hall_f28379d_CM_uint32 0 0 0 4294967295 ECU_ADDRESS 0x0000E0EE /end MEASUREMENT
/begin MEASUREMENT mcb_pmsm_foc_hall_f28379d_B.ReadGPIODATregister_nt "" ULONG mcb_pmsm_foc_hall_f28379d_CM_uint32 0 0 0 4294967295 ECU_ADDRESS 0x0000E150 /end MEASUREMENT
/begin MEASUREMENT mcb_pmsm_foc_hall_f28379d_B.ReadGPIODATregister_p "" ULONG mcb_pmsm_foc_hall_f28379d_CM_uint32 0 0 0 4294967295 ECU_ADDRESS 0x0000E138 /end MEASUREMENT
/begin MEASUREMENT mcb_pmsm_foc_hall_f28379d_B.Reciprocal "" FLOAT32_IEEE mcb_pmsm_foc_hall_f28379d_CM_single 0 0 -3.4E+38 3.4E+38 ECU_ADDRESS 0x0000E29E /end MEASUREMENT
/begin MEASUREMENT mcb_pmsm_foc_hall_f28379d_B.RelationalOperator "" UBYTE mcb_pmsm_foc_hall_f28379d_CM_logical 0 0 0 1 ECU_ADDRESS 0x0000E31E /end MEASUREMENT
/begin MEASUREMENT mcb_pmsm_foc_hall_f28379d_B.RelationalOperator_h "" UBYTE mcb_pmsm_foc_hall_f28379d_CM_logical 0 0 0 1 ECU_ADDRESS 0x0000E32D /end MEASUREMENT
/begin MEASUREMENT mcb_pmsm_foc_hall_f28379d_B.RelationalOperator_i "" UBYTE mcb_pmsm_foc_hall_f28379d_CM_logical 0 0 0 1 ECU_ADDRESS 0x0000E331 /end MEASUREMENT
/begin MEASUREMENT mcb_pmsm_foc_hall_f28379d_B.RelationalOperator_k "" UBYTE mcb_pmsm_foc_hall_f28379d_CM_logical 0 0 0 1 ECU_ADDRESS 0x0000E32B /end MEASUREMENT
/begin MEASUREMENT mcb_pmsm_foc_hall_f28379d_B.RelationalOperator_m "" UBYTE mcb_pmsm_foc_hall_f28379d_CM_logical 0 0 0 1 ECU_ADDRESS 0x0000E323 /end MEASUREMENT
/begin MEASUREMENT mcb_pmsm_foc_hall_f28379d_B.SCIReceive "" FLOAT32_IEEE mcb_pmsm_foc_hall_f28379d_CM_single 0 0 -3.4E+38 3.4E+38 ARRAY_SIZE 2 ECU_ADDRESS 0x0000E18E /end MEASUREMENT
/begin MEASUREMENT mcb_pmsm_foc_hall_f28379d_B.SPIMasterTransfer2.SPIMasterTransfer2 "" UWORD mcb_pmsm_foc_hall_f28379d_CM_uint16 0 0 0 65535 ARRAY_SIZE 1 ECU_ADDRESS 0x0000E35D /end MEASUREMENT
/begin MEASUREMENT mcb_pmsm_foc_hall_f28379d_B.SPIMasterTransfer3.SPIMasterTransfer2 "" UWORD mcb_pmsm_foc_hall_f28379d_CM_uint16 0 0 0 65535 ARRAY_SIZE 1 ECU_ADDRESS 0x0000E35C /end MEASUREMENT
/begin MEASUREMENT mcb_pmsm_foc_hall_f28379d_B.Saturation "" FLOAT32_IEEE mcb_pmsm_foc_hall_f28379d_CM_single 0 0 -3.4E+38 3.4E+38 ECU_ADDRESS 0x0000E1D0 /end MEASUREMENT
/begin MEASUREMENT mcb_pmsm_foc_hall_f28379d_B.Saturation_j "" FLOAT32_IEEE mcb_pmsm_foc_hall_f28379d_CM_single 0 0 -3.4E+38 3.4E+38 ECU_ADDRESS 0x0000E1DC /end MEASUREMENT
/begin MEASUREMENT mcb_pmsm_foc_hall_f28379d_B.Saturation_k "" FLOAT32_IEEE mcb_pmsm_foc_hall_f28379d_CM_single 0 0 -3.4E+38 3.4E+38 ECU_ADDRESS 0x0000E24E /end MEASUREMENT
/begin MEASUREMENT mcb_pmsm_foc_hall_f28379d_B.Scale_to_PWM_Counter_PRD "" UWORD mcb_pmsm_foc_hall_f28379d_CM_uint16 0 0 0 65535 ARRAY_SIZE 3 ECU_ADDRESS 0x0000E2F5 /end MEASUREMENT
/begin MEASUREMENT mcb_pmsm_foc_hall_f28379d_B.ShiftArithmetic "" ULONG mcb_pmsm_foc_hall_f28379d_CM_uint32 0 0 0 4294967295 ECU_ADDRESS 0x0000E0DA /end MEASUREMENT
/begin MEASUREMENT mcb_pmsm_foc_hall_f28379d_B.ShiftArithmetic1 "" ULONG mcb_pmsm_foc_hall_f28379d_CM_uint32 0 0 0 4294967295 ECU_ADDRESS 0x0000E0DE /end MEASUREMENT
/begin MEASUREMENT mcb_pmsm_foc_hall_f28379d_B.ShiftArithmetic1_c "" ULONG mcb_pmsm_foc_hall_f28379d_CM_uint32 0 0 0 4294967295 ECU_ADDRESS 0x0000E140 /end MEASUREMENT
/begin MEASUREMENT mcb_pmsm_foc_hall_f28379d_B.ShiftArithmetic1_d "" UWORD mcb_pmsm_foc_hall_f28379d_CM_uint16 0 0 0 65535 ECU_ADDRESS 0x0000E2D7 /end MEASUREMENT
/begin MEASUREMENT mcb_pmsm_foc_hall_f28379d_B.ShiftArithmetic1_h "" ULONG mcb_pmsm_foc_hall_f28379d_CM_uint32 0 0 0 4294967295 ECU_ADDRESS 0x0000E158 /end MEASUREMENT
/begin MEASUREMENT mcb_pmsm_foc_hall_f28379d_B.ShiftArithmetic1_j "" ULONG mcb_pmsm_foc_hall_f28379d_CM_uint32 0 0 0 4294967295 ECU_ADDRESS 0x0000E0F6 /end MEASUREMENT
/begin MEASUREMENT mcb_pmsm_foc_hall_f28379d_B.ShiftArithmetic1_jb "" ULONG mcb_pmsm_foc_hall_f28379d_CM_uint32 0 0 0 4294967295 ECU_ADDRESS 0x0000E10E /end MEASUREMENT
/begin MEASUREMENT mcb_pmsm_foc_hall_f28379d_B.ShiftArithmetic2 "" ULONG mcb_pmsm_foc_hall_f28379d_CM_uint32 0 0 0 4294967295 ECU_ADDRESS 0x0000E0E2 /end MEASUREMENT
/begin MEASUREMENT mcb_pmsm_foc_hall_f28379d_B.ShiftArithmetic2_e "" ULONG mcb_pmsm_foc_hall_f28379d_CM_uint32 0 0 0 4294967295 ECU_ADDRESS 0x0000E15C /end MEASUREMENT
/begin MEASUREMENT mcb_pmsm_foc_hall_f28379d_B.ShiftArithmetic2_i "" ULONG mcb_pmsm_foc_hall_f28379d_CM_uint32 0 0 0 4294967295 ECU_ADDRESS 0x0000E112 /end MEASUREMENT
/begin MEASUREMENT mcb_pmsm_foc_hall_f28379d_B.ShiftArithmetic2_k "" ULONG mcb_pmsm_foc_hall_f28379d_CM_uint32 0 0 0 4294967295 ECU_ADDRESS 0x0000E0FA /end MEASUREMENT
/begin MEASUREMENT mcb_pmsm_foc_hall_f28379d_B.ShiftArithmetic2_kn "" ULONG mcb_pmsm_foc_hall_f28379d_CM_uint32 0 0 0 4294967295 ECU_ADDRESS 0x0000E144 /end MEASUREMENT
/begin MEASUREMENT mcb_pmsm_foc_hall_f28379d_B.ShiftArithmetic_b "" ULONG mcb_pmsm_foc_hall_f28379d_CM_uint32 0 0 0 4294967295 ECU_ADDRESS 0x0000E0F2 /end MEASUREMENT
/begin MEASUREMENT mcb_pmsm_foc_hall_f28379d_B.ShiftArithmetic_e "" ULONG mcb_pmsm_foc_hall_f28379d_CM_uint32 0 0 0 4294967295 ECU_ADDRESS 0x0000E10A /end MEASUREMENT
/begin MEASUREMENT mcb_pmsm_foc_hall_f28379d_B.ShiftArithmetic_l "" ULONG mcb_pmsm_foc_hall_f28379d_CM_uint32 0 0 0 4294967295 ECU_ADDRESS 0x0000E13C /end MEASUREMENT
/begin MEASUREMENT mcb_pmsm_foc_hall_f28379d_B.ShiftArithmetic_p "" ULONG mcb_pmsm_foc_hall_f28379d_CM_uint32 0 0 0 4294967295 ECU_ADDRESS 0x0000E154 /end MEASUREMENT
/begin MEASUREMENT mcb_pmsm_foc_hall_f28379d_B.SpeedControl.AND3 "" UBYTE mcb_pmsm_foc_hall_f28379d_CM_logical 0 0 0 1 ECU_ADDRESS 0x0000E35B
 /begin IF_DATA XCP
  /begin DAQ_EVENT VARIABLE /begin DEFAULT_EVENT_LIST EVENT 0x0000 /end DEFAULT_EVENT_LIST /end DAQ_EVENT
 /end IF_DATA
/end MEASUREMENT
/begin MEASUREMENT mcb_pmsm_foc_hall_f28379d_B.SpeedControl.Add1 "" FLOAT32_IEEE mcb_pmsm_foc_hall_f28379d_CM_single 0 0 -3.4E+38 3.4E+38 ECU_ADDRESS 0x0000E33E
 /begin IF_DATA XCP
  /begin DAQ_EVENT VARIABLE /begin DEFAULT_EVENT_LIST EVENT 0x0000 /end DEFAULT_EVENT_LIST /end DAQ_EVENT
 /end IF_DATA
/end MEASUREMENT
/begin MEASUREMENT mcb_pmsm_foc_hall_f28379d_B.SpeedControl.DataStoreRead1 "" UBYTE mcb_pmsm_foc_hall_f28379d_CM_logical 0 0 0 1 ECU_ADDRESS 0x0000E355
 /begin IF_DATA XCP
  /begin DAQ_EVENT VARIABLE /begin DEFAULT_EVENT_LIST EVENT 0x0000 /end DEFAULT_EVENT_LIST /end DAQ_EVENT
 /end IF_DATA
/end MEASUREMENT
/begin MEASUREMENT mcb_pmsm_foc_hall_f28379d_B.SpeedControl.DataStoreRead2 "" UBYTE mcb_pmsm_foc_hall_f28379d_CM_logical 0 0 0 1 ECU_ADDRESS 0x0000E354
 /begin IF_DATA XCP
  /begin DAQ_EVENT VARIABLE /begin DEFAULT_EVENT_LIST EVENT 0x0000 /end DEFAULT_EVENT_LIST /end DAQ_EVENT
 /end IF_DATA
/end MEASUREMENT
/begin MEASUREMENT mcb_pmsm_foc_hall_f28379d_B.SpeedControl.DeadZone "" FLOAT32_IEEE mcb_pmsm_foc_hall_f28379d_CM_single 0 0 -3.4E+38 3.4E+38 ECU_ADDRESS 0x0000E34A
 /begin IF_DATA XCP
  /begin DAQ_EVENT VARIABLE /begin DEFAULT_EVENT_LIST EVENT 0x0000 /end DEFAULT_EVENT_LIST /end DAQ_EVENT
 /end IF_DATA
/end MEASUREMENT
/begin MEASUREMENT mcb_pmsm_foc_hall_f28379d_B.SpeedControl.Equal1 "" UBYTE mcb_pmsm_foc_hall_f28379d_CM_logical 0 0 0 1 ECU_ADDRESS 0x0000E35A
 /begin IF_DATA XCP
  /begin DAQ_EVENT VARIABLE /begin DEFAULT_EVENT_LIST EVENT 0x0000 /end DEFAULT_EVENT_LIST /end DAQ_EVENT
 /end IF_DATA
/end MEASUREMENT
/begin MEASUREMENT mcb_pmsm_foc_hall_f28379d_B.SpeedControl.IProdOut "" FLOAT32_IEEE mcb_pmsm_foc_hall_f28379d_CM_single 0 0 -3.4E+38 3.4E+38 ECU_ADDRESS 0x0000E34C
 /begin IF_DATA XCP
  /begin DAQ_EVENT VARIABLE /begin DEFAULT_EVENT_LIST EVENT 0x0000 /end DEFAULT_EVENT_LIST /end DAQ_EVENT
 /end IF_DATA
/end MEASUREMENT
/begin MEASUREMENT mcb_pmsm_foc_hall_f28379d_B.SpeedControl.Id_ref "" FLOAT32_IEEE mcb_pmsm_foc_hall_f28379d_CM_single 0 0 -3.4E+38 3.4E+38 ECU_ADDRESS 0x0000E334
 /begin IF_DATA XCP
  /begin DAQ_EVENT VARIABLE /begin DEFAULT_EVENT_LIST EVENT 0x0000 /end DEFAULT_EVENT_LIST /end DAQ_EVENT
 /end IF_DATA
/end MEASUREMENT
/begin MEASUREMENT mcb_pmsm_foc_hall_f28379d_B.SpeedControl.Integrator "" FLOAT32_IEEE mcb_pmsm_foc_hall_f28379d_CM_single 0 0 -3.4E+38 3.4E+38 ECU_ADDRESS 0x0000E346
 /begin IF_DATA XCP
  /begin DAQ_EVENT VARIABLE /begin DEFAULT_EVENT_LIST EVENT 0x0000 /end DEFAULT_EVENT_LIST /end DAQ_EVENT
 /end IF_DATA
/end MEASUREMENT
/begin MEASUREMENT mcb_pmsm_foc_hall_f28379d_B.SpeedControl.Ki2 "" FLOAT32_IEEE mcb_pmsm_foc_hall_f28379d_CM_single 0 0 -3.4E+38 3.4E+38 ECU_ADDRESS 0x0000E344
 /begin IF_DATA XCP
  /begin DAQ_EVENT VARIABLE /begin DEFAULT_EVENT_LIST EVENT 0x0000 /end DEFAULT_EVENT_LIST /end DAQ_EVENT
 /end IF_DATA
/end MEASUREMENT
/begin MEASUREMENT mcb_pmsm_foc_hall_f28379d_B.SpeedControl.LogicalOperator "" UBYTE mcb_pmsm_foc_hall_f28379d_CM_logical 0 0 0 1 ECU_ADDRESS 0x0000E356
 /begin IF_DATA XCP
  /begin DAQ_EVENT VARIABLE /begin DEFAULT_EVENT_LIST EVENT 0x0000 /end DEFAULT_EVENT_LIST /end DAQ_EVENT
 /end IF_DATA
/end MEASUREMENT
/begin MEASUREMENT mcb_pmsm_foc_hall_f28379d_B.SpeedControl.PProdOut "" FLOAT32_IEEE mcb_pmsm_foc_hall_f28379d_CM_single 0 0 -3.4E+38 3.4E+38 ECU_ADDRESS 0x0000E342
 /begin IF_DATA XCP
  /begin DAQ_EVENT VARIABLE /begin DEFAULT_EVENT_LIST EVENT 0x0000 /end DEFAULT_EVENT_LIST /end DAQ_EVENT
 /end IF_DATA
/end MEASUREMENT
/begin MEASUREMENT mcb_pmsm_foc_hall_f28379d_B.SpeedControl.Product "" FLOAT32_IEEE mcb_pmsm_foc_hall_f28379d_CM_single 0 0 -3.4E+38 3.4E+38 ECU_ADDRESS 0x0000E338
 /begin IF_DATA XCP
  /begin DAQ_EVENT VARIABLE /begin DEFAULT_EVENT_LIST EVENT 0x0000 /end DEFAULT_EVENT_LIST /end DAQ_EVENT
 /end IF_DATA
/end MEASUREMENT
/begin MEASUREMENT mcb_pmsm_foc_hall_f28379d_B.SpeedControl.Product1 "" FLOAT32_IEEE mcb_pmsm_foc_hall_f28379d_CM_single 0 0 -3.4E+38 3.4E+38 ECU_ADDRESS 0x0000E33C
 /begin IF_DATA XCP
  /begin DAQ_EVENT VARIABLE /begin DEFAULT_EVENT_LIST EVENT 0x0000 /end DEFAULT_EVENT_LIST /end DAQ_EVENT
 /end IF_DATA
/end MEASUREMENT
/begin MEASUREMENT mcb_pmsm_foc_hall_f28379d_B.SpeedControl.RelationalOperator "" UBYTE mcb_pmsm_foc_hall_f28379d_CM_logical 0 0 0 1 ECU_ADDRESS 0x0000E357
 /begin IF_DATA XCP
  /begin DAQ_EVENT VARIABLE /begin DEFAULT_EVENT_LIST EVENT 0x0000 /end DEFAULT_EVENT_LIST /end DAQ_EVENT
 /end IF_DATA
/end MEASUREMENT
/begin MEASUREMENT mcb_pmsm_foc_hall_f28379d_B.SpeedControl.Saturation "" FLOAT32_IEEE mcb_pmsm_foc_hall_f28379d_CM_single 0 0 -3.4E+38 3.4E+38 ECU_ADDRESS 0x0000E350
 /begin IF_DATA XCP
  /begin DAQ_EVENT VARIABLE /begin DEFAULT_EVENT_LIST EVENT 0x0000 /end DEFAULT_EVENT_LIST /end DAQ_EVENT
 /end IF_DATA
/end MEASUREMENT
/begin MEASUREMENT mcb_pmsm_foc_hall_f28379d_B.SpeedControl.Sum "" FLOAT32_IEEE mcb_pmsm_foc_hall_f28379d_CM_single 0 0 -3.4E+38 3.4E+38 ECU_ADDRESS 0x0000E340
 /begin IF_DATA XCP
  /begin DAQ_EVENT VARIABLE /begin DEFAULT_EVENT_LIST EVENT 0x0000 /end DEFAULT_EVENT_LIST /end DAQ_EVENT
 /end IF_DATA
/end MEASUREMENT
/begin MEASUREMENT mcb_pmsm_foc_hall_f28379d_B.SpeedControl.Sum_i "" FLOAT32_IEEE mcb_pmsm_foc_hall_f28379d_CM_single 0 0 -3.4E+38 3.4E+38 ECU_ADDRESS 0x0000E348
 /begin IF_DATA XCP
  /begin DAQ_EVENT VARIABLE /begin DEFAULT_EVENT_LIST EVENT 0x0000 /end DEFAULT_EVENT_LIST /end DAQ_EVENT
 /end IF_DATA
/end MEASUREMENT
/begin MEASUREMENT mcb_pmsm_foc_hall_f28379d_B.SpeedControl.Switch "" FLOAT32_IEEE mcb_pmsm_foc_hall_f28379d_CM_single 0 0 -3.4E+38 3.4E+38 ECU_ADDRESS 0x0000E336
 /begin IF_DATA XCP
  /begin DAQ_EVENT VARIABLE /begin DEFAULT_EVENT_LIST EVENT 0x0000 /end DEFAULT_EVENT_LIST /end DAQ_EVENT
 /end IF_DATA
/end MEASUREMENT
/begin MEASUREMENT mcb_pmsm_foc_hall_f28379d_B.SpeedControl.Switch1 "" SBYTE mcb_pmsm_foc_hall_f28379d_CM_int8 0 0 -128 127 ECU_ADDRESS 0x0000E352
 /begin IF_DATA XCP
  /begin DAQ_EVENT VARIABLE /begin DEFAULT_EVENT_LIST EVENT 0x0000 /end DEFAULT_EVENT_LIST /end DAQ_EVENT
 /end IF_DATA
/end MEASUREMENT
/begin MEASUREMENT mcb_pmsm_foc_hall_f28379d_B.SpeedControl.Switch2 "" SBYTE mcb_pmsm_foc_hall_f28379d_CM_int8 0 0 -128 127 ECU_ADDRESS 0x0000E353
 /begin IF_DATA XCP
  /begin DAQ_EVENT VARIABLE /begin DEFAULT_EVENT_LIST EVENT 0x0000 /end DEFAULT_EVENT_LIST /end DAQ_EVENT
 /end IF_DATA
/end MEASUREMENT
/begin MEASUREMENT mcb_pmsm_foc_hall_f28379d_B.SpeedControl.Switch_b "" FLOAT32_IEEE mcb_pmsm_foc_hall_f28379d_CM_single 0 0 -3.4E+38 3.4E+38 ECU_ADDRESS 0x0000E34E
 /begin IF_DATA XCP
  /begin DAQ_EVENT VARIABLE /begin DEFAULT_EVENT_LIST EVENT 0x0000 /end DEFAULT_EVENT_LIST /end DAQ_EVENT
 /end IF_DATA
/end MEASUREMENT
/begin MEASUREMENT mcb_pmsm_foc_hall_f28379d_B.SpeedControl.UnitDelay "" FLOAT32_IEEE mcb_pmsm_foc_hall_f28379d_CM_single 0 0 -3.4E+38 3.4E+38 ECU_ADDRESS 0x0000E33A
 /begin IF_DATA XCP
  /begin DAQ_EVENT VARIABLE /begin DEFAULT_EVENT_LIST EVENT 0x0000 /end DEFAULT_EVENT_LIST /end DAQ_EVENT
 /end IF_DATA
/end MEASUREMENT
/begin MEASUREMENT mcb_pmsm_foc_hall_f28379d_B.SpeedControl.fixforDTpropagationissue "" UBYTE mcb_pmsm_foc_hall_f28379d_CM_logical 0 0 0 1 ECU_ADDRESS 0x0000E358
 /begin IF_DATA XCP
  /begin DAQ_EVENT VARIABLE /begin DEFAULT_EVENT_LIST EVENT 0x0000 /end DEFAULT_EVENT_LIST /end DAQ_EVENT
 /end IF_DATA
/end MEASUREMENT
/begin MEASUREMENT mcb_pmsm_foc_hall_f28379d_B.SpeedControl.fixforDTpropagationissue1 "" UBYTE mcb_pmsm_foc_hall_f28379d_CM_logical 0 0 0 1 ECU_ADDRESS 0x0000E359
 /begin IF_DATA XCP
  /begin DAQ_EVENT VARIABLE /begin DEFAULT_EVENT_LIST EVENT 0x0000 /end DEFAULT_EVENT_LIST /end DAQ_EVENT
 /end IF_DATA
/end MEASUREMENT
/begin MEASUREMENT mcb_pmsm_foc_hall_f28379d_B.SpeedGain "" FLOAT32_IEEE mcb_pmsm_foc_hall_f28379d_CM_single 0 0 -3.4E+38 3.4E+38 ECU_ADDRESS 0x0000E24A /end MEASUREMENT
/begin MEASUREMENT mcb_pmsm_foc_hall_f28379d_B.Speed_PU "" FLOAT32_IEEE mcb_pmsm_foc_hall_f28379d_CM_single 0 0 -3.4E+38 3.4E+38 ECU_ADDRESS 0x0000E218 /end MEASUREMENT
/begin MEASUREMENT mcb_pmsm_foc_hall_f28379d_B.Sqrt "" FLOAT32_IEEE mcb_pmsm_foc_hall_f28379d_CM_single 0 0 -3.4E+38 3.4E+38 ECU_ADDRESS 0x0000E2B4 /end MEASUREMENT
/begin MEASUREMENT mcb_pmsm_foc_hall_f28379d_B.SquareRoot "" FLOAT32_IEEE mcb_pmsm_foc_hall_f28379d_CM_single 0 0 -3.4E+38 3.4E+38 ECU_ADDRESS 0x0000E29A /end MEASUREMENT
/begin MEASUREMENT mcb_pmsm_foc_hall_f28379d_B.Sum "" ULONG mcb_pmsm_foc_hall_f28379d_CM_uint32 0 0 0 4294967295 ARRAY_SIZE 4 ECU_ADDRESS 0x0000E11E /end MEASUREMENT
/begin MEASUREMENT mcb_pmsm_foc_hall_f28379d_B.Sum1 "" FLOAT32_IEEE mcb_pmsm_foc_hall_f28379d_CM_single 0 0 -3.4E+38 3.4E+38 ECU_ADDRESS 0x0000E1E6 /end MEASUREMENT
/begin MEASUREMENT mcb_pmsm_foc_hall_f28379d_B.Sum1_i "" FLOAT32_IEEE mcb_pmsm_foc_hall_f28379d_CM_single 0 0 -3.4E+38 3.4E+38 ECU_ADDRESS 0x0000E266 /end MEASUREMENT
/begin MEASUREMENT mcb_pmsm_foc_hall_f28379d_B.Sum1_j "" UWORD mcb_pmsm_foc_hall_f28379d_CM_uint16 0 0 0 65535 ECU_ADDRESS 0x0000E2D3 /end MEASUREMENT
/begin MEASUREMENT mcb_pmsm_foc_hall_f28379d_B.Sum2 "" FLOAT32_IEEE mcb_pmsm_foc_hall_f28379d_CM_single 0 0 -3.4E+38 3.4E+38 ECU_ADDRESS 0x0000E1BA /end MEASUREMENT
/begin MEASUREMENT mcb_pmsm_foc_hall_f28379d_B.Sum2_p "" FLOAT32_IEEE mcb_pmsm_foc_hall_f28379d_CM_single 0 0 -3.4E+38 3.4E+38 ECU_ADDRESS 0x0000E208 /end MEASUREMENT
/begin MEASUREMENT mcb_pmsm_foc_hall_f28379d_B.Sum3 "" FLOAT32_IEEE mcb_pmsm_foc_hall_f28379d_CM_single 0 0 -3.4E+38 3.4E+38 ECU_ADDRESS 0x0000E1B6 /end MEASUREMENT
/begin MEASUREMENT mcb_pmsm_foc_hall_f28379d_B.Sum3_c "" FLOAT32_IEEE mcb_pmsm_foc_hall_f28379d_CM_single 0 0 -3.4E+38 3.4E+38 ECU_ADDRESS 0x0000E206 /end MEASUREMENT
/begin MEASUREMENT mcb_pmsm_foc_hall_f28379d_B.Sum4 "" FLOAT32_IEEE mcb_pmsm_foc_hall_f28379d_CM_single 0 0 -3.4E+38 3.4E+38 ECU_ADDRESS 0x0000E1BE /end MEASUREMENT
/begin MEASUREMENT mcb_pmsm_foc_hall_f28379d_B.Sum4_j "" FLOAT32_IEEE mcb_pmsm_foc_hall_f28379d_CM_single 0 0 -3.4E+38 3.4E+38 ECU_ADDRESS 0x0000E210 /end MEASUREMENT
/begin MEASUREMENT mcb_pmsm_foc_hall_f28379d_B.Sum5 "" FLOAT32_IEEE mcb_pmsm_foc_hall_f28379d_CM_single 0 0 -3.4E+38 3.4E+38 ECU_ADDRESS 0x0000E1C0 /end MEASUREMENT
/begin MEASUREMENT mcb_pmsm_foc_hall_f28379d_B.Sum5_k "" FLOAT32_IEEE mcb_pmsm_foc_hall_f28379d_CM_single 0 0 -3.4E+38 3.4E+38 ECU_ADDRESS 0x0000E20C /end MEASUREMENT
/begin MEASUREMENT mcb_pmsm_foc_hall_f28379d_B.Sum6 "" FLOAT32_IEEE mcb_pmsm_foc_hall_f28379d_CM_single 0 0 -3.4E+38 3.4E+38 ECU_ADDRESS 0x0000E1C4 /end MEASUREMENT
/begin MEASUREMENT mcb_pmsm_foc_hall_f28379d_B.Sum6_e "" FLOAT32_IEEE mcb_pmsm_foc_hall_f28379d_CM_single 0 0 -3.4E+38 3.4E+38 ECU_ADDRESS 0x0000E212 /end MEASUREMENT
/begin MEASUREMENT mcb_pmsm_foc_hall_f28379d_B.Sum_b "" FLOAT32_IEEE mcb_pmsm_foc_hall_f28379d_CM_single 0 0 -3.4E+38 3.4E+38 ECU_ADDRESS 0x0000E1D2 /end MEASUREMENT
/begin MEASUREMENT mcb_pmsm_foc_hall_f28379d_B.Sum_g "" FLOAT32_IEEE mcb_pmsm_foc_hall_f28379d_CM_single 0 0 -3.4E+38 3.4E+38 ECU_ADDRESS 0x0000E1C6 /end MEASUREMENT
/begin MEASUREMENT mcb_pmsm_foc_hall_f28379d_B.Sum_h "" FLOAT32_IEEE mcb_pmsm_foc_hall_f28379d_CM_single 0 0 -3.4E+38 3.4E+38 ECU_ADDRESS 0x0000E1DA /end MEASUREMENT
/begin MEASUREMENT mcb_pmsm_foc_hall_f28379d_B.Sum_i "" UWORD mcb_pmsm_foc_hall_f28379d_CM_uint16 0 0 0 65535 ECU_ADDRESS 0x0000E2D1 /end MEASUREMENT
/begin MEASUREMENT mcb_pmsm_foc_hall_f28379d_B.Sum_k "" ULONG mcb_pmsm_foc_hall_f28379d_CM_uint32 0 0 0 4294967295 ARRAY_SIZE 4 ECU_ADDRESS 0x0000E126 /end MEASUREMENT
/begin MEASUREMENT mcb_pmsm_foc_hall_f28379d_B.Sum_m "" FLOAT32_IEEE mcb_pmsm_foc_hall_f28379d_CM_single 0 0 -3.4E+38 3.4E+38 ECU_ADDRESS 0x0000E1CE /end MEASUREMENT
/begin MEASUREMENT mcb_pmsm_foc_hall_f28379d_B.Sum_m3 "" UWORD mcb_pmsm_foc_hall_f28379d_CM_uint16 0 0 0 65535 ECU_ADDRESS 0x0000E2E8 /end MEASUREMENT
/begin MEASUREMENT mcb_pmsm_foc_hall_f28379d_B.Sum_n "" FLOAT32_IEEE mcb_pmsm_foc_hall_f28379d_CM_single 0 0 -3.4E+38 3.4E+38 ECU_ADDRESS 0x0000E262 /end MEASUREMENT
/begin MEASUREMENT mcb_pmsm_foc_hall_f28379d_B.Sum_nl "" FLOAT32_IEEE mcb_pmsm_foc_hall_f28379d_CM_single 0 0 -3.4E+38 3.4E+38 ECU_ADDRESS 0x0000E2A8 /end MEASUREMENT
/begin MEASUREMENT mcb_pmsm_foc_hall_f28379d_B.Switch "" ULONG mcb_pmsm_foc_hall_f28379d_CM_uint32 0 0 0 4294967295 ECU_ADDRESS 0x0000E0EA /end MEASUREMENT
/begin MEASUREMENT mcb_pmsm_foc_hall_f28379d_B.Switch1 "" FLOAT32_IEEE mcb_pmsm_foc_hall_f28379d_CM_single 0 0 -3.4E+38 3.4E+38 ECU_ADDRESS 0x0000E2B2 /end MEASUREMENT
/begin MEASUREMENT mcb_pmsm_foc_hall_f28379d_B.Switch1_f "" UWORD mcb_pmsm_foc_hall_f28379d_CM_uint16 0 0 0 65535 ARRAY_SIZE 3 ECU_ADDRESS 0x0000E2F2 /end MEASUREMENT
/begin MEASUREMENT mcb_pmsm_foc_hall_f28379d_B.Switch1_i "" SBYTE mcb_pmsm_foc_hall_f28379d_CM_int8 0 0 -128 127 ECU_ADDRESS 0x0000E305 /end MEASUREMENT
/begin MEASUREMENT mcb_pmsm_foc_hall_f28379d_B.Switch1_j "" SBYTE mcb_pmsm_foc_hall_f28379d_CM_int8 0 0 -128 127 ECU_ADDRESS 0x0000E307 /end MEASUREMENT
/begin MEASUREMENT mcb_pmsm_foc_hall_f28379d_B.Switch1_o "" UWORD mcb_pmsm_foc_hall_f28379d_CM_uint16 0 0 0 65535 ECU_ADDRESS 0x0000E2ED /end MEASUREMENT
/begin MEASUREMENT mcb_pmsm_foc_hall_f28379d_B.Switch2 "" FLOAT32_IEEE mcb_pmsm_foc_hall_f28379d_CM_single 0 0 -3.4E+38 3.4E+38 ECU_ADDRESS 0x0000E2A4 /end MEASUREMENT
/begin MEASUREMENT mcb_pmsm_foc_hall_f28379d_B.Switch2_a "" SBYTE mcb_pmsm_foc_hall_f28379d_CM_int8 0 0 -128 127 ECU_ADDRESS 0x0000E306 /end MEASUREMENT
/begin MEASUREMENT mcb_pmsm_foc_hall_f28379d_B.Switch2_b "" SBYTE mcb_pmsm_foc_hall_f28379d_CM_int8 0 0 -128 127 ECU_ADDRESS 0x0000E308 /end MEASUREMENT
/begin MEASUREMENT mcb_pmsm_foc_hall_f28379d_B.Switch_a "" UWORD mcb_pmsm_foc_hall_f28379d_CM_uint16 0 0 0 65535 ECU_ADDRESS 0x0000E2E4 /end MEASUREMENT
/begin MEASUREMENT mcb_pmsm_foc_hall_f28379d_B.Switch_b "" FLOAT32_IEEE mcb_pmsm_foc_hall_f28379d_CM_single 0 0 -3.4E+38 3.4E+38 ECU_ADDRESS 0x0000E1F0 /end MEASUREMENT
/begin MEASUREMENT mcb_pmsm_foc_hall_f28379d_B.Switch_bt "" UBYTE mcb_pmsm_foc_hall_f28379d_CM_logical 0 0 0 1 ECU_ADDRESS 0x0000E309 /end MEASUREMENT
/begin MEASUREMENT mcb_pmsm_foc_hall_f28379d_B.Switch_c "" FLOAT32_IEEE mcb_pmsm_foc_hall_f28379d_CM_single 0 0 -3.4E+38 3.4E+38 ECU_ADDRESS 0x0000E2B0 /end MEASUREMENT
/begin MEASUREMENT mcb_pmsm_foc_hall_f28379d_B.Switch_e "" ULONG mcb_pmsm_foc_hall_f28379d_CM_uint32 0 0 0 4294967295 ECU_ADDRESS 0x0000E11A /end MEASUREMENT
/begin MEASUREMENT mcb_pmsm_foc_hall_f28379d_B.Switch_f "" FLOAT32_IEEE mcb_pmsm_foc_hall_f28379d_CM_single 0 0 -3.4E+38 3.4E+38 ECU_ADDRESS 0x0000E216 /end MEASUREMENT
/begin MEASUREMENT mcb_pmsm_foc_hall_f28379d_B.Switch_fd "" FLOAT32_IEEE mcb_pmsm_foc_hall_f28379d_CM_single 0 0 -3.4E+38 3.4E+38 ARRAY_SIZE 2 ECU_ADDRESS 0x0000E27A /end MEASUREMENT
/begin MEASUREMENT mcb_pmsm_foc_hall_f28379d_B.Switch_h "" FLOAT32_IEEE mcb_pmsm_foc_hall_f28379d_CM_single 0 0 -3.4E+38 3.4E+38 ECU_ADDRESS 0x0000E196 /end MEASUREMENT
/begin MEASUREMENT mcb_pmsm_foc_hall_f28379d_B.Switch_hp "" FLOAT32_IEEE mcb_pmsm_foc_hall_f28379d_CM_single 0 0 -3.4E+38 3.4E+38 ARRAY_SIZE 2 ECU_ADDRESS 0x0000E2A0 /end MEASUREMENT
/begin MEASUREMENT mcb_pmsm_foc_hall_f28379d_B.Switch_j "" FLOAT32_IEEE mcb_pmsm_foc_hall_f28379d_CM_single 0 0 -3.4E+38 3.4E+38 ECU_ADDRESS 0x0000E1DE /end MEASUREMENT
/begin MEASUREMENT mcb_pmsm_foc_hall_f28379d_B.Switch_k "" FLOAT32_IEEE mcb_pmsm_foc_hall_f28379d_CM_single 0 0 -3.4E+38 3.4E+38 ARRAY_SIZE 2 ECU_ADDRESS 0x0000E28E /end MEASUREMENT
/begin MEASUREMENT mcb_pmsm_foc_hall_f28379d_B.Switch_l "" ULONG mcb_pmsm_foc_hall_f28379d_CM_uint32 0 0 0 4294967295 ECU_ADDRESS 0x0000E102 /end MEASUREMENT
/begin MEASUREMENT mcb_pmsm_foc_hall_f28379d_B.Switch_ls "" FLOAT32_IEEE mcb_pmsm_foc_hall_f28379d_CM_single 0 0 -3.4E+38 3.4E+38 ECU_ADDRESS 0x0000E1F6 /end MEASUREMENT
/begin MEASUREMENT mcb_pmsm_foc_hall_f28379d_B.Switch_m "" UWORD mcb_pmsm_foc_hall_f28379d_CM_uint16 0 0 0 65535 ECU_ADDRESS 0x0000E2E5 /end MEASUREMENT
/begin MEASUREMENT mcb_pmsm_foc_hall_f28379d_B.Switch_o "" FLOAT32_IEEE mcb_pmsm_foc_hall_f28379d_CM_single 0 0 -3.4E+38 3.4E+38 ECU_ADDRESS 0x0000E29C /end MEASUREMENT
/begin MEASUREMENT mcb_pmsm_foc_hall_f28379d_B.T "" FLOAT32_IEEE mcb_pmsm_foc_hall_f28379d_CM_single 0 0 -3.4E+38 3.4E+38 ECU_ADDRESS 0x0000E186
 /begin IF_DATA XCP
  /begin DAQ_EVENT VARIABLE /begin DEFAULT_EVENT_LIST EVENT 0x0001 /end DEFAULT_EVENT_LIST /end DAQ_EVENT
 /end IF_DATA
/end MEASUREMENT
/begin MEASUREMENT mcb_pmsm_foc_hall_f28379d_B.UnitDelay "" ULONG mcb_pmsm_foc_hall_f28379d_CM_uint32 0 0 0 4294967295 ECU_ADDRESS 0x0000E132 /end MEASUREMENT
/begin MEASUREMENT mcb_pmsm_foc_hall_f28379d_B.UpperRelop "" UBYTE mcb_pmsm_foc_hall_f28379d_CM_logical 0 0 0 1 ECU_ADDRESS 0x0000E332 /end MEASUREMENT
/begin MEASUREMENT mcb_pmsm_foc_hall_f28379d_B.ValidHalls.Merge "" UWORD mcb_pmsm_foc_hall_f28379d_CM_uint16 0 0 0 65535 ECU_ADDRESS 0x0000E368 /end MEASUREMENT
/begin MEASUREMENT mcb_pmsm_foc_hall_f28379d_B.ValidHalls.Merge1 "" UWORD mcb_pmsm_foc_hall_f28379d_CM_uint16 0 0 0 65535 ECU_ADDRESS 0x0000E369 /end MEASUREMENT
/begin MEASUREMENT mcb_pmsm_foc_hall_f28379d_B.ValidHalls.Merge2 "" SWORD mcb_pmsm_foc_hall_f28379d_CM_int16 0 0 -32768 32767 ECU_ADDRESS 0x0000E36B /end MEASUREMENT
/begin MEASUREMENT mcb_pmsm_foc_hall_f28379d_B.ValidHalls.Merge3 "" UWORD mcb_pmsm_foc_hall_f28379d_CM_uint16 0 0 0 65535 ECU_ADDRESS 0x0000E36A /end MEASUREMENT
/begin MEASUREMENT mcb_pmsm_foc_hall_f28379d_B.ValidHalls.RelationalOperator "" UBYTE mcb_pmsm_foc_hall_f28379d_CM_logical 0 0 0 1 ECU_ADDRESS 0x0000E36C /end MEASUREMENT
/begin MEASUREMENT mcb_pmsm_foc_hall_f28379d_B.ValidHalls_h.Merge "" UWORD mcb_pmsm_foc_hall_f28379d_CM_uint16 0 0 0 65535 ECU_ADDRESS 0x0000E363 /end MEASUREMENT
/begin MEASUREMENT mcb_pmsm_foc_hall_f28379d_B.ValidHalls_h.Merge1 "" UWORD mcb_pmsm_foc_hall_f28379d_CM_uint16 0 0 0 65535 ECU_ADDRESS 0x0000E364 /end MEASUREMENT
/begin MEASUREMENT mcb_pmsm_foc_hall_f28379d_B.ValidHalls_h.Merge2 "" SWORD mcb_pmsm_foc_hall_f28379d_CM_int16 0 0 -32768 32767 ECU_ADDRESS 0x0000E366 /end MEASUREMENT
/begin MEASUREMENT mcb_pmsm_foc_hall_f28379d_B.ValidHalls_h.Merge3 "" UWORD mcb_pmsm_foc_hall_f28379d_CM_uint16 0 0 0 65535 ECU_ADDRESS 0x0000E365 /end MEASUREMENT
/begin MEASUREMENT mcb_pmsm_foc_hall_f28379d_B.ValidHalls_h.RelationalOperator "" UBYTE mcb_pmsm_foc_hall_f28379d_CM_logical 0 0 0 1 ECU_ADDRESS 0x0000E367 /end MEASUREMENT
/begin MEASUREMENT mcb_pmsm_foc_hall_f28379d_B.ValidHalls_hi.Merge "" UWORD mcb_pmsm_foc_hall_f28379d_CM_uint16 0 0 0 65535 ECU_ADDRESS 0x0000E35E /end MEASUREMENT
/begin MEASUREMENT mcb_pmsm_foc_hall_f28379d_B.ValidHalls_hi.Merge1 "" UWORD mcb_pmsm_foc_hall_f28379d_CM_uint16 0 0 0 65535 ECU_ADDRESS 0x0000E35F /end MEASUREMENT
/begin MEASUREMENT mcb_pmsm_foc_hall_f28379d_B.ValidHalls_hi.Merge2 "" SWORD mcb_pmsm_foc_hall_f28379d_CM_int16 0 0 -32768 32767 ECU_ADDRESS 0x0000E361 /end MEASUREMENT
/begin MEASUREMENT mcb_pmsm_foc_hall_f28379d_B.ValidHalls_hi.Merge3 "" UWORD mcb_pmsm_foc_hall_f28379d_CM_uint16 0 0 0 65535 ECU_ADDRESS 0x0000E360 /end MEASUREMENT
/begin MEASUREMENT mcb_pmsm_foc_hall_f28379d_B.ValidHalls_hi.RelationalOperator "" UBYTE mcb_pmsm_foc_hall_f28379d_CM_logical 0 0 0 1 ECU_ADDRESS 0x0000E362 /end MEASUREMENT
/begin MEASUREMENT mcb_pmsm_foc_hall_f28379d_B.a_plus_2b "" FLOAT32_IEEE mcb_pmsm_foc_hall_f28379d_CM_single 0 0 -3.4E+38 3.4E+38 ECU_ADDRESS 0x0000E2B8 /end MEASUREMENT
/begin MEASUREMENT mcb_pmsm_foc_hall_f28379d_B.acos_e "" FLOAT32_IEEE mcb_pmsm_foc_hall_f28379d_CM_single 0 0 -3.4E+38 3.4E+38 ECU_ADDRESS 0x0000E26E /end MEASUREMENT
/begin MEASUREMENT mcb_pmsm_foc_hall_f28379d_B.add_b "" FLOAT32_IEEE mcb_pmsm_foc_hall_f28379d_CM_single 0 0 -3.4E+38 3.4E+38 ECU_ADDRESS 0x0000E224 /end MEASUREMENT
/begin MEASUREMENT mcb_pmsm_foc_hall_f28379d_B.add_c "" FLOAT32_IEEE mcb_pmsm_foc_hall_f28379d_CM_single 0 0 -3.4E+38 3.4E+38 ECU_ADDRESS 0x0000E222 /end MEASUREMENT
/begin MEASUREMENT mcb_pmsm_foc_hall_f28379d_B.algDD_o1 "" FLOAT32_IEEE mcb_pmsm_foc_hall_f28379d_CM_single 0 0 -3.4E+38 3.4E+38 ECU_ADDRESS 0x0000E27E /end MEASUREMENT
/begin MEASUREMENT mcb_pmsm_foc_hall_f28379d_B.algDD_o1_a "" FLOAT32_IEEE mcb_pmsm_foc_hall_f28379d_CM_single 0 0 -3.4E+38 3.4E+38 ECU_ADDRESS 0x0000E2BC /end MEASUREMENT
/begin MEASUREMENT mcb_pmsm_foc_hall_f28379d_B.algDD_o1_c "" FLOAT32_IEEE mcb_pmsm_foc_hall_f28379d_CM_single 0 0 -3.4E+38 3.4E+38 ECU_ADDRESS 0x0000E292 /end MEASUREMENT
/begin MEASUREMENT mcb_pmsm_foc_hall_f28379d_B.algDD_o2 "" FLOAT32_IEEE mcb_pmsm_foc_hall_f28379d_CM_single 0 0 -3.4E+38 3.4E+38 ECU_ADDRESS 0x0000E280 /end MEASUREMENT
/begin MEASUREMENT mcb_pmsm_foc_hall_f28379d_B.algDD_o2_e "" FLOAT32_IEEE mcb_pmsm_foc_hall_f28379d_CM_single 0 0 -3.4E+38 3.4E+38 ECU_ADDRESS 0x0000E294 /end MEASUREMENT
/begin MEASUREMENT mcb_pmsm_foc_hall_f28379d_B.algDD_o2_n "" FLOAT32_IEEE mcb_pmsm_foc_hall_f28379d_CM_single 0 0 -3.4E+38 3.4E+38 ECU_ADDRESS 0x0000E2BE /end MEASUREMENT
/begin MEASUREMENT mcb_pmsm_foc_hall_f28379d_B.asin_j "" FLOAT32_IEEE mcb_pmsm_foc_hall_f28379d_CM_single 0 0 -3.4E+38 3.4E+38 ECU_ADDRESS 0x0000E276 /end MEASUREMENT
/begin MEASUREMENT mcb_pmsm_foc_hall_f28379d_B.bcos "" FLOAT32_IEEE mcb_pmsm_foc_hall_f28379d_CM_single 0 0 -3.4E+38 3.4E+38 ECU_ADDRESS 0x0000E274 /end MEASUREMENT
/begin MEASUREMENT mcb_pmsm_foc_hall_f28379d_B.bsin "" FLOAT32_IEEE mcb_pmsm_foc_hall_f28379d_CM_single 0 0 -3.4E+38 3.4E+38 ECU_ADDRESS 0x0000E270 /end MEASUREMENT
/begin MEASUREMENT mcb_pmsm_foc_hall_f28379d_B.countData "" FLOAT32_IEEE mcb_pmsm_foc_hall_f28379d_CM_single 0 0 -3.4E+38 3.4E+38 ECU_ADDRESS 0x0000E252 /end MEASUREMENT
/begin MEASUREMENT mcb_pmsm_foc_hall_f28379d_B.countData_o "" FLOAT32_IEEE mcb_pmsm_foc_hall_f28379d_CM_single 0 0 -3.4E+38 3.4E+38 ECU_ADDRESS 0x0000E258 /end MEASUREMENT
/begin MEASUREMENT mcb_pmsm_foc_hall_f28379d_B.currentSpeedData "" FLOAT32_IEEE mcb_pmsm_foc_hall_f28379d_CM_single 0 0 -3.4E+38 3.4E+38 ECU_ADDRESS 0x0000E246 /end MEASUREMENT
/begin MEASUREMENT mcb_pmsm_foc_hall_f28379d_B.currentSpeedData_k "" FLOAT32_IEEE mcb_pmsm_foc_hall_f28379d_CM_single 0 0 -3.4E+38 3.4E+38 ECU_ADDRESS 0x0000E254 /end MEASUREMENT
/begin MEASUREMENT mcb_pmsm_foc_hall_f28379d_B.currentSpeedData_o "" FLOAT32_IEEE mcb_pmsm_foc_hall_f28379d_CM_single 0 0 -3.4E+38 3.4E+38 ECU_ADDRESS 0x0000E25E /end MEASUREMENT
/begin MEASUREMENT mcb_pmsm_foc_hall_f28379d_B.dcos "" FLOAT32_IEEE mcb_pmsm_foc_hall_f28379d_CM_single 0 0 -3.4E+38 3.4E+38 ECU_ADDRESS 0x0000E288 /end MEASUREMENT
/begin MEASUREMENT mcb_pmsm_foc_hall_f28379d_B.dsin "" FLOAT32_IEEE mcb_pmsm_foc_hall_f28379d_CM_single 0 0 -3.4E+38 3.4E+38 ECU_ADDRESS 0x0000E284 /end MEASUREMENT
/begin MEASUREMENT mcb_pmsm_foc_hall_f28379d_B.eCAP "" ULONG mcb_pmsm_foc_hall_f28379d_CM_uint32 0 0 0 4294967295 ARRAY_SIZE 2 ECU_ADDRESS 0x0000E0E6 /end MEASUREMENT
/begin MEASUREMENT mcb_pmsm_foc_hall_f28379d_B.eCAP_c "" ULONG mcb_pmsm_foc_hall_f28379d_CM_uint32 0 0 0 4294967295 ARRAY_SIZE 2 ECU_ADDRESS 0x0000E0FE /end MEASUREMENT
/begin MEASUREMENT mcb_pmsm_foc_hall_f28379d_B.eCAP_l "" ULONG mcb_pmsm_foc_hall_f28379d_CM_uint32 0 0 0 4294967295 ARRAY_SIZE 2 ECU_ADDRESS 0x0000E116 /end MEASUREMENT
/begin MEASUREMENT mcb_pmsm_foc_hall_f28379d_B.fixforDTpropagationissue "" UBYTE mcb_pmsm_foc_hall_f28379d_CM_logical 0 0 0 1 ECU_ADDRESS 0x0000E31F /end MEASUREMENT
/begin MEASUREMENT mcb_pmsm_foc_hall_f28379d_B.fixforDTpropagationissue1 "" UBYTE mcb_pmsm_foc_hall_f28379d_CM_logical 0 0 0 1 ECU_ADDRESS 0x0000E320 /end MEASUREMENT
/begin MEASUREMENT mcb_pmsm_foc_hall_f28379d_B.fixforDTpropagationissue1_h "" UBYTE mcb_pmsm_foc_hall_f28379d_CM_logical 0 0 0 1 ECU_ADDRESS 0x0000E325 /end MEASUREMENT
/begin MEASUREMENT mcb_pmsm_foc_hall_f28379d_B.fixforDTpropagationissue_b "" UBYTE mcb_pmsm_foc_hall_f28379d_CM_logical 0 0 0 1 ECU_ADDRESS 0x0000E324 /end MEASUREMENT
/begin MEASUREMENT mcb_pmsm_foc_hall_f28379d_B.indexing "" FLOAT32_IEEE mcb_pmsm_foc_hall_f28379d_CM_single 0 0 -3.4E+38 3.4E+38 ECU_ADDRESS 0x0000E1AC /end MEASUREMENT
/begin MEASUREMENT mcb_pmsm_foc_hall_f28379d_B.indexing_i "" FLOAT32_IEEE mcb_pmsm_foc_hall_f28379d_CM_single 0 0 -3.4E+38 3.4E+38 ECU_ADDRESS 0x0000E1FA /end MEASUREMENT
/begin MEASUREMENT mcb_pmsm_foc_hall_f28379d_B.one_by_sqrt3 "" FLOAT32_IEEE mcb_pmsm_foc_hall_f28379d_CM_single 0 0 -3.4E+38 3.4E+38 ECU_ADDRESS 0x0000E2BA /end MEASUREMENT
/begin MEASUREMENT mcb_pmsm_foc_hall_f28379d_B.one_by_two "" FLOAT32_IEEE mcb_pmsm_foc_hall_f28379d_CM_single 0 0 -3.4E+38 3.4E+38 ECU_ADDRESS 0x0000E220 /end MEASUREMENT
/begin MEASUREMENT mcb_pmsm_foc_hall_f28379d_B.one_by_two_b "" FLOAT32_IEEE mcb_pmsm_foc_hall_f28379d_CM_single 0 0 -3.4E+38 3.4E+38 ECU_ADDRESS 0x0000E22C /end MEASUREMENT
/begin MEASUREMENT mcb_pmsm_foc_hall_f28379d_B.previousSpeedData "" FLOAT32_IEEE mcb_pmsm_foc_hall_f28379d_CM_single 0 0 -3.4E+38 3.4E+38 ECU_ADDRESS 0x0000E25A /end MEASUREMENT
/begin MEASUREMENT mcb_pmsm_foc_hall_f28379d_B.qcos "" FLOAT32_IEEE mcb_pmsm_foc_hall_f28379d_CM_single 0 0 -3.4E+38 3.4E+38 ECU_ADDRESS 0x0000E282 /end MEASUREMENT
/begin MEASUREMENT mcb_pmsm_foc_hall_f28379d_B.qsin "" FLOAT32_IEEE mcb_pmsm_foc_hall_f28379d_CM_single 0 0 -3.4E+38 3.4E+38 ECU_ADDRESS 0x0000E28A /end MEASUREMENT
/begin MEASUREMENT mcb_pmsm_foc_hall_f28379d_B.speedCountDelay "" ULONG mcb_pmsm_foc_hall_f28379d_CM_uint32 0 0 0 4294967295 ECU_ADDRESS 0x0000E11C /end MEASUREMENT
/begin MEASUREMENT mcb_pmsm_foc_hall_f28379d_B.speedcheck "" UWORD mcb_pmsm_foc_hall_f28379d_CM_uint16 0 0 0 65535 ECU_ADDRESS 0x0000E2F8 /end MEASUREMENT
/begin MEASUREMENT mcb_pmsm_foc_hall_f28379d_B.sqrt3_by_two "" FLOAT32_IEEE mcb_pmsm_foc_hall_f28379d_CM_single 0 0 -3.4E+38 3.4E+38 ECU_ADDRESS 0x0000E21E /end MEASUREMENT
/begin MEASUREMENT mcb_pmsm_foc_hall_f28379d_B.sum_Ds "" FLOAT32_IEEE mcb_pmsm_foc_hall_f28379d_CM_single 0 0 -3.4E+38 3.4E+38 ECU_ADDRESS 0x0000E272 /end MEASUREMENT
/begin MEASUREMENT mcb_pmsm_foc_hall_f28379d_B.sum_Qs "" FLOAT32_IEEE mcb_pmsm_foc_hall_f28379d_CM_single 0 0 -3.4E+38 3.4E+38 ECU_ADDRESS 0x0000E278 /end MEASUREMENT
/begin MEASUREMENT mcb_pmsm_foc_hall_f28379d_B.sum_alpha "" FLOAT32_IEEE mcb_pmsm_foc_hall_f28379d_CM_single 0 0 -3.4E+38 3.4E+38 ECU_ADDRESS 0x0000E28C /end MEASUREMENT
/begin MEASUREMENT mcb_pmsm_foc_hall_f28379d_B.sum_beta "" FLOAT32_IEEE mcb_pmsm_foc_hall_f28379d_CM_single 0 0 -3.4E+38 3.4E+38 ECU_ADDRESS 0x0000E286 /end MEASUREMENT
/begin MEASUREMENT mcb_pmsm_foc_hall_f28379d_B.validityDelay "" UBYTE mcb_pmsm_foc_hall_f28379d_CM_logical 0 0 0 1 ECU_ADDRESS 0x0000E315 /end MEASUREMENT
/begin MEASUREMENT mcb_pmsm_foc_hall_f28379d_B.watchdogcheck "" UWORD mcb_pmsm_foc_hall_f28379d_CM_uint16 0 0 0 65535 ECU_ADDRESS 0x0000E2E7 /end MEASUREMENT
/begin MEASUREMENT mcb_pmsm_foc_hall_f28379d_DWork.Add_DWORK1 "" SLONG mcb_pmsm_foc_hall_f28379d_CM_int32 0 0 -2147483648 2147483647 ARRAY_SIZE 2 ECU_ADDRESS 0x0000E078 /end MEASUREMENT
/begin MEASUREMENT mcb_pmsm_foc_hall_f28379d_DWork.CANPack_ModeSignalID "" SWORD mcb_pmsm_foc_hall_f28379d_CM_int_T 0 0 -32768 32767 ECU_ADDRESS 0x0000E08A
 /begin IF_DATA XCP
  /begin DAQ_EVENT VARIABLE /begin DEFAULT_EVENT_LIST EVENT 0x0001 /end DEFAULT_EVENT_LIST /end DAQ_EVENT
 /end IF_DATA
/end MEASUREMENT
/begin MEASUREMENT mcb_pmsm_foc_hall_f28379d_DWork.DRV830xEnable_FRAC_LEN "" SLONG mcb_pmsm_foc_hall_f28379d_CM_int32 0 0 -2147483648 2147483647 ECU_ADDRESS 0x0000E076 /end MEASUREMENT
/begin MEASUREMENT mcb_pmsm_foc_hall_f28379d_DWork.Debug_signals "" UWORD mcb_pmsm_foc_hall_f28379d_CM_uint16 0 0 0 65535 ECU_ADDRESS 0x0000E09F /end MEASUREMENT
/begin MEASUREMENT mcb_pmsm_foc_hall_f28379d_DWork.DelayOneStep1_DSTATE "" UBYTE mcb_pmsm_foc_hall_f28379d_CM_logical 0 0 0 1 ECU_ADDRESS 0x0000E0A2 /end MEASUREMENT
/begin MEASUREMENT mcb_pmsm_foc_hall_f28379d_DWork.DelayOneStep_DSTATE "" UWORD mcb_pmsm_foc_hall_f28379d_CM_uint16 0 0 0 65535 ECU_ADDRESS 0x0000E08B /end MEASUREMENT
/begin MEASUREMENT mcb_pmsm_foc_hall_f28379d_DWork.DigitalOutput2_FRAC_LEN "" SLONG mcb_pmsm_foc_hall_f28379d_CM_int32 0 0 -2147483648 2147483647 ECU_ADDRESS 0x0000E074
 /begin IF_DATA XCP
  /begin DAQ_EVENT VARIABLE /begin DEFAULT_EVENT_LIST EVENT 0x0003 /end DEFAULT_EVENT_LIST /end DAQ_EVENT
 /end IF_DATA
/end MEASUREMENT
/begin MEASUREMENT mcb_pmsm_foc_hall_f28379d_DWork.Enable "" UBYTE mcb_pmsm_foc_hall_f28379d_CM_logical 0 0 0 1 ECU_ADDRESS 0x0000E0A5
 /begin IF_DATA XCP
  /begin DAQ_EVENT VARIABLE /begin DEFAULT_EVENT_LIST EVENT 0x0000 /end DEFAULT_EVENT_LIST /end DAQ_EVENT
 /end IF_DATA
/end MEASUREMENT
/begin MEASUREMENT mcb_pmsm_foc_hall_f28379d_DWork.GlobalDirection "" SWORD mcb_pmsm_foc_hall_f28379d_CM_int16 0 0 -32768 32767 ECU_ADDRESS 0x0000E09A
 /begin IF_DATA XCP
  /begin DAQ_EVENT VARIABLE /begin DEFAULT_EVENT_LIST EVENT 0x0000 /end DEFAULT_EVENT_LIST /end DAQ_EVENT
 /end IF_DATA
/end MEASUREMENT
/begin MEASUREMENT mcb_pmsm_foc_hall_f28379d_DWork.GlobalHallState "" ULONG mcb_pmsm_foc_hall_f28379d_CM_uint32 0 0 0 4294967295 ECU_ADDRESS 0x0000E080
 /begin IF_DATA XCP
  /begin DAQ_EVENT VARIABLE /begin DEFAULT_EVENT_LIST EVENT 0x0000 /end DEFAULT_EVENT_LIST /end DAQ_EVENT
 /end IF_DATA
/end MEASUREMENT
/begin MEASUREMENT mcb_pmsm_foc_hall_f28379d_DWork.GlobalSpeedCount "" ULONG mcb_pmsm_foc_hall_f28379d_CM_uint32 0 0 0 4294967295 ECU_ADDRESS 0x0000E07E
 /begin IF_DATA XCP
  /begin DAQ_EVENT VARIABLE /begin DEFAULT_EVENT_LIST EVENT 0x0000 /end DEFAULT_EVENT_LIST /end DAQ_EVENT
 /end IF_DATA
/end MEASUREMENT
/begin MEASUREMENT mcb_pmsm_foc_hall_f28379d_DWork.GlobalSpeedValidity "" UWORD mcb_pmsm_foc_hall_f28379d_CM_uint16 0 0 0 65535 ECU_ADDRESS 0x0000E09C
 /begin IF_DATA XCP
  /begin DAQ_EVENT VARIABLE /begin DEFAULT_EVENT_LIST EVENT 0x0000 /end DEFAULT_EVENT_LIST /end DAQ_EVENT
 /end IF_DATA
/end MEASUREMENT
/begin MEASUREMENT mcb_pmsm_foc_hall_f28379d_DWork.HallStateChangeFlag "" UWORD mcb_pmsm_foc_hall_f28379d_CM_uint16 0 0 0 65535 ECU_ADDRESS 0x0000E09B
 /begin IF_DATA XCP
  /begin DAQ_EVENT VARIABLE /begin DEFAULT_EVENT_LIST EVENT 0x0000 /end DEFAULT_EVENT_LIST /end DAQ_EVENT
 /end IF_DATA
/end MEASUREMENT
/begin MEASUREMENT mcb_pmsm_foc_hall_f28379d_DWork.IaOffset "" UWORD mcb_pmsm_foc_hall_f28379d_CM_uint16 0 0 0 65535 ECU_ADDRESS 0x0000E09D /end MEASUREMENT
/begin MEASUREMENT mcb_pmsm_foc_hall_f28379d_DWork.IbOffset "" UWORD mcb_pmsm_foc_hall_f28379d_CM_uint16 0 0 0 65535 ECU_ADDRESS 0x0000E09E /end MEASUREMENT
/begin MEASUREMENT mcb_pmsm_foc_hall_f28379d_DWork.Integrator_DSTATE "" FLOAT32_IEEE mcb_pmsm_foc_hall_f28379d_CM_single 0 0 -3.4E+38 3.4E+38 ECU_ADDRESS 0x0000E044 /end MEASUREMENT
/begin MEASUREMENT mcb_pmsm_foc_hall_f28379d_DWork.Integrator_DSTATE_j "" FLOAT32_IEEE mcb_pmsm_foc_hall_f28379d_CM_single 0 0 -3.4E+38 3.4E+38 ECU_ADDRESS 0x0000E046 /end MEASUREMENT
/begin MEASUREMENT mcb_pmsm_foc_hall_f28379d_DWork.Integrator_PrevResetState "" SBYTE mcb_pmsm_foc_hall_f28379d_CM_int8 0 0 -128 127 ECU_ADDRESS 0x0000E0A3 /end MEASUREMENT
/begin MEASUREMENT mcb_pmsm_foc_hall_f28379d_DWork.Integrator_PrevResetState_m "" SBYTE mcb_pmsm_foc_hall_f28379d_CM_int8 0 0 -128 127 ECU_ADDRESS 0x0000E0A4 /end MEASUREMENT
/begin MEASUREMENT mcb_pmsm_foc_hall_f28379d_DWork.InverterEnable_FRAC_LEN "" SLONG mcb_pmsm_foc_hall_f28379d_CM_int32 0 0 -2147483648 2147483647 ECU_ADDRESS 0x0000E07C /end MEASUREMENT
/begin MEASUREMENT mcb_pmsm_foc_hall_f28379d_DWork.Memory1_PreviousInput "" UWORD mcb_pmsm_foc_hall_f28379d_CM_uint16 0 0 0 65535 ECU_ADDRESS 0x0000E0A1 /end MEASUREMENT
/begin MEASUREMENT mcb_pmsm_foc_hall_f28379d_DWork.Memory_PreviousInput "" UWORD mcb_pmsm_foc_hall_f28379d_CM_uint16 0 0 0 65535 ECU_ADDRESS 0x0000E0A0 /end MEASUREMENT
/begin MEASUREMENT mcb_pmsm_foc_hall_f28379d_DWork.RT10_ActiveBufIdx "" SWORD mcb_pmsm_foc_hall_f28379d_CM_int16 0 0 -32768 32767 ECU_ADDRESS 0x0000E095
 /begin IF_DATA XCP
  /begin DAQ_EVENT VARIABLE /begin DEFAULT_EVENT_LIST EVENT 0x0001 /end DEFAULT_EVENT_LIST /end DAQ_EVENT
 /end IF_DATA
/end MEASUREMENT
/begin MEASUREMENT mcb_pmsm_foc_hall_f28379d_DWork.RT10_Buffer "" FLOAT32_IEEE mcb_pmsm_foc_hall_f28379d_CM_single 0 0 -3.4E+38 3.4E+38 ARRAY_SIZE 4 ECU_ADDRESS 0x0000E062
 /begin IF_DATA XCP
  /begin DAQ_EVENT VARIABLE /begin DEFAULT_EVENT_LIST EVENT 0x0001 /end DEFAULT_EVENT_LIST /end DAQ_EVENT
 /end IF_DATA
/end MEASUREMENT
/begin MEASUREMENT mcb_pmsm_foc_hall_f28379d_DWork.RT10_semaphoreTaken "" SWORD mcb_pmsm_foc_hall_f28379d_CM_int16 0 0 -32768 32767 ECU_ADDRESS 0x0000E096
 /begin IF_DATA XCP
  /begin DAQ_EVENT VARIABLE /begin DEFAULT_EVENT_LIST EVENT 0x0001 /end DEFAULT_EVENT_LIST /end DAQ_EVENT
 /end IF_DATA
/end MEASUREMENT
/begin MEASUREMENT mcb_pmsm_foc_hall_f28379d_DWork.RT11_ActiveBufIdx "" SWORD mcb_pmsm_foc_hall_f28379d_CM_int16 0 0 -32768 32767 ECU_ADDRESS 0x0000E097
 /begin IF_DATA XCP
  /begin DAQ_EVENT VARIABLE /begin DEFAULT_EVENT_LIST EVENT 0x0001 /end DEFAULT_EVENT_LIST /end DAQ_EVENT
 /end IF_DATA
/end MEASUREMENT
/begin MEASUREMENT mcb_pmsm_foc_hall_f28379d_DWork.RT11_Buffer "" FLOAT32_IEEE mcb_pmsm_foc_hall_f28379d_CM_single 0 0 -3.4E+38 3.4E+38 ARRAY_SIZE 4 ECU_ADDRESS 0x0000E06A
 /begin IF_DATA XCP
  /begin DAQ_EVENT VARIABLE /begin DEFAULT_EVENT_LIST EVENT 0x0001 /end DEFAULT_EVENT_LIST /end DAQ_EVENT
 /end IF_DATA
/end MEASUREMENT
/begin MEASUREMENT mcb_pmsm_foc_hall_f28379d_DWork.RT11_semaphoreTaken "" SWORD mcb_pmsm_foc_hall_f28379d_CM_int16 0 0 -32768 32767 ECU_ADDRESS 0x0000E098
 /begin IF_DATA XCP
  /begin DAQ_EVENT VARIABLE /begin DEFAULT_EVENT_LIST EVENT 0x0001 /end DEFAULT_EVENT_LIST /end DAQ_EVENT
 /end IF_DATA
/end MEASUREMENT
/begin MEASUREMENT mcb_pmsm_foc_hall_f28379d_DWork.RT12_ActiveBufIdx "" SWORD mcb_pmsm_foc_hall_f28379d_CM_int16 0 0 -32768 32767 ECU_ADDRESS 0x0000E099
 /begin IF_DATA XCP
  /begin DAQ_EVENT VARIABLE /begin DEFAULT_EVENT_LIST EVENT 0x0001 /end DEFAULT_EVENT_LIST /end DAQ_EVENT
 /end IF_DATA
/end MEASUREMENT
/begin MEASUREMENT mcb_pmsm_foc_hall_f28379d_DWork.RT12_Buffer "" FLOAT64_IEEE mcb_pmsm_foc_hall_f28379d_CM_double 0 0 -1.7E+308 1.7E+308 ARRAY_SIZE 2 ECU_ADDRESS 0x0000E040
 /begin IF_DATA XCP
  /begin DAQ_EVENT VARIABLE /begin DEFAULT_EVENT_LIST EVENT 0x0001 /end DEFAULT_EVENT_LIST /end DAQ_EVENT
 /end IF_DATA
/end MEASUREMENT
/begin MEASUREMENT mcb_pmsm_foc_hall_f28379d_DWork.RT1_ActiveBufIdx "" SWORD mcb_pmsm_foc_hall_f28379d_CM_int16 0 0 -32768 32767 ECU_ADDRESS 0x0000E08C
 /begin IF_DATA XCP
  /begin DAQ_EVENT VARIABLE /begin DEFAULT_EVENT_LIST EVENT 0x0000 /end DEFAULT_EVENT_LIST /end DAQ_EVENT
 /end IF_DATA
/end MEASUREMENT
/begin MEASUREMENT mcb_pmsm_foc_hall_f28379d_DWork.RT1_Buffer "" FLOAT32_IEEE mcb_pmsm_foc_hall_f28379d_CM_single 0 0 -3.4E+38 3.4E+38 ARRAY_SIZE 2 ECU_ADDRESS 0x0000E04A
 /begin IF_DATA XCP
  /begin DAQ_EVENT VARIABLE /begin DEFAULT_EVENT_LIST EVENT 0x0000 /end DEFAULT_EVENT_LIST /end DAQ_EVENT
 /end IF_DATA
/end MEASUREMENT
/begin MEASUREMENT mcb_pmsm_foc_hall_f28379d_DWork.RT1_semaphoreTaken "" SWORD mcb_pmsm_foc_hall_f28379d_CM_int16 0 0 -32768 32767 ECU_ADDRESS 0x0000E08D
 /begin IF_DATA XCP
  /begin DAQ_EVENT VARIABLE /begin DEFAULT_EVENT_LIST EVENT 0x0000 /end DEFAULT_EVENT_LIST /end DAQ_EVENT
 /end IF_DATA
/end MEASUREMENT
/begin MEASUREMENT mcb_pmsm_foc_hall_f28379d_DWork.RT2_ActiveBufIdx "" SWORD mcb_pmsm_foc_hall_f28379d_CM_int16 0 0 -32768 32767 ECU_ADDRESS 0x0000E090
 /begin IF_DATA XCP
  /begin DAQ_EVENT VARIABLE /begin DEFAULT_EVENT_LIST EVENT 0x0000 /end DEFAULT_EVENT_LIST /end DAQ_EVENT
 /end IF_DATA
/end MEASUREMENT
/begin MEASUREMENT mcb_pmsm_foc_hall_f28379d_DWork.RT2_Buffer "" FLOAT32_IEEE mcb_pmsm_foc_hall_f28379d_CM_single 0 0 -3.4E+38 3.4E+38 ARRAY_SIZE 4 ECU_ADDRESS 0x0000E052
 /begin IF_DATA XCP
  /begin DAQ_EVENT VARIABLE /begin DEFAULT_EVENT_LIST EVENT 0x0000 /end DEFAULT_EVENT_LIST /end DAQ_EVENT
 /end IF_DATA
/end MEASUREMENT
/begin MEASUREMENT mcb_pmsm_foc_hall_f28379d_DWork.RT6_ActiveBufIdx "" SWORD mcb_pmsm_foc_hall_f28379d_CM_int16 0 0 -32768 32767 ECU_ADDRESS 0x0000E08E
 /begin IF_DATA XCP
  /begin DAQ_EVENT VARIABLE /begin DEFAULT_EVENT_LIST EVENT 0x0000 /end DEFAULT_EVENT_LIST /end DAQ_EVENT
 /end IF_DATA
/end MEASUREMENT
/begin MEASUREMENT mcb_pmsm_foc_hall_f28379d_DWork.RT6_Buffer "" FLOAT32_IEEE mcb_pmsm_foc_hall_f28379d_CM_single 0 0 -3.4E+38 3.4E+38 ARRAY_SIZE 2 ECU_ADDRESS 0x0000E04E
 /begin IF_DATA XCP
  /begin DAQ_EVENT VARIABLE /begin DEFAULT_EVENT_LIST EVENT 0x0000 /end DEFAULT_EVENT_LIST /end DAQ_EVENT
 /end IF_DATA
/end MEASUREMENT
/begin MEASUREMENT mcb_pmsm_foc_hall_f28379d_DWork.RT6_semaphoreTaken "" SWORD mcb_pmsm_foc_hall_f28379d_CM_int16 0 0 -32768 32767 ECU_ADDRESS 0x0000E08F
 /begin IF_DATA XCP
  /begin DAQ_EVENT VARIABLE /begin DEFAULT_EVENT_LIST EVENT 0x0000 /end DEFAULT_EVENT_LIST /end DAQ_EVENT
 /end IF_DATA
/end MEASUREMENT
/begin MEASUREMENT mcb_pmsm_foc_hall_f28379d_DWork.RT8_ActiveBufIdx "" SWORD mcb_pmsm_foc_hall_f28379d_CM_int16 0 0 -32768 32767 ECU_ADDRESS 0x0000E091
 /begin IF_DATA XCP
  /begin DAQ_EVENT VARIABLE /begin DEFAULT_EVENT_LIST EVENT 0x0001 /end DEFAULT_EVENT_LIST /end DAQ_EVENT
 /end IF_DATA
/end MEASUREMENT
/begin MEASUREMENT mcb_pmsm_foc_hall_f28379d_DWork.RT8_Buffer "" FLOAT32_IEEE mcb_pmsm_foc_hall_f28379d_CM_single 0 0 -3.4E+38 3.4E+38 ARRAY_SIZE 2 ECU_ADDRESS 0x0000E05A
 /begin IF_DATA XCP
  /begin DAQ_EVENT VARIABLE /begin DEFAULT_EVENT_LIST EVENT 0x0001 /end DEFAULT_EVENT_LIST /end DAQ_EVENT
 /end IF_DATA
/end MEASUREMENT
/begin MEASUREMENT mcb_pmsm_foc_hall_f28379d_DWork.RT8_semaphoreTaken "" SWORD mcb_pmsm_foc_hall_f28379d_CM_int16 0 0 -32768 32767 ECU_ADDRESS 0x0000E092
 /begin IF_DATA XCP
  /begin DAQ_EVENT VARIABLE /begin DEFAULT_EVENT_LIST EVENT 0x0001 /end DEFAULT_EVENT_LIST /end DAQ_EVENT
 /end IF_DATA
/end MEASUREMENT
/begin MEASUREMENT mcb_pmsm_foc_hall_f28379d_DWork.RT9_ActiveBufIdx "" SWORD mcb_pmsm_foc_hall_f28379d_CM_int16 0 0 -32768 32767 ECU_ADDRESS 0x0000E093
 /begin IF_DATA XCP
  /begin DAQ_EVENT VARIABLE /begin DEFAULT_EVENT_LIST EVENT 0x0001 /end DEFAULT_EVENT_LIST /end DAQ_EVENT
 /end IF_DATA
/end MEASUREMENT
/begin MEASUREMENT mcb_pmsm_foc_hall_f28379d_DWork.RT9_Buffer "" FLOAT32_IEEE mcb_pmsm_foc_hall_f28379d_CM_single 0 0 -3.4E+38 3.4E+38 ARRAY_SIZE 2 ECU_ADDRESS 0x0000E05E
 /begin IF_DATA XCP
  /begin DAQ_EVENT VARIABLE /begin DEFAULT_EVENT_LIST EVENT 0x0001 /end DEFAULT_EVENT_LIST /end DAQ_EVENT
 /end IF_DATA
/end MEASUREMENT
/begin MEASUREMENT mcb_pmsm_foc_hall_f28379d_DWork.RT9_semaphoreTaken "" SWORD mcb_pmsm_foc_hall_f28379d_CM_int16 0 0 -32768 32767 ECU_ADDRESS 0x0000E094
 /begin IF_DATA XCP
  /begin DAQ_EVENT VARIABLE /begin DEFAULT_EVENT_LIST EVENT 0x0001 /end DEFAULT_EVENT_LIST /end DAQ_EVENT
 /end IF_DATA
/end MEASUREMENT
/begin MEASUREMENT mcb_pmsm_foc_hall_f28379d_DWork.SPIMasterTransfer2.objisempty "" UBYTE mcb_pmsm_foc_hall_f28379d_CM_logical 0 0 0 1 ECU_ADDRESS 0x0000E0BE /end MEASUREMENT
/begin MEASUREMENT mcb_pmsm_foc_hall_f28379d_DWork.SPIMasterTransfer3.objisempty "" UBYTE mcb_pmsm_foc_hall_f28379d_CM_logical 0 0 0 1 ECU_ADDRESS 0x0000E0B4 /end MEASUREMENT
/begin MEASUREMENT mcb_pmsm_foc_hall_f28379d_DWork.SpeedControl.Integrator_DSTATE "" FLOAT32_IEEE mcb_pmsm_foc_hall_f28379d_CM_single 0 0 -3.4E+38 3.4E+38 ECU_ADDRESS 0x0000E0A8
 /begin IF_DATA XCP
  /begin DAQ_EVENT VARIABLE /begin DEFAULT_EVENT_LIST EVENT 0x0000 /end DEFAULT_EVENT_LIST /end DAQ_EVENT
 /end IF_DATA
/end MEASUREMENT
/begin MEASUREMENT mcb_pmsm_foc_hall_f28379d_DWork.SpeedControl.Integrator_PrevResetState "" SBYTE mcb_pmsm_foc_hall_f28379d_CM_int8 0 0 -128 127 ECU_ADDRESS 0x0000E0AA
 /begin IF_DATA XCP
  /begin DAQ_EVENT VARIABLE /begin DEFAULT_EVENT_LIST EVENT 0x0000 /end DEFAULT_EVENT_LIST /end DAQ_EVENT
 /end IF_DATA
/end MEASUREMENT
/begin MEASUREMENT mcb_pmsm_foc_hall_f28379d_DWork.SpeedControl.UnitDelay_DSTATE "" FLOAT32_IEEE mcb_pmsm_foc_hall_f28379d_CM_single 0 0 -3.4E+38 3.4E+38 ECU_ADDRESS 0x0000E0A6
 /begin IF_DATA XCP
  /begin DAQ_EVENT VARIABLE /begin DEFAULT_EVENT_LIST EVENT 0x0000 /end DEFAULT_EVENT_LIST /end DAQ_EVENT
 /end IF_DATA
/end MEASUREMENT
/begin MEASUREMENT mcb_pmsm_foc_hall_f28379d_DWork.Speed_ref "" FLOAT32_IEEE mcb_pmsm_foc_hall_f28379d_CM_single 0 0 -3.4E+38 3.4E+38 ECU_ADDRESS 0x0000E072 /end MEASUREMENT
/begin MEASUREMENT mcb_pmsm_foc_hall_f28379d_DWork.Sum_DWORK1 "" ULONG mcb_pmsm_foc_hall_f28379d_CM_uint32 0 0 0 4294967295 ARRAY_SIZE 4 ECU_ADDRESS 0x0000E082 /end MEASUREMENT
/begin MEASUREMENT mcb_pmsm_foc_hall_f28379d_DWork.UnitDelay_DSTATE "" ULONG mcb_pmsm_foc_hall_f28379d_CM_uint32 0 0 0 4294967295 ECU_ADDRESS 0x0000E048 /end MEASUREMENT
/begin FUNCTION Badhallglitchorwrongconnect ""
 /begin IN_MEASUREMENT mcb_pmsm_foc_hall_f28379d_B.DataStoreRead1_o mcb_pmsm_foc_hall_f28379d_B.Merge_k mcb_pmsm_foc_hall_f28379d_B.Merge1_kl mcb_pmsm_foc_hall_f28379d_B.Merge3_m /end IN_MEASUREMENT
/end FUNCTION
/begin FUNCTION mcb_pmsm_IfActionSubsystem1 ""
 /begin IN_MEASUREMENT mcb_pmsm_foc_hall_f28379d_B.Add mcb_pmsm_foc_hall_f28379d_B.Merge_p /end IN_MEASUREMENT
/end FUNCTION
/begin FUNCTION mcb_pmsm__IfActionSubsystem ""
 /begin IN_MEASUREMENT mcb_pmsm_foc_hall_f28379d_B.Add mcb_pmsm_foc_hall_f28379d_B.Merge_p /end IN_MEASUREMENT
/end FUNCTION
/begin FUNCTION mcb_pmsm_foc_h_HallValueof1 "" /begin IN_MEASUREMENT mcb_pmsm_foc_hall_f28379d_B.Merge1_d /end IN_MEASUREMENT /end FUNCTION
/begin FUNCTION mcb_pmsm_foc_h_HallValueof2 "" /begin IN_MEASUREMENT mcb_pmsm_foc_hall_f28379d_B.Merge1_d /end IN_MEASUREMENT /end FUNCTION
/begin FUNCTION mcb_pmsm_foc_h_HallValueof3 "" /begin IN_MEASUREMENT mcb_pmsm_foc_hall_f28379d_B.Merge1_d /end IN_MEASUREMENT /end FUNCTION
/begin FUNCTION mcb_pmsm_foc_h_HallValueof4 "" /begin IN_MEASUREMENT mcb_pmsm_foc_hall_f28379d_B.Merge1_d /end IN_MEASUREMENT /end FUNCTION
/begin FUNCTION mcb_pmsm_foc_h_HallValueof5 "" /begin IN_MEASUREMENT mcb_pmsm_foc_hall_f28379d_B.Merge1_d /end IN_MEASUREMENT /end FUNCTION
/begin FUNCTION mcb_pmsm_foc_h_HallValueof7 "" /begin IN_MEASUREMENT mcb_pmsm_foc_hall_f28379d_B.Merge1_d /end IN_MEASUREMENT /end FUNCTION
/begin FUNCTION mcb_pmsm_foc_h_SpeedControl ""
 /begin IN_MEASUREMENT mcb_pmsm_foc_hall_f28379d_B.RT6 mcb_pmsm_foc_hall_f28379d_B.RT7 mcb_pmsm_foc_hall_f28379d_DWork.Enable /end IN_MEASUREMENT
/end FUNCTION
/begin FUNCTION mcb_pmsm_foc_hal_ValidHalls ""
 /begin IN_MEASUREMENT mcb_pmsm_foc_hall_f28379d_B.DataTypeConversion1_d mcb_pmsm_foc_hall_f28379d_B.DataTypeConversion2_c mcb_pmsm_foc_hall_f28379d_B.DataStoreRead1_o mcb_pmsm_foc_hall_f28379d_B.Merge3_m mcb_pmsm_foc_hall_f28379d_B.Merge1_kl mcb_pmsm_foc_hall_f28379d_B.Merge_k /end IN_MEASUREMENT
/end FUNCTION
/begin FUNCTION mcb_pmsm_foc_hall_f_Output0 "" /begin IN_MEASUREMENT mcb_pmsm_foc_hall_f28379d_B.Merge_n /end IN_MEASUREMENT /end FUNCTION
/begin FUNCTION mcb_pmsm_foc_hall_f_Output1 "" /begin IN_MEASUREMENT mcb_pmsm_foc_hall_f28379d_B.Merge_n /end IN_MEASUREMENT /end FUNCTION
/begin COMPU_METHOD mcb_pmsm_foc_hall_f28379d_CM_double "Q = V" RAT_FUNC "%15.10" "" COEFFS 0 1 0 0 0 1 /end COMPU_METHOD
/begin COMPU_METHOD mcb_pmsm_foc_hall_f28379d_CM_int16 "Q = V" RAT_FUNC "%5.0" "" COEFFS 0 1 0 0 0 1 /end COMPU_METHOD
/begin COMPU_METHOD mcb_pmsm_foc_hall_f28379d_CM_int32 "Q = V" RAT_FUNC "%10.0" "" COEFFS 0 1 0 0 0 1 /end COMPU_METHOD
/begin COMPU_METHOD mcb_pmsm_foc_hall_f28379d_CM_int8 "Q = V" RAT_FUNC "%3.0" "" COEFFS 0 1 0 0 0 1 /end COMPU_METHOD
/begin COMPU_METHOD mcb_pmsm_foc_hall_f28379d_CM_int_T "Q = V" RAT_FUNC "%0.6" "" COEFFS 0 1 0 0 0 1 /end COMPU_METHOD
/begin COMPU_METHOD mcb_pmsm_foc_hall_f28379d_CM_logical "Q = V" RAT_FUNC "%1.0" "" COEFFS 0 1 0 0 0 1 /end COMPU_METHOD
/begin COMPU_METHOD mcb_pmsm_foc_hall_f28379d_CM_single "Q = V" RAT_FUNC "%8.6" "" COEFFS 0 1 0 0 0 1 /end COMPU_METHOD
/begin COMPU_METHOD mcb_pmsm_foc_hall_f28379d_CM_uint16 "Q = V" RAT_FUNC "%5.0" "" COEFFS 0 1 0 0 0 1 /end COMPU_METHOD
/begin COMPU_METHOD mcb_pmsm_foc_hall_f28379d_CM_uint32 "Q = V" RAT_FUNC "%10.0" "" COEFFS 0 1 0 0 0 1 /end COMPU_METHOD
/begin COMPU_METHOD mcb_pmsm_foc_hall_f28379d_CM_uint8 "Q = V" RAT_FUNC "%3.0" "" COEFFS 0 1 0 0 0 1 /end COMPU_METHOD
/begin RECORD_LAYOUT Record_BOOLEAN FNC_VALUES 1 UBYTE COLUMN_DIR DIRECT /end RECORD_LAYOUT
/begin RECORD_LAYOUT Record_FLOAT32_IEEE FNC_VALUES 1 FLOAT32_IEEE COLUMN_DIR DIRECT /end RECORD_LAYOUT
/begin RECORD_LAYOUT Record_FLOAT64_IEEE FNC_VALUES 1 FLOAT64_IEEE COLUMN_DIR DIRECT /end RECORD_LAYOUT
/begin RECORD_LAYOUT Record_SBYTE FNC_VALUES 1 SBYTE COLUMN_DIR DIRECT /end RECORD_LAYOUT
/begin RECORD_LAYOUT Record_SLONG FNC_VALUES 1 SLONG COLUMN_DIR DIRECT /end RECORD_LAYOUT
/begin RECORD_LAYOUT Record_SWORD FNC_VALUES 1 SWORD COLUMN_DIR DIRECT /end RECORD_LAYOUT
/begin RECORD_LAYOUT Record_UBYTE FNC_VALUES 1 UBYTE COLUMN_DIR DIRECT /end RECORD_LAYOUT
/begin RECORD_LAYOUT Record_ULONG FNC_VALUES 1 ULONG COLUMN_DIR DIRECT /end RECORD_LAYOUT
/begin RECORD_LAYOUT Record_UWORD FNC_VALUES 1 UWORD COLUMN_DIR DIRECT /end RECORD_LAYOUT
/begin GROUP mcb_pmsm_foc_hall_f28379d "mcb_pmsm_foc_hall_f28379d" /* Root */ ROOT
 /begin SUB_GROUP mcb_pmsm_foc_hall_f28379d_Current_Control mcb_pmsm_foc_hall_f28379d_Hall_Sensor_A mcb_pmsm_foc_hall_f28379d_Hall_Sensor_B mcb_pmsm_foc_hall_f28379d_Hall_Sensor_C mcb_pmsm_foc_hall_f28379d_Hardware_Init mcb_pmsm_foc_hall_f28379d_Heartbeat_LED mcb_pmsm_foc_hall_f28379d_Serial_Receive mcb_pmsm_foc_hall_f28379d_Speed_Control mcb_pmsm_foc_hall_f28379d_Subsystem4 /end SUB_GROUP
 /begin REF_MEASUREMENT mcb_pmsm_foc_hall_f28379d_B.Add mcb_pmsm_foc_hall_f28379d_B.Constant mcb_pmsm_foc_hall_f28379d_B.OutportBufferForV_dq_ref mcb_pmsm_foc_hall_f28379d_B.RT1 mcb_pmsm_foc_hall_f28379d_B.RT10 mcb_pmsm_foc_hall_f28379d_B.RT11 mcb_pmsm_foc_hall_f28379d_B.RT12 mcb_pmsm_foc_hall_f28379d_B.RT2 mcb_pmsm_foc_hall_f28379d_B.RT6 mcb_pmsm_foc_hall_f28379d_B.RT7 mcb_pmsm_foc_hall_f28379d_B.RT8 mcb_pmsm_foc_hall_f28379d_B.RT9 mcb_pmsm_foc_hall_f28379d_B.SCIReceive mcb_pmsm_foc_hall_f28379d_B.Speed_PU mcb_pmsm_foc_hall_f28379d_DWork.Debug_signals mcb_pmsm_foc_hall_f28379d_DWork.Enable mcb_pmsm_foc_hall_f28379d_DWork.GlobalDirection mcb_pmsm_foc_hall_f28379d_DWork.GlobalHallState mcb_pmsm_foc_hall_f28379d_DWork.GlobalSpeedCount mcb_pmsm_foc_hall_f28379d_DWork.GlobalSpeedValidity mcb_pmsm_foc_hall_f28379d_DWork.HallStateChangeFlag mcb_pmsm_foc_hall_f28379d_DWork.IaOffset mcb_pmsm_foc_hall_f28379d_DWork.IbOffset mcb_pmsm_foc_hall_f28379d_DWork.RT10_ActiveBufIdx mcb_pmsm_foc_hall_f28379d_DWork.RT10_Buffer mcb_pmsm_foc_hall_f28379d_DWork.RT10_semaphoreTaken mcb_pmsm_foc_hall_f28379d_DWork.RT11_ActiveBufIdx mcb_pmsm_foc_hall_f28379d_DWork.RT11_Buffer mcb_pmsm_foc_hall_f28379d_DWork.RT11_semaphoreTaken mcb_pmsm_foc_hall_f28379d_DWork.RT12_ActiveBufIdx mcb_pmsm_foc_hall_f28379d_DWork.RT12_Buffer mcb_pmsm_foc_hall_f28379d_DWork.RT1_ActiveBufIdx mcb_pmsm_foc_hall_f28379d_DWork.RT1_Buffer mcb_pmsm_foc_hall_f28379d_DWork.RT1_semaphoreTaken mcb_pmsm_foc_hall_f28379d_DWork.RT2_ActiveBufIdx mcb_pmsm_foc_hall_f28379d_DWork.RT2_Buffer mcb_pmsm_foc_hall_f28379d_DWork.RT6_ActiveBufIdx mcb_pmsm_foc_hall_f28379d_DWork.RT6_Buffer mcb_pmsm_foc_hall_f28379d_DWork.RT6_semaphoreTaken mcb_pmsm_foc_hall_f28379d_DWork.RT8_ActiveBufIdx mcb_pmsm_foc_hall_f28379d_DWork.RT8_Buffer mcb_pmsm_foc_hall_f28379d_DWork.RT8_semaphoreTaken mcb_pmsm_foc_hall_f28379d_DWork.RT9_ActiveBufIdx mcb_pmsm_foc_hall_f28379d_DWork.RT9_Buffer mcb_pmsm_foc_hall_f28379d_DWork.RT9_semaphoreTaken mcb_pmsm_foc_hall_f28379d_DWork.Speed_ref /end REF_MEASUREMENT
/end GROUP
/begin GROUP mcb_pmsm_foc_hall_f28379d_Current_Control "mcb_pmsm_foc_hall_f28379d/Current Control"
 /begin SUB_GROUP mcb_pmsm_foc_hall_f28379d_Current_Control_Control_System mcb_pmsm_foc_hall_f28379d_Current_Control_Input_Scaling mcb_pmsm_foc_hall_f28379d_Current_Control_Inverter mcb_pmsm_foc_hall_f28379d_Current_Control_Output_Scaling mcb_pmsm_foc_hall_f28379d_Current_Control_Sensor_Driver_Blocks /end SUB_GROUP
 /begin REF_MEASUREMENT mcb_pmsm_foc_hall_f28379d_B.Add mcb_pmsm_foc_hall_f28379d_B.OutportBufferForV_dq_ref mcb_pmsm_foc_hall_f28379d_B.Speed_PU /end REF_MEASUREMENT
/end GROUP
/begin GROUP mcb_pmsm_foc_hall_f28379d_Current_Control_Control_System "mcb_pmsm_foc_hall_f28379d/Current Control/Control_System"
 /begin SUB_GROUP mcb_pmsm_foc_hall_f28379d_Current_Control_Control_System_Clarke_Transform mcb_pmsm_foc_hall_f28379d_Current_Control_Control_System_Current_Controllers mcb_pmsm_foc_hall_f28379d_Current_Control_Control_System_Inverse_Park_Transform mcb_pmsm_foc_hall_f28379d_Current_Control_Control_System_Park_Transform mcb_pmsm_foc_hall_f28379d_Current_Control_Control_System_Space_Vector_Generator /end SUB_GROUP
/end GROUP
/begin GROUP mcb_pmsm_foc_hall_f28379d_Current_Control_Control_System_Clarke_Transform "mcb_pmsm_foc_hall_f28379d/Current Control/Control_System/Clarke Transform"
 /begin SUB_GROUP mcb_pmsm_foc_hall_f28379d_Current_Control_Control_System_Clarke_Transform_Two_phase_input /end SUB_GROUP
/end GROUP
/begin GROUP mcb_pmsm_foc_hall_f28379d_Current_Control_Control_System_Clarke_Transform_Two_phase_input "mcb_pmsm_foc_hall_f28379d/Current Control/Control_System/Clarke Transform/Two phase input"
 /begin SUB_GROUP mcb_pmsm_foc_hall_f28379d_Current_Control_Control_System_Clarke_Transform_Two_phase_input_Two_phase_CRL_wrap /end SUB_GROUP
/end GROUP
/begin GROUP mcb_pmsm_foc_hall_f28379d_Current_Control_Control_System_Clarke_Transform_Two_phase_input_Two_phase_CRL_wrap "mcb_pmsm_foc_hall_f28379d/Current Control/Control_System/Clarke Transform/Two phase input/Two phase CRL wrap"
 /begin REF_MEASUREMENT mcb_pmsm_foc_hall_f28379d_B.PU_Conversion mcb_pmsm_foc_hall_f28379d_B.a_plus_2b mcb_pmsm_foc_hall_f28379d_B.one_by_sqrt3 /end REF_MEASUREMENT
/end GROUP
/begin GROUP mcb_pmsm_foc_hall_f28379d_Current_Control_Control_System_Current_Controllers "mcb_pmsm_foc_hall_f28379d/Current Control/Control_System/Current_Controllers"
 /begin SUB_GROUP mcb_pmsm_foc_hall_f28379d_Current_Control_Control_System_Current_Controllers_DQ_Limiter mcb_pmsm_foc_hall_f28379d_Current_Control_Control_System_Current_Controllers_PI_Controller_Id mcb_pmsm_foc_hall_f28379d_Current_Control_Control_System_Current_Controllers_PI_Controller_Iq /end SUB_GROUP
/end GROUP
/begin GROUP mcb_pmsm_foc_hall_f28379d_Current_Control_Control_System_Current_Controllers_DQ_Limiter "mcb_pmsm_foc_hall_f28379d/Current Control/Control_System/Current_Controllers/DQ Limiter"
 /begin SUB_GROUP mcb_pmsm_foc_hall_f28379d_Current_Control_Control_System_Current_Controllers_DQ_Limiter_D_Q_Equivalence mcb_pmsm_foc_hall_f28379d_Current_Control_Control_System_Current_Controllers_DQ_Limiter_D__Q_Axis_Priority mcb_pmsm_foc_hall_f28379d_Current_Control_Control_System_Current_Controllers_DQ_Limiter_Inport__Dialog_Selection mcb_pmsm_foc_hall_f28379d_Current_Control_Control_System_Current_Controllers_DQ_Limiter_Magnitude_calc /end SUB_GROUP
 /begin REF_MEASUREMENT mcb_pmsm_foc_hall_f28379d_B.Merge_do mcb_pmsm_foc_hall_f28379d_B.Switch1_o /end REF_MEASUREMENT
/end GROUP
/begin GROUP mcb_pmsm_foc_hall_f28379d_Current_Control_Control_System_Current_Controllers_DQ_Limiter_D_Q_Equivalence "mcb_pmsm_foc_hall_f28379d/Current Control/Control_System/Current_Controllers/DQ Limiter/D-Q Equivalence"
 /begin SUB_GROUP mcb_pmsm_foc_hall_f28379d_Current_Control_Control_System_Current_Controllers_DQ_Limiter_D_Q_Equivalence_Limiter mcb_pmsm_foc_hall_f28379d_Current_Control_Control_System_Current_Controllers_DQ_Limiter_D_Q_Equivalence_Passthrough /end SUB_GROUP
 /begin REF_MEASUREMENT mcb_pmsm_foc_hall_f28379d_B.DataTypeConversion_jg mcb_pmsm_foc_hall_f28379d_B.Merge_do mcb_pmsm_foc_hall_f28379d_B.Product_b mcb_pmsm_foc_hall_f28379d_B.RelationalOperator_h mcb_pmsm_foc_hall_f28379d_B.Sum1 /end REF_MEASUREMENT
/end GROUP
/begin GROUP mcb_pmsm_foc_hall_f28379d_Current_Control_Control_System_Current_Controllers_DQ_Limiter_D_Q_Equivalence_Limiter "mcb_pmsm_foc_hall_f28379d/Current Control/Control_System/Current_Controllers/DQ Limiter/D-Q Equivalence/Limiter"
 /begin REF_MEASUREMENT mcb_pmsm_foc_hall_f28379d_B.Merge_do mcb_pmsm_foc_hall_f28379d_B.Product_ie mcb_pmsm_foc_hall_f28379d_B.Reciprocal mcb_pmsm_foc_hall_f28379d_B.SquareRoot mcb_pmsm_foc_hall_f28379d_B.Sum1 mcb_pmsm_foc_hall_f28379d_B.Switch_j mcb_pmsm_foc_hall_f28379d_B.Switch_o /end REF_MEASUREMENT
/end GROUP
/begin GROUP mcb_pmsm_foc_hall_f28379d_Current_Control_Control_System_Current_Controllers_DQ_Limiter_D_Q_Equivalence_Passthrough "mcb_pmsm_foc_hall_f28379d/Current Control/Control_System/Current_Controllers/DQ Limiter/D-Q Equivalence/Passthrough" /begin REF_MEASUREMENT mcb_pmsm_foc_hall_f28379d_B.Merge_do /end REF_MEASUREMENT /end GROUP
/begin GROUP mcb_pmsm_foc_hall_f28379d_Current_Control_Control_System_Current_Controllers_DQ_Limiter_D__Q_Axis_Priority "mcb_pmsm_foc_hall_f28379d/Current Control/Control_System/Current_Controllers/DQ Limiter/D//Q Axis Priority"
 /begin SUB_GROUP mcb_pmsm_foc_hall_f28379d_Current_Control_Control_System_Current_Controllers_DQ_Limiter_D__Q_Axis_Priority_Compare_To_Constant mcb_pmsm_foc_hall_f28379d_Current_Control_Control_System_Current_Controllers_DQ_Limiter_D__Q_Axis_Priority_Compare_To_Constant1 mcb_pmsm_foc_hall_f28379d_Current_Control_Control_System_Current_Controllers_DQ_Limiter_D__Q_Axis_Priority_limiter /end SUB_GROUP
 /begin REF_MEASUREMENT mcb_pmsm_foc_hall_f28379d_B.Compare_h mcb_pmsm_foc_hall_f28379d_B.Compare_nfz mcb_pmsm_foc_hall_f28379d_B.Merge_do mcb_pmsm_foc_hall_f28379d_B.Switch_hp /end REF_MEASUREMENT
/end GROUP
/begin GROUP mcb_pmsm_foc_hall_f28379d_Current_Control_Control_System_Current_Controllers_DQ_Limiter_D__Q_Axis_Priority_Compare_To_Constant "mcb_pmsm_foc_hall_f28379d/Current Control/Control_System/Current_Controllers/DQ Limiter/D//Q Axis Priority/Compare\r\nTo Constant"
 /begin REF_MEASUREMENT mcb_pmsm_foc_hall_f28379d_B.Compare_h mcb_pmsm_foc_hall_f28379d_B.Switch1_o /end REF_MEASUREMENT
/end GROUP
/begin GROUP mcb_pmsm_foc_hall_f28379d_Current_Control_Control_System_Current_Controllers_DQ_Limiter_D__Q_Axis_Priority_Compare_To_Constant1 "mcb_pmsm_foc_hall_f28379d/Current Control/Control_System/Current_Controllers/DQ Limiter/D//Q Axis Priority/Compare\r\nTo Constant1"
 /begin REF_MEASUREMENT mcb_pmsm_foc_hall_f28379d_B.Compare_nfz mcb_pmsm_foc_hall_f28379d_B.Switch1_o /end REF_MEASUREMENT
/end GROUP
/begin GROUP mcb_pmsm_foc_hall_f28379d_Current_Control_Control_System_Current_Controllers_DQ_Limiter_D__Q_Axis_Priority_limiter "mcb_pmsm_foc_hall_f28379d/Current Control/Control_System/Current_Controllers/DQ Limiter/D//Q Axis Priority/limiter"
 /begin SUB_GROUP mcb_pmsm_foc_hall_f28379d_Current_Control_Control_System_Current_Controllers_DQ_Limiter_D__Q_Axis_Priority_limiter_limitRef1 mcb_pmsm_foc_hall_f28379d_Current_Control_Control_System_Current_Controllers_DQ_Limiter_D__Q_Axis_Priority_limiter_limitRef2 mcb_pmsm_foc_hall_f28379d_Current_Control_Control_System_Current_Controllers_DQ_Limiter_D__Q_Axis_Priority_limiter_passThrough /end SUB_GROUP
 /begin REF_MEASUREMENT mcb_pmsm_foc_hall_f28379d_B.DataTypeConversion_nl mcb_pmsm_foc_hall_f28379d_B.Gain_e mcb_pmsm_foc_hall_f28379d_B.Merge_me mcb_pmsm_foc_hall_f28379d_B.Product2 mcb_pmsm_foc_hall_f28379d_B.Product_a mcb_pmsm_foc_hall_f28379d_B.Product_b mcb_pmsm_foc_hall_f28379d_B.RelationalOperator_i mcb_pmsm_foc_hall_f28379d_B.Sum_nl mcb_pmsm_foc_hall_f28379d_B.Switch2 mcb_pmsm_foc_hall_f28379d_B.Switch_hp mcb_pmsm_foc_hall_f28379d_B.Switch_j /end REF_MEASUREMENT
/end GROUP
/begin GROUP mcb_pmsm_foc_hall_f28379d_Current_Control_Control_System_Current_Controllers_DQ_Limiter_D__Q_Axis_Priority_limiter_limitRef1 "mcb_pmsm_foc_hall_f28379d/Current Control/Control_System/Current_Controllers/DQ Limiter/D//Q Axis Priority/limiter/limitRef1"
 /begin REF_MEASUREMENT mcb_pmsm_foc_hall_f28379d_B.Gain_e mcb_pmsm_foc_hall_f28379d_B.LowerRelop1 mcb_pmsm_foc_hall_f28379d_B.Switch2 mcb_pmsm_foc_hall_f28379d_B.Switch_c mcb_pmsm_foc_hall_f28379d_B.Switch_hp mcb_pmsm_foc_hall_f28379d_B.Switch_j mcb_pmsm_foc_hall_f28379d_B.UpperRelop /end REF_MEASUREMENT
/end GROUP
/begin GROUP mcb_pmsm_foc_hall_f28379d_Current_Control_Control_System_Current_Controllers_DQ_Limiter_D__Q_Axis_Priority_limiter_limitRef2 "mcb_pmsm_foc_hall_f28379d/Current Control/Control_System/Current_Controllers/DQ Limiter/D//Q Axis Priority/limiter/limitRef2"
 /begin REF_MEASUREMENT mcb_pmsm_foc_hall_f28379d_B.Gain_c mcb_pmsm_foc_hall_f28379d_B.Merge_me mcb_pmsm_foc_hall_f28379d_B.Sqrt mcb_pmsm_foc_hall_f28379d_B.Sum_nl mcb_pmsm_foc_hall_f28379d_B.Switch1 mcb_pmsm_foc_hall_f28379d_B.Switch_hp /end REF_MEASUREMENT
/end GROUP
/begin GROUP mcb_pmsm_foc_hall_f28379d_Current_Control_Control_System_Current_Controllers_DQ_Limiter_D__Q_Axis_Priority_limiter_passThrough "mcb_pmsm_foc_hall_f28379d/Current Control/Control_System/Current_Controllers/DQ Limiter/D//Q Axis Priority/limiter/passThrough" /begin REF_MEASUREMENT mcb_pmsm_foc_hall_f28379d_B.Merge_me /end REF_MEASUREMENT /end GROUP
/begin GROUP mcb_pmsm_foc_hall_f28379d_Current_Control_Control_System_Current_Controllers_DQ_Limiter_Inport__Dialog_Selection "mcb_pmsm_foc_hall_f28379d/Current Control/Control_System/Current_Controllers/DQ Limiter/Inport//Dialog Selection"
 /begin REF_MEASUREMENT mcb_pmsm_foc_hall_f28379d_B.Product_b mcb_pmsm_foc_hall_f28379d_B.Switch1_o mcb_pmsm_foc_hall_f28379d_B.Switch_j /end REF_MEASUREMENT
/end GROUP
/begin GROUP mcb_pmsm_foc_hall_f28379d_Current_Control_Control_System_Current_Controllers_DQ_Limiter_Magnitude_calc "mcb_pmsm_foc_hall_f28379d/Current Control/Control_System/Current_Controllers/DQ Limiter/Magnitude_calc"
 /begin REF_MEASUREMENT mcb_pmsm_foc_hall_f28379d_B.Product1_b mcb_pmsm_foc_hall_f28379d_B.Product_e mcb_pmsm_foc_hall_f28379d_B.Saturation mcb_pmsm_foc_hall_f28379d_B.Saturation_j mcb_pmsm_foc_hall_f28379d_B.Sum1 /end REF_MEASUREMENT
/end GROUP
/begin GROUP mcb_pmsm_foc_hall_f28379d_Current_Control_Control_System_Current_Controllers_PI_Controller_Id "mcb_pmsm_foc_hall_f28379d/Current Control/Control_System/Current_Controllers/PI_Controller_Id"
 /begin SUB_GROUP mcb_pmsm_foc_hall_f28379d_Current_Control_Control_System_Current_Controllers_PI_Controller_Id_Discrete_PI_Controller__with_anti_windup___reset /end SUB_GROUP
 /begin REF_MEASUREMENT mcb_pmsm_foc_hall_f28379d_B.DataStoreRead1_g mcb_pmsm_foc_hall_f28379d_B.Ki1 mcb_pmsm_foc_hall_f28379d_B.LogicalOperator_j mcb_pmsm_foc_hall_f28379d_B.RT2 mcb_pmsm_foc_hall_f28379d_B.Sum_b mcb_pmsm_foc_hall_f28379d_B.algDD_o1 mcb_pmsm_foc_hall_f28379d_DWork.Enable /end REF_MEASUREMENT
/end GROUP
/begin GROUP mcb_pmsm_foc_hall_f28379d_Current_Control_Control_System_Current_Controllers_PI_Controller_Id_Discrete_PI_Controller__with_anti_windup___reset "mcb_pmsm_foc_hall_f28379d/Current Control/Control_System/Current_Controllers/PI_Controller_Id/Discrete PI Controller \r\nwith anti-windup & reset"
 /begin SUB_GROUP mcb_pmsm_foc_hall_f28379d_Current_Control_Control_System_Current_Controllers_PI_Controller_Id_Discrete_PI_Controller__with_anti_windup___reset_Anti_windup mcb_pmsm_foc_hall_f28379d_Current_Control_Control_System_Current_Controllers_PI_Controller_Id_Discrete_PI_Controller__with_anti_windup___reset_I_Gain mcb_pmsm_foc_hall_f28379d_Current_Control_Control_System_Current_Controllers_PI_Controller_Id_Discrete_PI_Controller__with_anti_windup___reset_Integrator mcb_pmsm_foc_hall_f28379d_Current_Control_Control_System_Current_Controllers_PI_Controller_Id_Discrete_PI_Controller__with_anti_windup___reset_Parallel_P_Gain mcb_pmsm_foc_hall_f28379d_Current_Control_Control_System_Current_Controllers_PI_Controller_Id_Discrete_PI_Controller__with_anti_windup___reset_Saturation mcb_pmsm_foc_hall_f28379d_Current_Control_Control_System_Current_Controllers_PI_Controller_Id_Discrete_PI_Controller__with_anti_windup___reset_Sum /end SUB_GROUP
/end GROUP
/begin GROUP mcb_pmsm_foc_hall_f28379d_Current_Control_Control_System_Current_Controllers_PI_Controller_Id_Discrete_PI_Controller__with_anti_windup___reset_Anti_windup "mcb_pmsm_foc_hall_f28379d/Current Control/Control_System/Current_Controllers/PI_Controller_Id/Discrete PI Controller \r\nwith anti-windup & reset/Anti-windup"
 /begin SUB_GROUP mcb_pmsm_foc_hall_f28379d_Current_Control_Control_System_Current_Controllers_PI_Controller_Id_Discrete_PI_Controller__with_anti_windup___reset_Anti_windup_Disc__Clamping_Parallel /end SUB_GROUP
/end GROUP
/begin GROUP mcb_pmsm_foc_hall_f28379d_Current_Control_Control_System_Current_Controllers_PI_Controller_Id_Discrete_PI_Controller__with_anti_windup___reset_Anti_windup_Disc__Clamping_Parallel "mcb_pmsm_foc_hall_f28379d/Current Control/Control_System/Current_Controllers/PI_Controller_Id/Discrete PI Controller \r\nwith anti-windup & reset/Anti-windup/Disc. Clamping Parallel"
 /begin SUB_GROUP mcb_pmsm_foc_hall_f28379d_Current_Control_Control_System_Current_Controllers_PI_Controller_Id_Discrete_PI_Controller__with_anti_windup___reset_Anti_windup_Disc__Clamping_Parallel_Dead_Zone /end SUB_GROUP
 /begin REF_MEASUREMENT mcb_pmsm_foc_hall_f28379d_B.AND3 mcb_pmsm_foc_hall_f28379d_B.DeadZone mcb_pmsm_foc_hall_f28379d_B.Equal1 mcb_pmsm_foc_hall_f28379d_B.IProdOut mcb_pmsm_foc_hall_f28379d_B.RelationalOperator mcb_pmsm_foc_hall_f28379d_B.Switch1_i mcb_pmsm_foc_hall_f28379d_B.Switch2_a mcb_pmsm_foc_hall_f28379d_B.Switch_b mcb_pmsm_foc_hall_f28379d_B.fixforDTpropagationissue mcb_pmsm_foc_hall_f28379d_B.fixforDTpropagationissue1 /end REF_MEASUREMENT
/end GROUP
/begin GROUP mcb_pmsm_foc_hall_f28379d_Current_Control_Control_System_Current_Controllers_PI_Controller_Id_Discrete_PI_Controller__with_anti_windup___reset_Anti_windup_Disc__Clamping_Parallel_Dead_Zone "mcb_pmsm_foc_hall_f28379d/Current Control/Control_System/Current_Controllers/PI_Controller_Id/Discrete PI Controller \r\nwith anti-windup & reset/Anti-windup/Disc. Clamping Parallel/Dead Zone"
 /begin SUB_GROUP mcb_pmsm_foc_hall_f28379d_Current_Control_Control_System_Current_Controllers_PI_Controller_Id_Discrete_PI_Controller__with_anti_windup___reset_Anti_windup_Disc__Clamping_Parallel_Dead_Zone_Enabled /end SUB_GROUP
/end GROUP
/begin GROUP mcb_pmsm_foc_hall_f28379d_Current_Control_Control_System_Current_Controllers_PI_Controller_Id_Discrete_PI_Controller__with_anti_windup___reset_Anti_windup_Disc__Clamping_Parallel_Dead_Zone_Enabled "mcb_pmsm_foc_hall_f28379d/Current Control/Control_System/Current_Controllers/PI_Controller_Id/Discrete PI Controller \r\nwith anti-windup & reset/Anti-windup/Disc. Clamping Parallel/Dead Zone/Enabled"
 /begin REF_MEASUREMENT mcb_pmsm_foc_hall_f28379d_B.DeadZone mcb_pmsm_foc_hall_f28379d_B.Sum_h /end REF_MEASUREMENT
/end GROUP
/begin GROUP mcb_pmsm_foc_hall_f28379d_Current_Control_Control_System_Current_Controllers_PI_Controller_Id_Discrete_PI_Controller__with_anti_windup___reset_I_Gain "mcb_pmsm_foc_hall_f28379d/Current Control/Control_System/Current_Controllers/PI_Controller_Id/Discrete PI Controller \r\nwith anti-windup & reset/I Gain"
 /begin SUB_GROUP mcb_pmsm_foc_hall_f28379d_Current_Control_Control_System_Current_Controllers_PI_Controller_Id_Discrete_PI_Controller__with_anti_windup___reset_I_Gain_External_Parameters /end SUB_GROUP
/end GROUP
/begin GROUP mcb_pmsm_foc_hall_f28379d_Current_Control_Control_System_Current_Controllers_PI_Controller_Id_Discrete_PI_Controller__with_anti_windup___reset_I_Gain_External_Parameters "mcb_pmsm_foc_hall_f28379d/Current Control/Control_System/Current_Controllers/PI_Controller_Id/Discrete PI Controller \r\nwith anti-windup & reset/I Gain/External Parameters"
 /begin REF_MEASUREMENT mcb_pmsm_foc_hall_f28379d_B.IProdOut mcb_pmsm_foc_hall_f28379d_B.Sum_b /end REF_MEASUREMENT
/end GROUP
/begin GROUP mcb_pmsm_foc_hall_f28379d_Current_Control_Control_System_Current_Controllers_PI_Controller_Id_Discrete_PI_Controller__with_anti_windup___reset_Integrator "mcb_pmsm_foc_hall_f28379d/Current Control/Control_System/Current_Controllers/PI_Controller_Id/Discrete PI Controller \r\nwith anti-windup & reset/Integrator"
 /begin SUB_GROUP mcb_pmsm_foc_hall_f28379d_Current_Control_Control_System_Current_Controllers_PI_Controller_Id_Discrete_PI_Controller__with_anti_windup___reset_Integrator_Discrete /end SUB_GROUP
/end GROUP
/begin GROUP mcb_pmsm_foc_hall_f28379d_Current_Control_Control_System_Current_Controllers_PI_Controller_Id_Discrete_PI_Controller__with_anti_windup___reset_Integrator_Discrete "mcb_pmsm_foc_hall_f28379d/Current Control/Control_System/Current_Controllers/PI_Controller_Id/Discrete PI Controller \r\nwith anti-windup & reset/Integrator/Discrete"
 /begin REF_MEASUREMENT mcb_pmsm_foc_hall_f28379d_B.Integrator_o mcb_pmsm_foc_hall_f28379d_B.Ki1 mcb_pmsm_foc_hall_f28379d_B.LogicalOperator_j mcb_pmsm_foc_hall_f28379d_B.Switch_b mcb_pmsm_foc_hall_f28379d_DWork.Integrator_DSTATE_j mcb_pmsm_foc_hall_f28379d_DWork.Integrator_PrevResetState_m /end REF_MEASUREMENT
/end GROUP
/begin GROUP mcb_pmsm_foc_hall_f28379d_Current_Control_Control_System_Current_Controllers_PI_Controller_Id_Discrete_PI_Controller__with_anti_windup___reset_Parallel_P_Gain "mcb_pmsm_foc_hall_f28379d/Current Control/Control_System/Current_Controllers/PI_Controller_Id/Discrete PI Controller \r\nwith anti-windup & reset/Parallel P Gain"
 /begin SUB_GROUP mcb_pmsm_foc_hall_f28379d_Current_Control_Control_System_Current_Controllers_PI_Controller_Id_Discrete_PI_Controller__with_anti_windup___reset_Parallel_P_Gain_External_Parameters /end SUB_GROUP
/end GROUP
/begin GROUP mcb_pmsm_foc_hall_f28379d_Current_Control_Control_System_Current_Controllers_PI_Controller_Id_Discrete_PI_Controller__with_anti_windup___reset_Parallel_P_Gain_External_Parameters "mcb_pmsm_foc_hall_f28379d/Current Control/Control_System/Current_Controllers/PI_Controller_Id/Discrete PI Controller \r\nwith anti-windup & reset/Parallel P Gain/External Parameters"
 /begin REF_MEASUREMENT mcb_pmsm_foc_hall_f28379d_B.PProdOut_b mcb_pmsm_foc_hall_f28379d_B.Sum_b /end REF_MEASUREMENT
/end GROUP
/begin GROUP mcb_pmsm_foc_hall_f28379d_Current_Control_Control_System_Current_Controllers_PI_Controller_Id_Discrete_PI_Controller__with_anti_windup___reset_Saturation "mcb_pmsm_foc_hall_f28379d/Current Control/Control_System/Current_Controllers/PI_Controller_Id/Discrete PI Controller \r\nwith anti-windup & reset/Saturation"
 /begin SUB_GROUP mcb_pmsm_foc_hall_f28379d_Current_Control_Control_System_Current_Controllers_PI_Controller_Id_Discrete_PI_Controller__with_anti_windup___reset_Saturation_Enabled /end SUB_GROUP
/end GROUP
/begin GROUP mcb_pmsm_foc_hall_f28379d_Current_Control_Control_System_Current_Controllers_PI_Controller_Id_Discrete_PI_Controller__with_anti_windup___reset_Saturation_Enabled "mcb_pmsm_foc_hall_f28379d/Current Control/Control_System/Current_Controllers/PI_Controller_Id/Discrete PI Controller \r\nwith anti-windup & reset/Saturation/Enabled"
 /begin REF_MEASUREMENT mcb_pmsm_foc_hall_f28379d_B.Saturation_j mcb_pmsm_foc_hall_f28379d_B.Sum_h /end REF_MEASUREMENT
/end GROUP
/begin GROUP mcb_pmsm_foc_hall_f28379d_Current_Control_Control_System_Current_Controllers_PI_Controller_Id_Discrete_PI_Controller__with_anti_windup___reset_Sum "mcb_pmsm_foc_hall_f28379d/Current Control/Control_System/Current_Controllers/PI_Controller_Id/Discrete PI Controller \r\nwith anti-windup & reset/Sum"
 /begin SUB_GROUP mcb_pmsm_foc_hall_f28379d_Current_Control_Control_System_Current_Controllers_PI_Controller_Id_Discrete_PI_Controller__with_anti_windup___reset_Sum_Sum_PI /end SUB_GROUP
/end GROUP
/begin GROUP mcb_pmsm_foc_hall_f28379d_Current_Control_Control_System_Current_Controllers_PI_Controller_Id_Discrete_PI_Controller__with_anti_windup___reset_Sum_Sum_PI "mcb_pmsm_foc_hall_f28379d/Current Control/Control_System/Current_Controllers/PI_Controller_Id/Discrete PI Controller \r\nwith anti-windup & reset/Sum/Sum_PI"
 /begin REF_MEASUREMENT mcb_pmsm_foc_hall_f28379d_B.Integrator_o mcb_pmsm_foc_hall_f28379d_B.PProdOut_b mcb_pmsm_foc_hall_f28379d_B.Sum_h /end REF_MEASUREMENT
/end GROUP
/begin GROUP mcb_pmsm_foc_hall_f28379d_Current_Control_Control_System_Current_Controllers_PI_Controller_Iq "mcb_pmsm_foc_hall_f28379d/Current Control/Control_System/Current_Controllers/PI_Controller_Iq"
 /begin SUB_GROUP mcb_pmsm_foc_hall_f28379d_Current_Control_Control_System_Current_Controllers_PI_Controller_Iq_Discrete_PI_Controller__with_anti_windup___reset /end SUB_GROUP
 /begin REF_MEASUREMENT mcb_pmsm_foc_hall_f28379d_B.DataStoreRead1_b mcb_pmsm_foc_hall_f28379d_B.Kp1 mcb_pmsm_foc_hall_f28379d_B.LogicalOperator mcb_pmsm_foc_hall_f28379d_B.RT2 mcb_pmsm_foc_hall_f28379d_B.Sum_g mcb_pmsm_foc_hall_f28379d_B.algDD_o2 mcb_pmsm_foc_hall_f28379d_DWork.Enable /end REF_MEASUREMENT
/end GROUP
/begin GROUP mcb_pmsm_foc_hall_f28379d_Current_Control_Control_System_Current_Controllers_PI_Controller_Iq_Discrete_PI_Controller__with_anti_windup___reset "mcb_pmsm_foc_hall_f28379d/Current Control/Control_System/Current_Controllers/PI_Controller_Iq/Discrete PI Controller \r\nwith anti-windup & reset"
 /begin SUB_GROUP mcb_pmsm_foc_hall_f28379d_Current_Control_Control_System_Current_Controllers_PI_Controller_Iq_Discrete_PI_Controller__with_anti_windup___reset_Anti_windup mcb_pmsm_foc_hall_f28379d_Current_Control_Control_System_Current_Controllers_PI_Controller_Iq_Discrete_PI_Controller__with_anti_windup___reset_I_Gain mcb_pmsm_foc_hall_f28379d_Current_Control_Control_System_Current_Controllers_PI_Controller_Iq_Discrete_PI_Controller__with_anti_windup___reset_Integrator mcb_pmsm_foc_hall_f28379d_Current_Control_Control_System_Current_Controllers_PI_Controller_Iq_Discrete_PI_Controller__with_anti_windup___reset_Parallel_P_Gain mcb_pmsm_foc_hall_f28379d_Current_Control_Control_System_Current_Controllers_PI_Controller_Iq_Discrete_PI_Controller__with_anti_windup___reset_Saturation mcb_pmsm_foc_hall_f28379d_Current_Control_Control_System_Current_Controllers_PI_Controller_Iq_Discrete_PI_Controller__with_anti_windup___reset_Sum /end SUB_GROUP
/end GROUP
/begin GROUP mcb_pmsm_foc_hall_f28379d_Current_Control_Control_System_Current_Controllers_PI_Controller_Iq_Discrete_PI_Controller__with_anti_windup___reset_Anti_windup "mcb_pmsm_foc_hall_f28379d/Current Control/Control_System/Current_Controllers/PI_Controller_Iq/Discrete PI Controller \r\nwith anti-windup & reset/Anti-windup"
 /begin SUB_GROUP mcb_pmsm_foc_hall_f28379d_Current_Control_Control_System_Current_Controllers_PI_Controller_Iq_Discrete_PI_Controller__with_anti_windup___reset_Anti_windup_Disc__Clamping_Parallel /end SUB_GROUP
/end GROUP
/begin GROUP mcb_pmsm_foc_hall_f28379d_Current_Control_Control_System_Current_Controllers_PI_Controller_Iq_Discrete_PI_Controller__with_anti_windup___reset_Anti_windup_Disc__Clamping_Parallel "mcb_pmsm_foc_hall_f28379d/Current Control/Control_System/Current_Controllers/PI_Controller_Iq/Discrete PI Controller \r\nwith anti-windup & reset/Anti-windup/Disc. Clamping Parallel"
 /begin SUB_GROUP mcb_pmsm_foc_hall_f28379d_Current_Control_Control_System_Current_Controllers_PI_Controller_Iq_Discrete_PI_Controller__with_anti_windup___reset_Anti_windup_Disc__Clamping_Parallel_Dead_Zone /end SUB_GROUP
 /begin REF_MEASUREMENT mcb_pmsm_foc_hall_f28379d_B.AND3_f mcb_pmsm_foc_hall_f28379d_B.DeadZone_g mcb_pmsm_foc_hall_f28379d_B.Equal1_d mcb_pmsm_foc_hall_f28379d_B.IProdOut_h mcb_pmsm_foc_hall_f28379d_B.RelationalOperator_m mcb_pmsm_foc_hall_f28379d_B.Switch1_j mcb_pmsm_foc_hall_f28379d_B.Switch2_b mcb_pmsm_foc_hall_f28379d_B.Switch_ls mcb_pmsm_foc_hall_f28379d_B.fixforDTpropagationissue1_h mcb_pmsm_foc_hall_f28379d_B.fixforDTpropagationissue_b /end REF_MEASUREMENT
/end GROUP
/begin GROUP mcb_pmsm_foc_hall_f28379d_Current_Control_Control_System_Current_Controllers_PI_Controller_Iq_Discrete_PI_Controller__with_anti_windup___reset_Anti_windup_Disc__Clamping_Parallel_Dead_Zone "mcb_pmsm_foc_hall_f28379d/Current Control/Control_System/Current_Controllers/PI_Controller_Iq/Discrete PI Controller \r\nwith anti-windup & reset/Anti-windup/Disc. Clamping Parallel/Dead Zone"
 /begin SUB_GROUP mcb_pmsm_foc_hall_f28379d_Current_Control_Control_System_Current_Controllers_PI_Controller_Iq_Discrete_PI_Controller__with_anti_windup___reset_Anti_windup_Disc__Clamping_Parallel_Dead_Zone_Enabled /end SUB_GROUP
/end GROUP
/begin GROUP mcb_pmsm_foc_hall_f28379d_Current_Control_Control_System_Current_Controllers_PI_Controller_Iq_Discrete_PI_Controller__with_anti_windup___reset_Anti_windup_Disc__Clamping_Parallel_Dead_Zone_Enabled "mcb_pmsm_foc_hall_f28379d/Current Control/Control_System/Current_Controllers/PI_Controller_Iq/Discrete PI Controller \r\nwith anti-windup & reset/Anti-windup/Disc. Clamping Parallel/Dead Zone/Enabled"
 /begin REF_MEASUREMENT mcb_pmsm_foc_hall_f28379d_B.DeadZone_g mcb_pmsm_foc_hall_f28379d_B.Sum_m /end REF_MEASUREMENT
/end GROUP
/begin GROUP mcb_pmsm_foc_hall_f28379d_Current_Control_Control_System_Current_Controllers_PI_Controller_Iq_Discrete_PI_Controller__with_anti_windup___reset_I_Gain "mcb_pmsm_foc_hall_f28379d/Current Control/Control_System/Current_Controllers/PI_Controller_Iq/Discrete PI Controller \r\nwith anti-windup & reset/I Gain"
 /begin SUB_GROUP mcb_pmsm_foc_hall_f28379d_Current_Control_Control_System_Current_Controllers_PI_Controller_Iq_Discrete_PI_Controller__with_anti_windup___reset_I_Gain_External_Parameters /end SUB_GROUP
/end GROUP
/begin GROUP mcb_pmsm_foc_hall_f28379d_Current_Control_Control_System_Current_Controllers_PI_Controller_Iq_Discrete_PI_Controller__with_anti_windup___reset_I_Gain_External_Parameters "mcb_pmsm_foc_hall_f28379d/Current Control/Control_System/Current_Controllers/PI_Controller_Iq/Discrete PI Controller \r\nwith anti-windup & reset/I Gain/External Parameters"
 /begin REF_MEASUREMENT mcb_pmsm_foc_hall_f28379d_B.IProdOut_h mcb_pmsm_foc_hall_f28379d_B.Sum_g /end REF_MEASUREMENT
/end GROUP
/begin GROUP mcb_pmsm_foc_hall_f28379d_Current_Control_Control_System_Current_Controllers_PI_Controller_Iq_Discrete_PI_Controller__with_anti_windup___reset_Integrator "mcb_pmsm_foc_hall_f28379d/Current Control/Control_System/Current_Controllers/PI_Controller_Iq/Discrete PI Controller \r\nwith anti-windup & reset/Integrator"
 /begin SUB_GROUP mcb_pmsm_foc_hall_f28379d_Current_Control_Control_System_Current_Controllers_PI_Controller_Iq_Discrete_PI_Controller__with_anti_windup___reset_Integrator_Discrete /end SUB_GROUP
/end GROUP
/begin GROUP mcb_pmsm_foc_hall_f28379d_Current_Control_Control_System_Current_Controllers_PI_Controller_Iq_Discrete_PI_Controller__with_anti_windup___reset_Integrator_Discrete "mcb_pmsm_foc_hall_f28379d/Current Control/Control_System/Current_Controllers/PI_Controller_Iq/Discrete PI Controller \r\nwith anti-windup & reset/Integrator/Discrete"
 /begin REF_MEASUREMENT mcb_pmsm_foc_hall_f28379d_B.Integrator mcb_pmsm_foc_hall_f28379d_B.Kp1 mcb_pmsm_foc_hall_f28379d_B.LogicalOperator mcb_pmsm_foc_hall_f28379d_B.Switch_ls mcb_pmsm_foc_hall_f28379d_DWork.Integrator_DSTATE mcb_pmsm_foc_hall_f28379d_DWork.Integrator_PrevResetState /end REF_MEASUREMENT
/end GROUP
/begin GROUP mcb_pmsm_foc_hall_f28379d_Current_Control_Control_System_Current_Controllers_PI_Controller_Iq_Discrete_PI_Controller__with_anti_windup___reset_Parallel_P_Gain "mcb_pmsm_foc_hall_f28379d/Current Control/Control_System/Current_Controllers/PI_Controller_Iq/Discrete PI Controller \r\nwith anti-windup & reset/Parallel P Gain"
 /begin SUB_GROUP mcb_pmsm_foc_hall_f28379d_Current_Control_Control_System_Current_Controllers_PI_Controller_Iq_Discrete_PI_Controller__with_anti_windup___reset_Parallel_P_Gain_External_Parameters /end SUB_GROUP
/end GROUP
/begin GROUP mcb_pmsm_foc_hall_f28379d_Current_Control_Control_System_Current_Controllers_PI_Controller_Iq_Discrete_PI_Controller__with_anti_windup___reset_Parallel_P_Gain_External_Parameters "mcb_pmsm_foc_hall_f28379d/Current Control/Control_System/Current_Controllers/PI_Controller_Iq/Discrete PI Controller \r\nwith anti-windup & reset/Parallel P Gain/External Parameters"
 /begin REF_MEASUREMENT mcb_pmsm_foc_hall_f28379d_B.PProdOut mcb_pmsm_foc_hall_f28379d_B.Sum_g /end REF_MEASUREMENT
/end GROUP
/begin GROUP mcb_pmsm_foc_hall_f28379d_Current_Control_Control_System_Current_Controllers_PI_Controller_Iq_Discrete_PI_Controller__with_anti_windup___reset_Saturation "mcb_pmsm_foc_hall_f28379d/Current Control/Control_System/Current_Controllers/PI_Controller_Iq/Discrete PI Controller \r\nwith anti-windup & reset/Saturation"
 /begin SUB_GROUP mcb_pmsm_foc_hall_f28379d_Current_Control_Control_System_Current_Controllers_PI_Controller_Iq_Discrete_PI_Controller__with_anti_windup___reset_Saturation_Enabled /end SUB_GROUP
/end GROUP
/begin GROUP mcb_pmsm_foc_hall_f28379d_Current_Control_Control_System_Current_Controllers_PI_Controller_Iq_Discrete_PI_Controller__with_anti_windup___reset_Saturation_Enabled "mcb_pmsm_foc_hall_f28379d/Current Control/Control_System/Current_Controllers/PI_Controller_Iq/Discrete PI Controller \r\nwith anti-windup & reset/Saturation/Enabled"
 /begin REF_MEASUREMENT mcb_pmsm_foc_hall_f28379d_B.Saturation mcb_pmsm_foc_hall_f28379d_B.Sum_m /end REF_MEASUREMENT
/end GROUP
/begin GROUP mcb_pmsm_foc_hall_f28379d_Current_Control_Control_System_Current_Controllers_PI_Controller_Iq_Discrete_PI_Controller__with_anti_windup___reset_Sum "mcb_pmsm_foc_hall_f28379d/Current Control/Control_System/Current_Controllers/PI_Controller_Iq/Discrete PI Controller \r\nwith anti-windup & reset/Sum"
 /begin SUB_GROUP mcb_pmsm_foc_hall_f28379d_Current_Control_Control_System_Current_Controllers_PI_Controller_Iq_Discrete_PI_Controller__with_anti_windup___reset_Sum_Sum_PI /end SUB_GROUP
/end GROUP
/begin GROUP mcb_pmsm_foc_hall_f28379d_Current_Control_Control_System_Current_Controllers_PI_Controller_Iq_Discrete_PI_Controller__with_anti_windup___reset_Sum_Sum_PI "mcb_pmsm_foc_hall_f28379d/Current Control/Control_System/Current_Controllers/PI_Controller_Iq/Discrete PI Controller \r\nwith anti-windup & reset/Sum/Sum_PI"
 /begin REF_MEASUREMENT mcb_pmsm_foc_hall_f28379d_B.Integrator mcb_pmsm_foc_hall_f28379d_B.PProdOut mcb_pmsm_foc_hall_f28379d_B.Sum_m /end REF_MEASUREMENT
/end GROUP
/begin GROUP mcb_pmsm_foc_hall_f28379d_Current_Control_Control_System_Inverse_Park_Transform "mcb_pmsm_foc_hall_f28379d/Current Control/Control_System/Inverse Park Transform"
 /begin SUB_GROUP mcb_pmsm_foc_hall_f28379d_Current_Control_Control_System_Inverse_Park_Transform_Sine_Cosine mcb_pmsm_foc_hall_f28379d_Current_Control_Control_System_Inverse_Park_Transform_Two_inputs_CRL /end SUB_GROUP
/end GROUP
/begin GROUP mcb_pmsm_foc_hall_f28379d_Current_Control_Control_System_Inverse_Park_Transform_Sine_Cosine "mcb_pmsm_foc_hall_f28379d/Current Control/Control_System/Inverse Park Transform/Sine Cosine"
 /begin SUB_GROUP mcb_pmsm_foc_hall_f28379d_Current_Control_Control_System_Inverse_Park_Transform_Sine_Cosine_Interpolation mcb_pmsm_foc_hall_f28379d_Current_Control_Control_System_Inverse_Park_Transform_Sine_Cosine_WrapUp /end SUB_GROUP
 /begin REF_MEASUREMENT mcb_pmsm_foc_hall_f28379d_B.DataTypeConversion1_f mcb_pmsm_foc_hall_f28379d_B.Get_Integer_f mcb_pmsm_foc_hall_f28379d_B.Lookup_f mcb_pmsm_foc_hall_f28379d_B.Merge_p mcb_pmsm_foc_hall_f28379d_B.Sum2_p mcb_pmsm_foc_hall_f28379d_B.Sum_k mcb_pmsm_foc_hall_f28379d_B.indexing_i mcb_pmsm_foc_hall_f28379d_DWork.Sum_DWORK1 /end REF_MEASUREMENT
/end GROUP
/begin GROUP mcb_pmsm_foc_hall_f28379d_Current_Control_Control_System_Inverse_Park_Transform_Sine_Cosine_Interpolation "mcb_pmsm_foc_hall_f28379d/Current Control/Control_System/Inverse Park Transform/Sine Cosine/Interpolation"
 /begin REF_MEASUREMENT mcb_pmsm_foc_hall_f28379d_B.Lookup_f mcb_pmsm_foc_hall_f28379d_B.Product1_p mcb_pmsm_foc_hall_f28379d_B.Product_d mcb_pmsm_foc_hall_f28379d_B.Sum2_p mcb_pmsm_foc_hall_f28379d_B.Sum3_c mcb_pmsm_foc_hall_f28379d_B.Sum4_j mcb_pmsm_foc_hall_f28379d_B.Sum5_k mcb_pmsm_foc_hall_f28379d_B.Sum6_e /end REF_MEASUREMENT
/end GROUP
/begin GROUP mcb_pmsm_foc_hall_f28379d_Current_Control_Control_System_Inverse_Park_Transform_Sine_Cosine_WrapUp "mcb_pmsm_foc_hall_f28379d/Current Control/Control_System/Inverse Park Transform/Sine Cosine/WrapUp"
 /begin SUB_GROUP mcb_pmsm_foc_hall_f28379d_Current_Control_Control_System_Inverse_Park_Transform_Sine_Cosine_WrapUp_Compare_To_Zero mcb_pmsm_foc_hall_f28379d_Current_Control_Control_System_Inverse_Park_Transform_Sine_Cosine_WrapUp_If_Action_Subsystem mcb_pmsm_foc_hall_f28379d_Current_Control_Control_System_Inverse_Park_Transform_Sine_Cosine_WrapUp_If_Action_Subsystem1 /end SUB_GROUP
 /begin REF_MEASUREMENT mcb_pmsm_foc_hall_f28379d_B.Compare_nf mcb_pmsm_foc_hall_f28379d_B.DataTypeConversion_e mcb_pmsm_foc_hall_f28379d_B.Merge_p /end REF_MEASUREMENT
/end GROUP
/begin GROUP mcb_pmsm_foc_hall_f28379d_Current_Control_Control_System_Inverse_Park_Transform_Sine_Cosine_WrapUp_Compare_To_Zero "mcb_pmsm_foc_hall_f28379d/Current Control/Control_System/Inverse Park Transform/Sine Cosine/WrapUp/Compare\r\nTo Zero"
 /begin REF_MEASUREMENT mcb_pmsm_foc_hall_f28379d_B.Add mcb_pmsm_foc_hall_f28379d_B.Compare_nf /end REF_MEASUREMENT
/end GROUP
/begin GROUP mcb_pmsm_foc_hall_f28379d_Current_Control_Control_System_Inverse_Park_Transform_Sine_Cosine_WrapUp_If_Action_Subsystem "mcb_pmsm_foc_hall_f28379d/Current Control/Control_System/Inverse Park Transform/Sine Cosine/WrapUp/If Action\r\nSubsystem"
 /begin REF_MEASUREMENT mcb_pmsm_foc_hall_f28379d_B.Add mcb_pmsm_foc_hall_f28379d_B.Merge_p /end REF_MEASUREMENT
/end GROUP
/begin GROUP mcb_pmsm_foc_hall_f28379d_Current_Control_Control_System_Inverse_Park_Transform_Sine_Cosine_WrapUp_If_Action_Subsystem1 "mcb_pmsm_foc_hall_f28379d/Current Control/Control_System/Inverse Park Transform/Sine Cosine/WrapUp/If Action\r\nSubsystem1"
 /begin REF_MEASUREMENT mcb_pmsm_foc_hall_f28379d_B.Add mcb_pmsm_foc_hall_f28379d_B.Merge_p /end REF_MEASUREMENT
/end GROUP
/begin GROUP mcb_pmsm_foc_hall_f28379d_Current_Control_Control_System_Inverse_Park_Transform_Two_inputs_CRL "mcb_pmsm_foc_hall_f28379d/Current Control/Control_System/Inverse Park Transform/Two inputs CRL"
 /begin SUB_GROUP mcb_pmsm_foc_hall_f28379d_Current_Control_Control_System_Inverse_Park_Transform_Two_inputs_CRL_Switch_Axis /end SUB_GROUP
 /begin REF_MEASUREMENT mcb_pmsm_foc_hall_f28379d_B.Merge_do mcb_pmsm_foc_hall_f28379d_B.Sum4_j mcb_pmsm_foc_hall_f28379d_B.Sum6_e mcb_pmsm_foc_hall_f28379d_B.dcos mcb_pmsm_foc_hall_f28379d_B.dsin mcb_pmsm_foc_hall_f28379d_B.qcos mcb_pmsm_foc_hall_f28379d_B.qsin mcb_pmsm_foc_hall_f28379d_B.sum_alpha mcb_pmsm_foc_hall_f28379d_B.sum_beta /end REF_MEASUREMENT
/end GROUP
/begin GROUP mcb_pmsm_foc_hall_f28379d_Current_Control_Control_System_Inverse_Park_Transform_Two_inputs_CRL_Switch_Axis "mcb_pmsm_foc_hall_f28379d/Current Control/Control_System/Inverse Park Transform/Two inputs CRL/Switch_Axis" /begin REF_MEASUREMENT mcb_pmsm_foc_hall_f28379d_B.Switch_k /end REF_MEASUREMENT /end GROUP
/begin GROUP mcb_pmsm_foc_hall_f28379d_Current_Control_Control_System_Park_Transform "mcb_pmsm_foc_hall_f28379d/Current Control/Control_System/Park Transform"
 /begin SUB_GROUP mcb_pmsm_foc_hall_f28379d_Current_Control_Control_System_Park_Transform_Sine_Cosine mcb_pmsm_foc_hall_f28379d_Current_Control_Control_System_Park_Transform_Two_inputs_CRL /end SUB_GROUP
/end GROUP
/begin GROUP mcb_pmsm_foc_hall_f28379d_Current_Control_Control_System_Park_Transform_Sine_Cosine "mcb_pmsm_foc_hall_f28379d/Current Control/Control_System/Park Transform/Sine Cosine"
 /begin SUB_GROUP mcb_pmsm_foc_hall_f28379d_Current_Control_Control_System_Park_Transform_Sine_Cosine_Sine_Cosine_Lookup /end SUB_GROUP
/end GROUP
/begin GROUP mcb_pmsm_foc_hall_f28379d_Current_Control_Control_System_Park_Transform_Sine_Cosine_Sine_Cosine_Lookup "mcb_pmsm_foc_hall_f28379d/Current Control/Control_System/Park Transform/Sine Cosine/Sine-Cosine Lookup"
 /begin SUB_GROUP mcb_pmsm_foc_hall_f28379d_Current_Control_Control_System_Park_Transform_Sine_Cosine_Sine_Cosine_Lookup_Interpolation mcb_pmsm_foc_hall_f28379d_Current_Control_Control_System_Park_Transform_Sine_Cosine_Sine_Cosine_Lookup_WrapUp /end SUB_GROUP
 /begin REF_MEASUREMENT mcb_pmsm_foc_hall_f28379d_B.DataTypeConversion1 mcb_pmsm_foc_hall_f28379d_B.Get_Integer mcb_pmsm_foc_hall_f28379d_B.Lookup mcb_pmsm_foc_hall_f28379d_B.Merge_mm mcb_pmsm_foc_hall_f28379d_B.Sum mcb_pmsm_foc_hall_f28379d_B.Sum2 mcb_pmsm_foc_hall_f28379d_B.indexing mcb_pmsm_foc_hall_f28379d_DWork.Sum_DWORK1 /end REF_MEASUREMENT
/end GROUP
/begin GROUP mcb_pmsm_foc_hall_f28379d_Current_Control_Control_System_Park_Transform_Sine_Cosine_Sine_Cosine_Lookup_Interpolation "mcb_pmsm_foc_hall_f28379d/Current Control/Control_System/Park Transform/Sine Cosine/Sine-Cosine Lookup/Interpolation"
 /begin REF_MEASUREMENT mcb_pmsm_foc_hall_f28379d_B.Lookup mcb_pmsm_foc_hall_f28379d_B.Product mcb_pmsm_foc_hall_f28379d_B.Product1 mcb_pmsm_foc_hall_f28379d_B.Sum2 mcb_pmsm_foc_hall_f28379d_B.Sum3 mcb_pmsm_foc_hall_f28379d_B.Sum4 mcb_pmsm_foc_hall_f28379d_B.Sum5 mcb_pmsm_foc_hall_f28379d_B.Sum6 /end REF_MEASUREMENT
/end GROUP
/begin GROUP mcb_pmsm_foc_hall_f28379d_Current_Control_Control_System_Park_Transform_Sine_Cosine_Sine_Cosine_Lookup_WrapUp "mcb_pmsm_foc_hall_f28379d/Current Control/Control_System/Park Transform/Sine Cosine/Sine-Cosine Lookup/WrapUp"
 /begin SUB_GROUP mcb_pmsm_foc_hall_f28379d_Current_Control_Control_System_Park_Transform_Sine_Cosine_Sine_Cosine_Lookup_WrapUp_Compare_To_Zero mcb_pmsm_foc_hall_f28379d_Current_Control_Control_System_Park_Transform_Sine_Cosine_Sine_Cosine_Lookup_WrapUp_If_Action_Subsystem mcb_pmsm_foc_hall_f28379d_Current_Control_Control_System_Park_Transform_Sine_Cosine_Sine_Cosine_Lookup_WrapUp_If_Action_Subsystem1 /end SUB_GROUP
 /begin REF_MEASUREMENT mcb_pmsm_foc_hall_f28379d_B.Compare_d mcb_pmsm_foc_hall_f28379d_B.DataTypeConversion_m mcb_pmsm_foc_hall_f28379d_B.Merge_mm /end REF_MEASUREMENT
/end GROUP
/begin GROUP mcb_pmsm_foc_hall_f28379d_Current_Control_Control_System_Park_Transform_Sine_Cosine_Sine_Cosine_Lookup_WrapUp_Compare_To_Zero "mcb_pmsm_foc_hall_f28379d/Current Control/Control_System/Park Transform/Sine Cosine/Sine-Cosine Lookup/WrapUp/Compare\r\nTo Zero"
 /begin REF_MEASUREMENT mcb_pmsm_foc_hall_f28379d_B.Add mcb_pmsm_foc_hall_f28379d_B.Compare_d /end REF_MEASUREMENT
/end GROUP
/begin GROUP mcb_pmsm_foc_hall_f28379d_Current_Control_Control_System_Park_Transform_Sine_Cosine_Sine_Cosine_Lookup_WrapUp_If_Action_Subsystem "mcb_pmsm_foc_hall_f28379d/Current Control/Control_System/Park Transform/Sine Cosine/Sine-Cosine Lookup/WrapUp/If Action\r\nSubsystem"
 /begin REF_MEASUREMENT mcb_pmsm_foc_hall_f28379d_B.Add mcb_pmsm_foc_hall_f28379d_B.Merge_mm /end REF_MEASUREMENT
/end GROUP
/begin GROUP mcb_pmsm_foc_hall_f28379d_Current_Control_Control_System_Park_Transform_Sine_Cosine_Sine_Cosine_Lookup_WrapUp_If_Action_Subsystem1 "mcb_pmsm_foc_hall_f28379d/Current Control/Control_System/Park Transform/Sine Cosine/Sine-Cosine Lookup/WrapUp/If Action\r\nSubsystem1"
 /begin REF_MEASUREMENT mcb_pmsm_foc_hall_f28379d_B.Add mcb_pmsm_foc_hall_f28379d_B.Merge_mm /end REF_MEASUREMENT
/end GROUP
/begin GROUP mcb_pmsm_foc_hall_f28379d_Current_Control_Control_System_Park_Transform_Two_inputs_CRL "mcb_pmsm_foc_hall_f28379d/Current Control/Control_System/Park Transform/Two inputs CRL"
 /begin SUB_GROUP mcb_pmsm_foc_hall_f28379d_Current_Control_Control_System_Park_Transform_Two_inputs_CRL_Switch_Axis /end SUB_GROUP
 /begin REF_MEASUREMENT mcb_pmsm_foc_hall_f28379d_B.Sum4 mcb_pmsm_foc_hall_f28379d_B.Sum6 mcb_pmsm_foc_hall_f28379d_B.acos_e mcb_pmsm_foc_hall_f28379d_B.algDD_o1_a mcb_pmsm_foc_hall_f28379d_B.algDD_o2_n mcb_pmsm_foc_hall_f28379d_B.asin_j mcb_pmsm_foc_hall_f28379d_B.bcos mcb_pmsm_foc_hall_f28379d_B.bsin mcb_pmsm_foc_hall_f28379d_B.sum_Ds mcb_pmsm_foc_hall_f28379d_B.sum_Qs /end REF_MEASUREMENT
/end GROUP
/begin GROUP mcb_pmsm_foc_hall_f28379d_Current_Control_Control_System_Park_Transform_Two_inputs_CRL_Switch_Axis "mcb_pmsm_foc_hall_f28379d/Current Control/Control_System/Park Transform/Two inputs CRL/Switch_Axis" /begin REF_MEASUREMENT mcb_pmsm_foc_hall_f28379d_B.Switch_fd /end REF_MEASUREMENT /end GROUP
/begin GROUP mcb_pmsm_foc_hall_f28379d_Current_Control_Control_System_Space_Vector_Generator "mcb_pmsm_foc_hall_f28379d/Current Control/Control_System/Space Vector Generator"
 /begin SUB_GROUP mcb_pmsm_foc_hall_f28379d_Current_Control_Control_System_Space_Vector_Generator_Modulation_method mcb_pmsm_foc_hall_f28379d_Current_Control_Control_System_Space_Vector_Generator_Voltage_Input /end SUB_GROUP
/end GROUP
/begin GROUP mcb_pmsm_foc_hall_f28379d_Current_Control_Control_System_Space_Vector_Generator_Modulation_method "mcb_pmsm_foc_hall_f28379d/Current Control/Control_System/Space Vector Generator/Modulation method"
 /begin SUB_GROUP mcb_pmsm_foc_hall_f28379d_Current_Control_Control_System_Space_Vector_Generator_Modulation_method_SVPWM /end SUB_GROUP
/end GROUP
/begin GROUP mcb_pmsm_foc_hall_f28379d_Current_Control_Control_System_Space_Vector_Generator_Modulation_method_SVPWM "mcb_pmsm_foc_hall_f28379d/Current Control/Control_System/Space Vector Generator/Modulation method/SVPWM"
 /begin SUB_GROUP mcb_pmsm_foc_hall_f28379d_Current_Control_Control_System_Space_Vector_Generator_Modulation_method_SVPWM_Half_Vmin_Vmax_ /end SUB_GROUP
 /begin REF_MEASUREMENT mcb_pmsm_foc_hall_f28379d_B.Add1 mcb_pmsm_foc_hall_f28379d_B.Add2 mcb_pmsm_foc_hall_f28379d_B.Add3 mcb_pmsm_foc_hall_f28379d_B.Gain_o mcb_pmsm_foc_hall_f28379d_B.add_b mcb_pmsm_foc_hall_f28379d_B.add_c mcb_pmsm_foc_hall_f28379d_B.algDD_o1_c mcb_pmsm_foc_hall_f28379d_B.one_by_two_b /end REF_MEASUREMENT
/end GROUP
/begin GROUP mcb_pmsm_foc_hall_f28379d_Current_Control_Control_System_Space_Vector_Generator_Modulation_method_SVPWM_Half_Vmin_Vmax_ "mcb_pmsm_foc_hall_f28379d/Current Control/Control_System/Space Vector Generator/Modulation method/SVPWM/Half(Vmin+Vmax)"
 /begin REF_MEASUREMENT mcb_pmsm_foc_hall_f28379d_B.Add_i mcb_pmsm_foc_hall_f28379d_B.Max_h mcb_pmsm_foc_hall_f28379d_B.Min_a mcb_pmsm_foc_hall_f28379d_B.add_b mcb_pmsm_foc_hall_f28379d_B.add_c mcb_pmsm_foc_hall_f28379d_B.algDD_o1_c mcb_pmsm_foc_hall_f28379d_B.one_by_two_b /end REF_MEASUREMENT
/end GROUP
/begin GROUP mcb_pmsm_foc_hall_f28379d_Current_Control_Control_System_Space_Vector_Generator_Voltage_Input "mcb_pmsm_foc_hall_f28379d/Current Control/Control_System/Space Vector Generator/Voltage Input"
 /begin SUB_GROUP mcb_pmsm_foc_hall_f28379d_Current_Control_Control_System_Space_Vector_Generator_Voltage_Input_Valphabeta /end SUB_GROUP
/end GROUP
/begin GROUP mcb_pmsm_foc_hall_f28379d_Current_Control_Control_System_Space_Vector_Generator_Voltage_Input_Valphabeta "mcb_pmsm_foc_hall_f28379d/Current Control/Control_System/Space Vector Generator/Voltage Input/Valphabeta"
 /begin SUB_GROUP mcb_pmsm_foc_hall_f28379d_Current_Control_Control_System_Space_Vector_Generator_Voltage_Input_Valphabeta_Inverse_Clarke_Transform /end SUB_GROUP
/end GROUP
/begin GROUP mcb_pmsm_foc_hall_f28379d_Current_Control_Control_System_Space_Vector_Generator_Voltage_Input_Valphabeta_Inverse_Clarke_Transform "mcb_pmsm_foc_hall_f28379d/Current Control/Control_System/Space Vector Generator/Voltage Input/Valphabeta/Inverse Clarke Transform"
 /begin SUB_GROUP mcb_pmsm_foc_hall_f28379d_Current_Control_Control_System_Space_Vector_Generator_Voltage_Input_Valphabeta_Inverse_Clarke_Transform_Two_phase_input /end SUB_GROUP
/end GROUP
/begin GROUP mcb_pmsm_foc_hall_f28379d_Current_Control_Control_System_Space_Vector_Generator_Voltage_Input_Valphabeta_Inverse_Clarke_Transform_Two_phase_input "mcb_pmsm_foc_hall_f28379d/Current Control/Control_System/Space Vector Generator/Voltage Input/Valphabeta/Inverse Clarke Transform/Two phase input"
 /begin REF_MEASUREMENT mcb_pmsm_foc_hall_f28379d_B.add_b mcb_pmsm_foc_hall_f28379d_B.add_c mcb_pmsm_foc_hall_f28379d_B.algDD_o1_c mcb_pmsm_foc_hall_f28379d_B.algDD_o2_e mcb_pmsm_foc_hall_f28379d_B.one_by_two mcb_pmsm_foc_hall_f28379d_B.sqrt3_by_two /end REF_MEASUREMENT
/end GROUP
/begin GROUP mcb_pmsm_foc_hall_f28379d_Current_Control_Input_Scaling "mcb_pmsm_foc_hall_f28379d/Current Control/Input Scaling"
 /begin SUB_GROUP mcb_pmsm_foc_hall_f28379d_Current_Control_Input_Scaling_Read_Sensor__codegen_ /end SUB_GROUP
/end GROUP
/begin GROUP mcb_pmsm_foc_hall_f28379d_Current_Control_Input_Scaling_Read_Sensor__codegen_ "mcb_pmsm_foc_hall_f28379d/Current Control/Input Scaling/Read_Sensor (codegen)"
 /begin SUB_GROUP mcb_pmsm_foc_hall_f28379d_Current_Control_Input_Scaling_Read_Sensor__codegen__Calculate_Position_from_Hall mcb_pmsm_foc_hall_f28379d_Current_Control_Input_Scaling_Read_Sensor__codegen__Convert_ADC_value_to_PU /end SUB_GROUP
/end GROUP
/begin GROUP mcb_pmsm_foc_hall_f28379d_Current_Control_Input_Scaling_Read_Sensor__codegen__Calculate_Position_from_Hall "mcb_pmsm_foc_hall_f28379d/Current Control/Input Scaling/Read_Sensor (codegen)/Calculate Position from Hall"
 /begin SUB_GROUP mcb_pmsm_foc_hall_f28379d_Current_Control_Input_Scaling_Read_Sensor__codegen__Calculate_Position_from_Hall_Atomic_Hall_Reading mcb_pmsm_foc_hall_f28379d_Current_Control_Input_Scaling_Read_Sensor__codegen__Calculate_Position_from_Hall_Glitch_Filter mcb_pmsm_foc_hall_f28379d_Current_Control_Input_Scaling_Read_Sensor__codegen__Calculate_Position_from_Hall_Hall_Speed_and_Position mcb_pmsm_foc_hall_f28379d_Current_Control_Input_Scaling_Read_Sensor__codegen__Calculate_Position_from_Hall_Mechanical_to_Electrical_Position1 mcb_pmsm_foc_hall_f28379d_Current_Control_Input_Scaling_Read_Sensor__codegen__Calculate_Position_from_Hall_Subsystem /end SUB_GROUP
 /begin REF_MEASUREMENT mcb_pmsm_foc_hall_f28379d_B.Switch_a mcb_pmsm_foc_hall_f28379d_DWork.HallStateChangeFlag /end REF_MEASUREMENT
/end GROUP
/begin GROUP mcb_pmsm_foc_hall_f28379d_Current_Control_Input_Scaling_Read_Sensor__codegen__Calculate_Position_from_Hall_Atomic_Hall_Reading "mcb_pmsm_foc_hall_f28379d/Current Control/Input Scaling/Read_Sensor (codegen)/Calculate Position from Hall/Atomic Hall Reading"
 /begin SUB_GROUP mcb_pmsm_foc_hall_f28379d_Current_Control_Input_Scaling_Read_Sensor__codegen__Calculate_Position_from_Hall_Atomic_Hall_Reading_Function_Call_Subsystem mcb_pmsm_foc_hall_f28379d_Current_Control_Input_Scaling_Read_Sensor__codegen__Calculate_Position_from_Hall_Atomic_Hall_Reading_Function_Call_Subsystem1 mcb_pmsm_foc_hall_f28379d_Current_Control_Input_Scaling_Read_Sensor__codegen__Calculate_Position_from_Hall_Atomic_Hall_Reading_Integrity_Check /end SUB_GROUP
 /begin REF_MEASUREMENT mcb_pmsm_foc_hall_f28379d_B.DataStoreRead2 mcb_pmsm_foc_hall_f28379d_B.DataStoreRead3 mcb_pmsm_foc_hall_f28379d_B.DataStoreRead4 mcb_pmsm_foc_hall_f28379d_B.DataStoreRead5 mcb_pmsm_foc_hall_f28379d_DWork.GlobalDirection mcb_pmsm_foc_hall_f28379d_DWork.GlobalSpeedCount mcb_pmsm_foc_hall_f28379d_DWork.GlobalSpeedValidity mcb_pmsm_foc_hall_f28379d_DWork.HallStateChangeFlag /end REF_MEASUREMENT
/end GROUP
/begin GROUP mcb_pmsm_foc_hall_f28379d_Current_Control_Input_Scaling_Read_Sensor__codegen__Calculate_Position_from_Hall_Atomic_Hall_Reading_Function_Call_Subsystem "mcb_pmsm_foc_hall_f28379d/Current Control/Input Scaling/Read_Sensor (codegen)/Calculate Position from Hall/Atomic Hall Reading/Function-Call\r\nSubsystem"
 /begin SUB_GROUP mcb_pmsm_foc_hall_f28379d_Current_Control_Input_Scaling_Read_Sensor__codegen__Calculate_Position_from_Hall_Atomic_Hall_Reading_Function_Call_Subsystem_Read_Halls /end SUB_GROUP
 /begin REF_MEASUREMENT mcb_pmsm_foc_hall_f28379d_B.BitwiseOperator2_p /end REF_MEASUREMENT
/end GROUP
/begin GROUP mcb_pmsm_foc_hall_f28379d_Current_Control_Input_Scaling_Read_Sensor__codegen__Calculate_Position_from_Hall_Atomic_Hall_Reading_Function_Call_Subsystem1 "mcb_pmsm_foc_hall_f28379d/Current Control/Input Scaling/Read_Sensor (codegen)/Calculate Position from Hall/Atomic Hall Reading/Function-Call\r\nSubsystem1"
 /begin REF_MEASUREMENT mcb_pmsm_foc_hall_f28379d_B.MemoryCopy mcb_pmsm_foc_hall_f28379d_B.MemoryCopy1 mcb_pmsm_foc_hall_f28379d_B.MemoryCopy2 mcb_pmsm_foc_hall_f28379d_B.Min /end REF_MEASUREMENT
/end GROUP
/begin GROUP mcb_pmsm_foc_hall_f28379d_Current_Control_Input_Scaling_Read_Sensor__codegen__Calculate_Position_from_Hall_Atomic_Hall_Reading_Function_Call_Subsystem_Read_Halls "mcb_pmsm_foc_hall_f28379d/Current Control/Input Scaling/Read_Sensor (codegen)/Calculate Position from Hall/Atomic Hall Reading/Function-Call\r\nSubsystem/Read Halls"
 /begin REF_MEASUREMENT mcb_pmsm_foc_hall_f28379d_B.BitwiseOperator2_p mcb_pmsm_foc_hall_f28379d_B.Hall_A_c mcb_pmsm_foc_hall_f28379d_B.Hall_B_f mcb_pmsm_foc_hall_f28379d_B.Hall_C_fc mcb_pmsm_foc_hall_f28379d_B.ReadGPIODATregister_nt mcb_pmsm_foc_hall_f28379d_B.ShiftArithmetic1_h mcb_pmsm_foc_hall_f28379d_B.ShiftArithmetic2_e mcb_pmsm_foc_hall_f28379d_B.ShiftArithmetic_p /end REF_MEASUREMENT
/end GROUP
/begin GROUP mcb_pmsm_foc_hall_f28379d_Current_Control_Input_Scaling_Read_Sensor__codegen__Calculate_Position_from_Hall_Atomic_Hall_Reading_Integrity_Check "mcb_pmsm_foc_hall_f28379d/Current Control/Input Scaling/Read_Sensor (codegen)/Calculate Position from Hall/Atomic Hall Reading/Integrity_Check"
 /begin SUB_GROUP mcb_pmsm_foc_hall_f28379d_Current_Control_Input_Scaling_Read_Sensor__codegen__Calculate_Position_from_Hall_Atomic_Hall_Reading_Integrity_Check_Compare_To_Constant mcb_pmsm_foc_hall_f28379d_Current_Control_Input_Scaling_Read_Sensor__codegen__Calculate_Position_from_Hall_Atomic_Hall_Reading_Integrity_Check_No_Integrity_issue mcb_pmsm_foc_hall_f28379d_Current_Control_Input_Scaling_Read_Sensor__codegen__Calculate_Position_from_Hall_Atomic_Hall_Reading_Integrity_Check_Refresh_Halls /end SUB_GROUP
 /begin REF_MEASUREMENT mcb_pmsm_foc_hall_f28379d_B.BitwiseOperator2_p mcb_pmsm_foc_hall_f28379d_B.Compare mcb_pmsm_foc_hall_f28379d_B.Merge mcb_pmsm_foc_hall_f28379d_B.NOT_b mcb_pmsm_foc_hall_f28379d_B.RelationalOperator_k mcb_pmsm_foc_hall_f28379d_B.UnitDelay mcb_pmsm_foc_hall_f28379d_DWork.UnitDelay_DSTATE /end REF_MEASUREMENT
/end GROUP
/begin GROUP mcb_pmsm_foc_hall_f28379d_Current_Control_Input_Scaling_Read_Sensor__codegen__Calculate_Position_from_Hall_Atomic_Hall_Reading_Integrity_Check_Compare_To_Constant "mcb_pmsm_foc_hall_f28379d/Current Control/Input Scaling/Read_Sensor (codegen)/Calculate Position from Hall/Atomic Hall Reading/Integrity_Check/Compare\r\nTo Constant"
 /begin REF_MEASUREMENT mcb_pmsm_foc_hall_f28379d_B.Compare mcb_pmsm_foc_hall_f28379d_B.Min /end REF_MEASUREMENT
/end GROUP
/begin GROUP mcb_pmsm_foc_hall_f28379d_Current_Control_Input_Scaling_Read_Sensor__codegen__Calculate_Position_from_Hall_Atomic_Hall_Reading_Integrity_Check_No_Integrity_issue "mcb_pmsm_foc_hall_f28379d/Current Control/Input Scaling/Read_Sensor (codegen)/Calculate Position from Hall/Atomic Hall Reading/Integrity_Check/No_Integrity_issue" /begin REF_MEASUREMENT mcb_pmsm_foc_hall_f28379d_B.Merge /end REF_MEASUREMENT /end GROUP
/begin GROUP mcb_pmsm_foc_hall_f28379d_Current_Control_Input_Scaling_Read_Sensor__codegen__Calculate_Position_from_Hall_Atomic_Hall_Reading_Integrity_Check_Refresh_Halls "mcb_pmsm_foc_hall_f28379d/Current Control/Input Scaling/Read_Sensor (codegen)/Calculate Position from Hall/Atomic Hall Reading/Integrity_Check/Refresh_Halls"
 /begin SUB_GROUP mcb_pmsm_foc_hall_f28379d_Current_Control_Input_Scaling_Read_Sensor__codegen__Calculate_Position_from_Hall_Atomic_Hall_Reading_Integrity_Check_Refresh_Halls_Read_Halls /end SUB_GROUP
/end GROUP
/begin GROUP mcb_pmsm_foc_hall_f28379d_Current_Control_Input_Scaling_Read_Sensor__codegen__Calculate_Position_from_Hall_Atomic_Hall_Reading_Integrity_Check_Refresh_Halls_Read_Halls "mcb_pmsm_foc_hall_f28379d/Current Control/Input Scaling/Read_Sensor (codegen)/Calculate Position from Hall/Atomic Hall Reading/Integrity_Check/Refresh_Halls/Read Halls"
 /begin REF_MEASUREMENT mcb_pmsm_foc_hall_f28379d_B.BitwiseOperator2_g mcb_pmsm_foc_hall_f28379d_B.Hall_A_d mcb_pmsm_foc_hall_f28379d_B.Hall_B_e mcb_pmsm_foc_hall_f28379d_B.Hall_C_e mcb_pmsm_foc_hall_f28379d_B.ReadGPIODATregister_p mcb_pmsm_foc_hall_f28379d_B.ShiftArithmetic1_c mcb_pmsm_foc_hall_f28379d_B.ShiftArithmetic2_kn mcb_pmsm_foc_hall_f28379d_B.ShiftArithmetic_l /end REF_MEASUREMENT
/end GROUP
/begin GROUP mcb_pmsm_foc_hall_f28379d_Current_Control_Input_Scaling_Read_Sensor__codegen__Calculate_Position_from_Hall_Glitch_Filter "mcb_pmsm_foc_hall_f28379d/Current Control/Input Scaling/Read_Sensor (codegen)/Calculate Position from Hall/Glitch Filter"
 /begin REF_MEASUREMENT mcb_pmsm_foc_hall_f28379d_B.Compare_e mcb_pmsm_foc_hall_f28379d_B.DataStoreRead2 /end REF_MEASUREMENT
/end GROUP
/begin GROUP mcb_pmsm_foc_hall_f28379d_Current_Control_Input_Scaling_Read_Sensor__codegen__Calculate_Position_from_Hall_Hall_Speed_and_Position "mcb_pmsm_foc_hall_f28379d/Current Control/Input Scaling/Read_Sensor (codegen)/Calculate Position from Hall/Hall Speed and Position"
 /begin SUB_GROUP mcb_pmsm_foc_hall_f28379d_Current_Control_Input_Scaling_Read_Sensor__codegen__Calculate_Position_from_Hall_Hall_Speed_and_Position_ExtrapolationOrder mcb_pmsm_foc_hall_f28379d_Current_Control_Input_Scaling_Read_Sensor__codegen__Calculate_Position_from_Hall_Hall_Speed_and_Position_Software_Watchdog_Timer mcb_pmsm_foc_hall_f28379d_Current_Control_Input_Scaling_Read_Sensor__codegen__Calculate_Position_from_Hall_Hall_Speed_and_Position_Speed_and_direction_are_not_valid_Position_will_be_set_to_the_middle_of_the_Hall_quadrant mcb_pmsm_foc_hall_f28379d_Current_Control_Input_Scaling_Read_Sensor__codegen__Calculate_Position_from_Hall_Hall_Speed_and_Position_Speed_and_direction_are_valid_Use_speed_to_extrapolate_position mcb_pmsm_foc_hall_f28379d_Current_Control_Input_Scaling_Read_Sensor__codegen__Calculate_Position_from_Hall_Hall_Speed_and_Position_VaidityCheck /end SUB_GROUP
 /begin REF_MEASUREMENT mcb_pmsm_foc_hall_f28379d_B.DataStoreRead5 mcb_pmsm_foc_hall_f28379d_B.DataTypeConversion4_k mcb_pmsm_foc_hall_f28379d_B.Merge1 mcb_pmsm_foc_hall_f28379d_B.Merge_d mcb_pmsm_foc_hall_f28379d_B.Switch_a mcb_pmsm_foc_hall_f28379d_B.watchdogcheck /end REF_MEASUREMENT
/end GROUP
/begin GROUP mcb_pmsm_foc_hall_f28379d_Current_Control_Input_Scaling_Read_Sensor__codegen__Calculate_Position_from_Hall_Hall_Speed_and_Position_ExtrapolationOrder "mcb_pmsm_foc_hall_f28379d/Current Control/Input Scaling/Read_Sensor (codegen)/Calculate Position from Hall/Hall Speed and Position/ExtrapolationOrder"
 /begin REF_MEASUREMENT mcb_pmsm_foc_hall_f28379d_B.DataStoreRead4 mcb_pmsm_foc_hall_f28379d_B.DataStoreRead5 mcb_pmsm_foc_hall_f28379d_B.DataTypeConversion_nh mcb_pmsm_foc_hall_f28379d_B.Input mcb_pmsm_foc_hall_f28379d_B.LogicalOperator_a mcb_pmsm_foc_hall_f28379d_B.Switch_m mcb_pmsm_foc_hall_f28379d_B.speedCountDelay mcb_pmsm_foc_hall_f28379d_B.validityDelay /end REF_MEASUREMENT
/end GROUP
/begin GROUP mcb_pmsm_foc_hall_f28379d_Current_Control_Input_Scaling_Read_Sensor__codegen__Calculate_Position_from_Hall_Hall_Speed_and_Position_Software_Watchdog_Timer "mcb_pmsm_foc_hall_f28379d/Current Control/Input Scaling/Read_Sensor (codegen)/Calculate Position from Hall/Hall Speed and Position/Software Watchdog Timer"
 /begin SUB_GROUP mcb_pmsm_foc_hall_f28379d_Current_Control_Input_Scaling_Read_Sensor__codegen__Calculate_Position_from_Hall_Hall_Speed_and_Position_Software_Watchdog_Timer_Compare_To_Zero /end SUB_GROUP
 /begin REF_MEASUREMENT mcb_pmsm_foc_hall_f28379d_B.Compare_n mcb_pmsm_foc_hall_f28379d_B.DataTypeConversion4_k mcb_pmsm_foc_hall_f28379d_B.DelayOneStep mcb_pmsm_foc_hall_f28379d_B.DelayOneStep1 mcb_pmsm_foc_hall_f28379d_B.OR mcb_pmsm_foc_hall_f28379d_B.Sum_m3 mcb_pmsm_foc_hall_f28379d_DWork.DelayOneStep1_DSTATE mcb_pmsm_foc_hall_f28379d_DWork.DelayOneStep_DSTATE /end REF_MEASUREMENT
/end GROUP
/begin GROUP mcb_pmsm_foc_hall_f28379d_Current_Control_Input_Scaling_Read_Sensor__codegen__Calculate_Position_from_Hall_Hall_Speed_and_Position_Software_Watchdog_Timer_Compare_To_Zero "mcb_pmsm_foc_hall_f28379d/Current Control/Input Scaling/Read_Sensor (codegen)/Calculate Position from Hall/Hall Speed and Position/Software Watchdog Timer/Compare\r\nTo Zero"
 /begin REF_MEASUREMENT mcb_pmsm_foc_hall_f28379d_B.Compare_n mcb_pmsm_foc_hall_f28379d_B.DelayOneStep /end REF_MEASUREMENT
/end GROUP
/begin GROUP mcb_pmsm_foc_hall_f28379d_Current_Control_Input_Scaling_Read_Sensor__codegen__Calculate_Position_from_Hall_Hall_Speed_and_Position_Speed_and_direction_are_not_valid_Position_will_be_set_to_the_middle_of_the_Hall_quadrant "mcb_pmsm_foc_hall_f28379d/Current Control/Input Scaling/Read_Sensor (codegen)/Calculate Position from Hall/Hall Speed and Position/Speed and direction are not valid\r\nPosition will be set to the middle of the Hall quadrant"
 /begin SUB_GROUP mcb_pmsm_foc_hall_f28379d_Current_Control_Input_Scaling_Read_Sensor__codegen__Calculate_Position_from_Hall_Hall_Speed_and_Position_Speed_and_direction_are_not_valid_Position_will_be_set_to_the_middle_of_the_Hall_quadrant_independent_Direction /end SUB_GROUP
/end GROUP
/begin GROUP mcb_pmsm_foc_hall_f28379d_Current_Control_Input_Scaling_Read_Sensor__codegen__Calculate_Position_from_Hall_Hall_Speed_and_Position_Speed_and_direction_are_not_valid_Position_will_be_set_to_the_middle_of_the_Hall_quadrant_independent_Direction "mcb_pmsm_foc_hall_f28379d/Current Control/Input Scaling/Read_Sensor (codegen)/Calculate Position from Hall/Hall Speed and Position/Speed and direction are not valid\r\nPosition will be set to the middle of the Hall quadrant/independent Direction"
 /begin REF_MEASUREMENT mcb_pmsm_foc_hall_f28379d_B.Merge mcb_pmsm_foc_hall_f28379d_B.Merge1 /end REF_MEASUREMENT
/end GROUP
/begin GROUP mcb_pmsm_foc_hall_f28379d_Current_Control_Input_Scaling_Read_Sensor__codegen__Calculate_Position_from_Hall_Hall_Speed_and_Position_Speed_and_direction_are_valid_Use_speed_to_extrapolate_position "mcb_pmsm_foc_hall_f28379d/Current Control/Input Scaling/Read_Sensor (codegen)/Calculate Position from Hall/Hall Speed and Position/Speed and direction are valid\r\nUse speed to extrapolate position"
 /begin SUB_GROUP mcb_pmsm_foc_hall_f28379d_Current_Control_Input_Scaling_Read_Sensor__codegen__Calculate_Position_from_Hall_Hall_Speed_and_Position_Speed_and_direction_are_valid_Use_speed_to_extrapolate_position_If_Action_Subsystem mcb_pmsm_foc_hall_f28379d_Current_Control_Input_Scaling_Read_Sensor__codegen__Calculate_Position_from_Hall_Hall_Speed_and_Position_Speed_and_direction_are_valid_Use_speed_to_extrapolate_position_If_Action_Subsystem1 mcb_pmsm_foc_hall_f28379d_Current_Control_Input_Scaling_Read_Sensor__codegen__Calculate_Position_from_Hall_Hall_Speed_and_Position_Speed_and_direction_are_valid_Use_speed_to_extrapolate_position_Subsystem1 /end SUB_GROUP
 /begin REF_MEASUREMENT mcb_pmsm_foc_hall_f28379d_B.DataStoreRead3 mcb_pmsm_foc_hall_f28379d_B.Divide mcb_pmsm_foc_hall_f28379d_B.Input mcb_pmsm_foc_hall_f28379d_B.Merge_d mcb_pmsm_foc_hall_f28379d_B.SpeedGain mcb_pmsm_foc_hall_f28379d_B.currentSpeedData /end REF_MEASUREMENT
/end GROUP
/begin GROUP mcb_pmsm_foc_hall_f28379d_Current_Control_Input_Scaling_Read_Sensor__codegen__Calculate_Position_from_Hall_Hall_Speed_and_Position_Speed_and_direction_are_valid_Use_speed_to_extrapolate_position_If_Action_Subsystem "mcb_pmsm_foc_hall_f28379d/Current Control/Input Scaling/Read_Sensor (codegen)/Calculate Position from Hall/Hall Speed and Position/Speed and direction are valid\r\nUse speed to extrapolate position/If Action\r\nSubsystem" /begin REF_MEASUREMENT mcb_pmsm_foc_hall_f28379d_B.Merge_d /end REF_MEASUREMENT /end GROUP
/begin GROUP mcb_pmsm_foc_hall_f28379d_Current_Control_Input_Scaling_Read_Sensor__codegen__Calculate_Position_from_Hall_Hall_Speed_and_Position_Speed_and_direction_are_valid_Use_speed_to_extrapolate_position_If_Action_Subsystem1 "mcb_pmsm_foc_hall_f28379d/Current Control/Input Scaling/Read_Sensor (codegen)/Calculate Position from Hall/Hall Speed and Position/Speed and direction are valid\r\nUse speed to extrapolate position/If Action\r\nSubsystem1"
 /begin REF_MEASUREMENT mcb_pmsm_foc_hall_f28379d_B.Merge_d mcb_pmsm_foc_hall_f28379d_B.SpeedGain /end REF_MEASUREMENT
/end GROUP
/begin GROUP mcb_pmsm_foc_hall_f28379d_Current_Control_Input_Scaling_Read_Sensor__codegen__Calculate_Position_from_Hall_Hall_Speed_and_Position_Speed_and_direction_are_valid_Use_speed_to_extrapolate_position_Subsystem1 "mcb_pmsm_foc_hall_f28379d/Current Control/Input Scaling/Read_Sensor (codegen)/Calculate Position from Hall/Hall Speed and Position/Speed and direction are valid\r\nUse speed to extrapolate position/Subsystem1"
 /begin SUB_GROUP mcb_pmsm_foc_hall_f28379d_Current_Control_Input_Scaling_Read_Sensor__codegen__Calculate_Position_from_Hall_Hall_Speed_and_Position_Speed_and_direction_are_valid_Use_speed_to_extrapolate_position_Subsystem1__ve_Direction mcb_pmsm_foc_hall_f28379d_Current_Control_Input_Scaling_Read_Sensor__codegen__Calculate_Position_from_Hall_Hall_Speed_and_Position_Speed_and_direction_are_valid_Use_speed_to_extrapolate_position_Subsystem1_first_order mcb_pmsm_foc_hall_f28379d_Current_Control_Input_Scaling_Read_Sensor__codegen__Calculate_Position_from_Hall_Hall_Speed_and_Position_Speed_and_direction_are_valid_Use_speed_to_extrapolate_position_Subsystem1_second_order /end SUB_GROUP
 /begin REF_MEASUREMENT mcb_pmsm_foc_hall_f28379d_B.DataStoreRead3 mcb_pmsm_foc_hall_f28379d_B.Merge1_l mcb_pmsm_foc_hall_f28379d_B.Merge_c mcb_pmsm_foc_hall_f28379d_B.Saturation_k /end REF_MEASUREMENT
/end GROUP
/begin GROUP mcb_pmsm_foc_hall_f28379d_Current_Control_Input_Scaling_Read_Sensor__codegen__Calculate_Position_from_Hall_Hall_Speed_and_Position_Speed_and_direction_are_valid_Use_speed_to_extrapolate_position_Subsystem1__ve_Direction "mcb_pmsm_foc_hall_f28379d/Current Control/Input Scaling/Read_Sensor (codegen)/Calculate Position from Hall/Hall Speed and Position/Speed and direction are valid\r\nUse speed to extrapolate position/Subsystem1/+ve Direction"
 /begin REF_MEASUREMENT mcb_pmsm_foc_hall_f28379d_B.Merge mcb_pmsm_foc_hall_f28379d_B.Merge1_la mcb_pmsm_foc_hall_f28379d_B.Merge_c mcb_pmsm_foc_hall_f28379d_B.Saturation_k /end REF_MEASUREMENT
/end GROUP
/begin GROUP mcb_pmsm_foc_hall_f28379d_Current_Control_Input_Scaling_Read_Sensor__codegen__Calculate_Position_from_Hall_Hall_Speed_and_Position_Speed_and_direction_are_valid_Use_speed_to_extrapolate_position_Subsystem1_first_order "mcb_pmsm_foc_hall_f28379d/Current Control/Input Scaling/Read_Sensor (codegen)/Calculate Position from Hall/Hall Speed and Position/Speed and direction are valid\r\nUse speed to extrapolate position/Subsystem1/first_order"
 /begin REF_MEASUREMENT mcb_pmsm_foc_hall_f28379d_B.Divide_f mcb_pmsm_foc_hall_f28379d_B.Input mcb_pmsm_foc_hall_f28379d_B.Merge1_l mcb_pmsm_foc_hall_f28379d_B.Min mcb_pmsm_foc_hall_f28379d_B.countData mcb_pmsm_foc_hall_f28379d_B.currentSpeedData_k /end REF_MEASUREMENT
/end GROUP
/begin GROUP mcb_pmsm_foc_hall_f28379d_Current_Control_Input_Scaling_Read_Sensor__codegen__Calculate_Position_from_Hall_Hall_Speed_and_Position_Speed_and_direction_are_valid_Use_speed_to_extrapolate_position_Subsystem1_second_order "mcb_pmsm_foc_hall_f28379d/Current Control/Input Scaling/Read_Sensor (codegen)/Calculate Position from Hall/Hall Speed and Position/Speed and direction are valid\r\nUse speed to extrapolate position/Subsystem1/second_order"
 /begin REF_MEASUREMENT mcb_pmsm_foc_hall_f28379d_B.Divide1 mcb_pmsm_foc_hall_f28379d_B.Divide_i mcb_pmsm_foc_hall_f28379d_B.Gain1_g mcb_pmsm_foc_hall_f28379d_B.Input mcb_pmsm_foc_hall_f28379d_B.Merge1_l mcb_pmsm_foc_hall_f28379d_B.Min mcb_pmsm_foc_hall_f28379d_B.Product_i mcb_pmsm_foc_hall_f28379d_B.Sum1_i mcb_pmsm_foc_hall_f28379d_B.Sum_n mcb_pmsm_foc_hall_f28379d_B.countData_o mcb_pmsm_foc_hall_f28379d_B.currentSpeedData_o mcb_pmsm_foc_hall_f28379d_B.previousSpeedData mcb_pmsm_foc_hall_f28379d_B.speedCountDelay /end REF_MEASUREMENT
/end GROUP
/begin GROUP mcb_pmsm_foc_hall_f28379d_Current_Control_Input_Scaling_Read_Sensor__codegen__Calculate_Position_from_Hall_Hall_Speed_and_Position_VaidityCheck "mcb_pmsm_foc_hall_f28379d/Current Control/Input Scaling/Read_Sensor (codegen)/Calculate Position from Hall/Hall Speed and Position/VaidityCheck"
 /begin REF_MEASUREMENT mcb_pmsm_foc_hall_f28379d_B.Compare_n mcb_pmsm_foc_hall_f28379d_B.Input mcb_pmsm_foc_hall_f28379d_B.LogicalOperator_a mcb_pmsm_foc_hall_f28379d_B.Max mcb_pmsm_foc_hall_f28379d_B.Min mcb_pmsm_foc_hall_f28379d_B.speedcheck mcb_pmsm_foc_hall_f28379d_B.watchdogcheck /end REF_MEASUREMENT
/end GROUP
/begin GROUP mcb_pmsm_foc_hall_f28379d_Current_Control_Input_Scaling_Read_Sensor__codegen__Calculate_Position_from_Hall_Mechanical_to_Electrical_Position1 "mcb_pmsm_foc_hall_f28379d/Current Control/Input Scaling/Read_Sensor (codegen)/Calculate Position from Hall/Mechanical to Electrical Position1"
 /begin SUB_GROUP mcb_pmsm_foc_hall_f28379d_Current_Control_Input_Scaling_Read_Sensor__codegen__Calculate_Position_from_Hall_Mechanical_to_Electrical_Position1_MechToElec /end SUB_GROUP
/end GROUP
/begin GROUP mcb_pmsm_foc_hall_f28379d_Current_Control_Input_Scaling_Read_Sensor__codegen__Calculate_Position_from_Hall_Mechanical_to_Electrical_Position1_MechToElec "mcb_pmsm_foc_hall_f28379d/Current Control/Input Scaling/Read_Sensor (codegen)/Calculate Position from Hall/Mechanical to Electrical Position1/MechToElec"
 /begin SUB_GROUP mcb_pmsm_foc_hall_f28379d_Current_Control_Input_Scaling_Read_Sensor__codegen__Calculate_Position_from_Hall_Mechanical_to_Electrical_Position1_MechToElec_floating_point /end SUB_GROUP
/end GROUP
/begin GROUP mcb_pmsm_foc_hall_f28379d_Current_Control_Input_Scaling_Read_Sensor__codegen__Calculate_Position_from_Hall_Mechanical_to_Electrical_Position1_MechToElec_floating_point "mcb_pmsm_foc_hall_f28379d/Current Control/Input Scaling/Read_Sensor (codegen)/Calculate Position from Hall/Mechanical to Electrical Position1/MechToElec/floating-point"
 /begin SUB_GROUP mcb_pmsm_foc_hall_f28379d_Current_Control_Input_Scaling_Read_Sensor__codegen__Calculate_Position_from_Hall_Mechanical_to_Electrical_Position1_MechToElec_floating_point_Compensate_Offset mcb_pmsm_foc_hall_f28379d_Current_Control_Input_Scaling_Read_Sensor__codegen__Calculate_Position_from_Hall_Mechanical_to_Electrical_Position1_MechToElec_floating_point_Mech_To_Elec /end SUB_GROUP
 /begin REF_MEASUREMENT mcb_pmsm_foc_hall_f28379d_B.Switch_h /end REF_MEASUREMENT
/end GROUP
/begin GROUP mcb_pmsm_foc_hall_f28379d_Current_Control_Input_Scaling_Read_Sensor__codegen__Calculate_Position_from_Hall_Mechanical_to_Electrical_Position1_MechToElec_floating_point_Compensate_Offset "mcb_pmsm_foc_hall_f28379d/Current Control/Input Scaling/Read_Sensor (codegen)/Calculate Position from Hall/Mechanical to Electrical Position1/MechToElec/floating-point/Compensate Offset"
 /begin SUB_GROUP mcb_pmsm_foc_hall_f28379d_Current_Control_Input_Scaling_Read_Sensor__codegen__Calculate_Position_from_Hall_Mechanical_to_Electrical_Position1_MechToElec_floating_point_Compensate_Offset_If_Action_Subsystem mcb_pmsm_foc_hall_f28379d_Current_Control_Input_Scaling_Read_Sensor__codegen__Calculate_Position_from_Hall_Mechanical_to_Electrical_Position1_MechToElec_floating_point_Compensate_Offset_If_Action_Subsystem1 /end SUB_GROUP
 /begin REF_MEASUREMENT mcb_pmsm_foc_hall_f28379d_B.Merge1 mcb_pmsm_foc_hall_f28379d_B.Merge_m mcb_pmsm_foc_hall_f28379d_B.Switch_h /end REF_MEASUREMENT
/end GROUP
/begin GROUP mcb_pmsm_foc_hall_f28379d_Current_Control_Input_Scaling_Read_Sensor__codegen__Calculate_Position_from_Hall_Mechanical_to_Electrical_Position1_MechToElec_floating_point_Compensate_Offset_If_Action_Subsystem "mcb_pmsm_foc_hall_f28379d/Current Control/Input Scaling/Read_Sensor (codegen)/Calculate Position from Hall/Mechanical to Electrical Position1/MechToElec/floating-point/Compensate Offset/If Action\r\nSubsystem"
 /begin REF_MEASUREMENT mcb_pmsm_foc_hall_f28379d_B.Merge1 mcb_pmsm_foc_hall_f28379d_B.Merge_m mcb_pmsm_foc_hall_f28379d_B.Switch_h /end REF_MEASUREMENT
/end GROUP
/begin GROUP mcb_pmsm_foc_hall_f28379d_Current_Control_Input_Scaling_Read_Sensor__codegen__Calculate_Position_from_Hall_Mechanical_to_Electrical_Position1_MechToElec_floating_point_Compensate_Offset_If_Action_Subsystem1 "mcb_pmsm_foc_hall_f28379d/Current Control/Input Scaling/Read_Sensor (codegen)/Calculate Position from Hall/Mechanical to Electrical Position1/MechToElec/floating-point/Compensate Offset/If Action\r\nSubsystem1"
 /begin REF_MEASUREMENT mcb_pmsm_foc_hall_f28379d_B.Merge1 mcb_pmsm_foc_hall_f28379d_B.Merge_m mcb_pmsm_foc_hall_f28379d_B.Switch_h /end REF_MEASUREMENT
/end GROUP
/begin GROUP mcb_pmsm_foc_hall_f28379d_Current_Control_Input_Scaling_Read_Sensor__codegen__Calculate_Position_from_Hall_Mechanical_to_Electrical_Position1_MechToElec_floating_point_Mech_To_Elec "mcb_pmsm_foc_hall_f28379d/Current Control/Input Scaling/Read_Sensor (codegen)/Calculate Position from Hall/Mechanical to Electrical Position1/MechToElec/floating-point/Mech To Elec"
 /begin REF_MEASUREMENT mcb_pmsm_foc_hall_f28379d_B.Add mcb_pmsm_foc_hall_f28379d_B.Floor mcb_pmsm_foc_hall_f28379d_B.Merge_m /end REF_MEASUREMENT
/end GROUP
/begin GROUP mcb_pmsm_foc_hall_f28379d_Current_Control_Input_Scaling_Read_Sensor__codegen__Calculate_Position_from_Hall_Subsystem "mcb_pmsm_foc_hall_f28379d/Current Control/Input Scaling/Read_Sensor (codegen)/Calculate Position from Hall/Subsystem" /begin REF_MEASUREMENT mcb_pmsm_foc_hall_f28379d_B.Input /end REF_MEASUREMENT /end GROUP
/begin GROUP mcb_pmsm_foc_hall_f28379d_Current_Control_Input_Scaling_Read_Sensor__codegen__Convert_ADC_value_to_PU "mcb_pmsm_foc_hall_f28379d/Current Control/Input Scaling/Read_Sensor (codegen)/Convert ADC value to PU"
 /begin SUB_GROUP mcb_pmsm_foc_hall_f28379d_Current_Control_Input_Scaling_Read_Sensor__codegen__Convert_ADC_value_to_PU_Data_Type /end SUB_GROUP
 /begin REF_MEASUREMENT mcb_pmsm_foc_hall_f28379d_B.Add_f mcb_pmsm_foc_hall_f28379d_B.DataStoreRead1 mcb_pmsm_foc_hall_f28379d_B.DataStoreRead_k mcb_pmsm_foc_hall_f28379d_B.DataTypeConversion_f mcb_pmsm_foc_hall_f28379d_DWork.Add_DWORK1 mcb_pmsm_foc_hall_f28379d_DWork.IaOffset mcb_pmsm_foc_hall_f28379d_DWork.IbOffset /end REF_MEASUREMENT
/end GROUP
/begin GROUP mcb_pmsm_foc_hall_f28379d_Current_Control_Input_Scaling_Read_Sensor__codegen__Convert_ADC_value_to_PU_Data_Type "mcb_pmsm_foc_hall_f28379d/Current Control/Input Scaling/Read_Sensor (codegen)/Convert ADC value to PU/Data_Type"
 /begin SUB_GROUP mcb_pmsm_foc_hall_f28379d_Current_Control_Input_Scaling_Read_Sensor__codegen__Convert_ADC_value_to_PU_Data_Type_Data_Type_Float /end SUB_GROUP
/end GROUP
/begin GROUP mcb_pmsm_foc_hall_f28379d_Current_Control_Input_Scaling_Read_Sensor__codegen__Convert_ADC_value_to_PU_Data_Type_Data_Type_Float "mcb_pmsm_foc_hall_f28379d/Current Control/Input Scaling/Read_Sensor (codegen)/Convert ADC value to PU/Data_Type/Data_Type_Float"
 /begin REF_MEASUREMENT mcb_pmsm_foc_hall_f28379d_B.Add_f mcb_pmsm_foc_hall_f28379d_B.GetADCVoltage mcb_pmsm_foc_hall_f28379d_B.GetCurrents mcb_pmsm_foc_hall_f28379d_B.PU_Conversion /end REF_MEASUREMENT
/end GROUP
/begin GROUP mcb_pmsm_foc_hall_f28379d_Current_Control_Inverter "mcb_pmsm_foc_hall_f28379d/Current Control/Inverter"
 /begin SUB_GROUP mcb_pmsm_foc_hall_f28379d_Current_Control_Inverter_Code_Generation /end SUB_GROUP
/end GROUP
/begin GROUP mcb_pmsm_foc_hall_f28379d_Current_Control_Inverter_Code_Generation "mcb_pmsm_foc_hall_f28379d/Current Control/Inverter/Code Generation"
 /begin REF_MEASUREMENT mcb_pmsm_foc_hall_f28379d_B.DataTypeConversion mcb_pmsm_foc_hall_f28379d_B.PWM_Duty_Cycles mcb_pmsm_foc_hall_f28379d_B.Scale_to_PWM_Counter_PRD mcb_pmsm_foc_hall_f28379d_B.Switch1_f mcb_pmsm_foc_hall_f28379d_B.Switch_f mcb_pmsm_foc_hall_f28379d_DWork.InverterEnable_FRAC_LEN /end REF_MEASUREMENT
/end GROUP
/begin GROUP mcb_pmsm_foc_hall_f28379d_Current_Control_Output_Scaling "mcb_pmsm_foc_hall_f28379d/Current Control/Output Scaling"
 /begin REF_MEASUREMENT mcb_pmsm_foc_hall_f28379d_B.DataTypeConversion mcb_pmsm_foc_hall_f28379d_B.Enable mcb_pmsm_foc_hall_f28379d_B.Gain_m mcb_pmsm_foc_hall_f28379d_B.Gain_o mcb_pmsm_foc_hall_f28379d_B.PWM_Duty_Cycles mcb_pmsm_foc_hall_f28379d_DWork.Enable /end REF_MEASUREMENT
/end GROUP
/begin GROUP mcb_pmsm_foc_hall_f28379d_Current_Control_Sensor_Driver_Blocks "mcb_pmsm_foc_hall_f28379d/Current Control/Sensor Driver Blocks"
 /begin SUB_GROUP mcb_pmsm_foc_hall_f28379d_Current_Control_Sensor_Driver_Blocks_Sensor_Driver_Blocks__codegen_ /end SUB_GROUP
/end GROUP
/begin GROUP mcb_pmsm_foc_hall_f28379d_Current_Control_Sensor_Driver_Blocks_Sensor_Driver_Blocks__codegen_ "mcb_pmsm_foc_hall_f28379d/Current Control/Sensor Driver Blocks/Sensor Driver Blocks (codegen)"
 /begin REF_MEASUREMENT mcb_pmsm_foc_hall_f28379d_B.ADC_B_IN2 mcb_pmsm_foc_hall_f28379d_B.ADC_C_IN2 /end REF_MEASUREMENT
/end GROUP
/begin GROUP mcb_pmsm_foc_hall_f28379d_Hall_Sensor_A "mcb_pmsm_foc_hall_f28379d/Hall Sensor A"
 /begin SUB_GROUP mcb_pmsm_foc_hall_f28379d_Hall_Sensor_A_Capture_Event_Selection mcb_pmsm_foc_hall_f28379d_Hall_Sensor_A_HallValidity mcb_pmsm_foc_hall_f28379d_Hall_Sensor_A_Hall_Validity mcb_pmsm_foc_hall_f28379d_Hall_Sensor_A_eCAP /end SUB_GROUP
 /begin REF_MEASUREMENT mcb_pmsm_foc_hall_f28379d_B.BitwiseOperator2_n mcb_pmsm_foc_hall_f28379d_B.DataStoreRead1_o mcb_pmsm_foc_hall_f28379d_B.DataStoreRead_p mcb_pmsm_foc_hall_f28379d_B.DataTypeConversion_p mcb_pmsm_foc_hall_f28379d_B.Merge1_kl mcb_pmsm_foc_hall_f28379d_B.Merge_n mcb_pmsm_foc_hall_f28379d_B.Switch_e mcb_pmsm_foc_hall_f28379d_B.eCAP_l mcb_pmsm_foc_hall_f28379d_DWork.GlobalDirection mcb_pmsm_foc_hall_f28379d_DWork.GlobalHallState mcb_pmsm_foc_hall_f28379d_DWork.GlobalSpeedCount mcb_pmsm_foc_hall_f28379d_DWork.GlobalSpeedValidity mcb_pmsm_foc_hall_f28379d_DWork.HallStateChangeFlag /end REF_MEASUREMENT
/end GROUP
/begin GROUP mcb_pmsm_foc_hall_f28379d_Hall_Sensor_A_Capture_Event_Selection "mcb_pmsm_foc_hall_f28379d/Hall Sensor A/Capture Event Selection"
 /begin REF_MEASUREMENT mcb_pmsm_foc_hall_f28379d_B.BitwiseOperator2_n mcb_pmsm_foc_hall_f28379d_B.Merge_n /end REF_MEASUREMENT
/end GROUP
/begin GROUP mcb_pmsm_foc_hall_f28379d_Hall_Sensor_A_HallValidity "mcb_pmsm_foc_hall_f28379d/Hall Sensor A/HallValidity"
 /begin SUB_GROUP mcb_pmsm_foc_hall_f28379d_Hall_Sensor_A_HallValidity_CodeGen /end SUB_GROUP
/end GROUP
/begin GROUP mcb_pmsm_foc_hall_f28379d_Hall_Sensor_A_HallValidity_CodeGen "mcb_pmsm_foc_hall_f28379d/Hall Sensor A/HallValidity/CodeGen"
 /begin SUB_GROUP mcb_pmsm_foc_hall_f28379d_Hall_Sensor_A_HallValidity_CodeGen_Read_Halls /end SUB_GROUP
/end GROUP
/begin GROUP mcb_pmsm_foc_hall_f28379d_Hall_Sensor_A_HallValidity_CodeGen_Read_Halls "mcb_pmsm_foc_hall_f28379d/Hall Sensor A/HallValidity/CodeGen/Read Halls"
 /begin REF_MEASUREMENT mcb_pmsm_foc_hall_f28379d_B.BitwiseOperator2_n mcb_pmsm_foc_hall_f28379d_B.Hall_A_k mcb_pmsm_foc_hall_f28379d_B.Hall_B_i mcb_pmsm_foc_hall_f28379d_B.Hall_C_n mcb_pmsm_foc_hall_f28379d_B.ReadGPIODATregister_g mcb_pmsm_foc_hall_f28379d_B.ShiftArithmetic1_jb mcb_pmsm_foc_hall_f28379d_B.ShiftArithmetic2_i mcb_pmsm_foc_hall_f28379d_B.ShiftArithmetic_e /end REF_MEASUREMENT
/end GROUP
/begin GROUP mcb_pmsm_foc_hall_f28379d_Hall_Sensor_A_Hall_Validity "mcb_pmsm_foc_hall_f28379d/Hall Sensor A/Hall Validity"
 /begin SUB_GROUP mcb_pmsm_foc_hall_f28379d_Hall_Sensor_A_Hall_Validity_Subsystem /end SUB_GROUP
 /begin REF_MEASUREMENT mcb_pmsm_foc_hall_f28379d_B.BitwiseOperator2_n mcb_pmsm_foc_hall_f28379d_B.DataStoreRead_p mcb_pmsm_foc_hall_f28379d_B.DataTypeConversion1_d mcb_pmsm_foc_hall_f28379d_B.DataTypeConversion2_c /end REF_MEASUREMENT
/end GROUP
/begin GROUP mcb_pmsm_foc_hall_f28379d_Hall_Sensor_A_Hall_Validity_Subsystem "mcb_pmsm_foc_hall_f28379d/Hall Sensor A/Hall Validity/Subsystem"
 /begin SUB_GROUP mcb_pmsm_foc_hall_f28379d_Hall_Sensor_A_Hall_Validity_Subsystem_Bad_hall__glitch_or_wrong_connection_ mcb_pmsm_foc_hall_f28379d_Hall_Sensor_A_Hall_Validity_Subsystem_Valid_Halls /end SUB_GROUP
 /begin REF_MEASUREMENT mcb_pmsm_foc_hall_f28379d_B.DataTypeConversion_p mcb_pmsm_foc_hall_f28379d_B.Merge1_kl mcb_pmsm_foc_hall_f28379d_B.Merge3_m mcb_pmsm_foc_hall_f28379d_B.Merge_k /end REF_MEASUREMENT
/end GROUP
/begin GROUP mcb_pmsm_foc_hall_f28379d_Hall_Sensor_A_Hall_Validity_Subsystem_Bad_hall__glitch_or_wrong_connection_ "mcb_pmsm_foc_hall_f28379d/Hall Sensor A/Hall Validity/Subsystem/Bad hall\r\n(glitch or wrong connection)"
 /begin REF_MEASUREMENT mcb_pmsm_foc_hall_f28379d_B.DataStoreRead1_o mcb_pmsm_foc_hall_f28379d_B.Merge1_kl /end REF_MEASUREMENT
/end GROUP
/begin GROUP mcb_pmsm_foc_hall_f28379d_Hall_Sensor_A_Hall_Validity_Subsystem_Valid_Halls "mcb_pmsm_foc_hall_f28379d/Hall Sensor A/Hall Validity/Subsystem/Valid Halls"
 /begin REF_MEASUREMENT mcb_pmsm_foc_hall_f28379d_B.DataStoreRead1_o mcb_pmsm_foc_hall_f28379d_B.DataTypeConversion1_d mcb_pmsm_foc_hall_f28379d_B.DataTypeConversion2_c mcb_pmsm_foc_hall_f28379d_B.Merge1_kl mcb_pmsm_foc_hall_f28379d_B.Merge3_m mcb_pmsm_foc_hall_f28379d_B.Merge_k /end REF_MEASUREMENT
/end GROUP
/begin GROUP mcb_pmsm_foc_hall_f28379d_Hall_Sensor_A_eCAP "mcb_pmsm_foc_hall_f28379d/Hall Sensor A/eCAP"
 /begin SUB_GROUP mcb_pmsm_foc_hall_f28379d_Hall_Sensor_A_eCAP_Code_generation /end SUB_GROUP
/end GROUP
/begin GROUP mcb_pmsm_foc_hall_f28379d_Hall_Sensor_A_eCAP_Code_generation "mcb_pmsm_foc_hall_f28379d/Hall Sensor A/eCAP/Code generation" /begin REF_MEASUREMENT mcb_pmsm_foc_hall_f28379d_B.eCAP_l /end REF_MEASUREMENT /end GROUP
/begin GROUP mcb_pmsm_foc_hall_f28379d_Hall_Sensor_B "mcb_pmsm_foc_hall_f28379d/Hall Sensor B"
 /begin SUB_GROUP mcb_pmsm_foc_hall_f28379d_Hall_Sensor_B_Capture_Event_Selection mcb_pmsm_foc_hall_f28379d_Hall_Sensor_B_HallValidity mcb_pmsm_foc_hall_f28379d_Hall_Sensor_B_Hall_Validity mcb_pmsm_foc_hall_f28379d_Hall_Sensor_B_eCAP /end SUB_GROUP
 /begin REF_MEASUREMENT mcb_pmsm_foc_hall_f28379d_B.BitwiseOperator2_m mcb_pmsm_foc_hall_f28379d_B.DataStoreRead1_kl mcb_pmsm_foc_hall_f28379d_B.DataStoreRead_o mcb_pmsm_foc_hall_f28379d_B.DataTypeConversion_j mcb_pmsm_foc_hall_f28379d_B.Merge1_a mcb_pmsm_foc_hall_f28379d_B.Merge_f mcb_pmsm_foc_hall_f28379d_B.Switch_l mcb_pmsm_foc_hall_f28379d_B.eCAP_c mcb_pmsm_foc_hall_f28379d_DWork.GlobalDirection mcb_pmsm_foc_hall_f28379d_DWork.GlobalHallState mcb_pmsm_foc_hall_f28379d_DWork.GlobalSpeedCount mcb_pmsm_foc_hall_f28379d_DWork.GlobalSpeedValidity mcb_pmsm_foc_hall_f28379d_DWork.HallStateChangeFlag /end REF_MEASUREMENT
/end GROUP
/begin GROUP mcb_pmsm_foc_hall_f28379d_Hall_Sensor_B_Capture_Event_Selection "mcb_pmsm_foc_hall_f28379d/Hall Sensor B/Capture Event Selection"
 /begin REF_MEASUREMENT mcb_pmsm_foc_hall_f28379d_B.BitwiseOperator2_m mcb_pmsm_foc_hall_f28379d_B.Merge_f /end REF_MEASUREMENT
/end GROUP
/begin GROUP mcb_pmsm_foc_hall_f28379d_Hall_Sensor_B_HallValidity "mcb_pmsm_foc_hall_f28379d/Hall Sensor B/HallValidity"
 /begin SUB_GROUP mcb_pmsm_foc_hall_f28379d_Hall_Sensor_B_HallValidity_CodeGen /end SUB_GROUP
/end GROUP
/begin GROUP mcb_pmsm_foc_hall_f28379d_Hall_Sensor_B_HallValidity_CodeGen "mcb_pmsm_foc_hall_f28379d/Hall Sensor B/HallValidity/CodeGen"
 /begin SUB_GROUP mcb_pmsm_foc_hall_f28379d_Hall_Sensor_B_HallValidity_CodeGen_Read_Halls /end SUB_GROUP
/end GROUP
/begin GROUP mcb_pmsm_foc_hall_f28379d_Hall_Sensor_B_HallValidity_CodeGen_Read_Halls "mcb_pmsm_foc_hall_f28379d/Hall Sensor B/HallValidity/CodeGen/Read Halls"
 /begin REF_MEASUREMENT mcb_pmsm_foc_hall_f28379d_B.BitwiseOperator2_m mcb_pmsm_foc_hall_f28379d_B.Hall_A_e mcb_pmsm_foc_hall_f28379d_B.Hall_B_m mcb_pmsm_foc_hall_f28379d_B.Hall_C_f mcb_pmsm_foc_hall_f28379d_B.ReadGPIODATregister_n mcb_pmsm_foc_hall_f28379d_B.ShiftArithmetic1_j mcb_pmsm_foc_hall_f28379d_B.ShiftArithmetic2_k mcb_pmsm_foc_hall_f28379d_B.ShiftArithmetic_b /end REF_MEASUREMENT
/end GROUP
/begin GROUP mcb_pmsm_foc_hall_f28379d_Hall_Sensor_B_Hall_Validity "mcb_pmsm_foc_hall_f28379d/Hall Sensor B/Hall Validity"
 /begin SUB_GROUP mcb_pmsm_foc_hall_f28379d_Hall_Sensor_B_Hall_Validity_Subsystem /end SUB_GROUP
 /begin REF_MEASUREMENT mcb_pmsm_foc_hall_f28379d_B.BitwiseOperator2_m mcb_pmsm_foc_hall_f28379d_B.DataStoreRead_o mcb_pmsm_foc_hall_f28379d_B.DataTypeConversion1_n mcb_pmsm_foc_hall_f28379d_B.DataTypeConversion2_g /end REF_MEASUREMENT
/end GROUP
/begin GROUP mcb_pmsm_foc_hall_f28379d_Hall_Sensor_B_Hall_Validity_Subsystem "mcb_pmsm_foc_hall_f28379d/Hall Sensor B/Hall Validity/Subsystem"
 /begin SUB_GROUP mcb_pmsm_foc_hall_f28379d_Hall_Sensor_B_Hall_Validity_Subsystem_Bad_hall__glitch_or_wrong_connection_ mcb_pmsm_foc_hall_f28379d_Hall_Sensor_B_Hall_Validity_Subsystem_Valid_Halls /end SUB_GROUP
 /begin REF_MEASUREMENT mcb_pmsm_foc_hall_f28379d_B.DataTypeConversion_j mcb_pmsm_foc_hall_f28379d_B.Merge1_a mcb_pmsm_foc_hall_f28379d_B.Merge3_o mcb_pmsm_foc_hall_f28379d_B.Merge_j /end REF_MEASUREMENT
/end GROUP
/begin GROUP mcb_pmsm_foc_hall_f28379d_Hall_Sensor_B_Hall_Validity_Subsystem_Bad_hall__glitch_or_wrong_connection_ "mcb_pmsm_foc_hall_f28379d/Hall Sensor B/Hall Validity/Subsystem/Bad hall\r\n(glitch or wrong connection)"
 /begin REF_MEASUREMENT mcb_pmsm_foc_hall_f28379d_B.DataStoreRead1_kl mcb_pmsm_foc_hall_f28379d_B.Merge1_a /end REF_MEASUREMENT
/end GROUP
/begin GROUP mcb_pmsm_foc_hall_f28379d_Hall_Sensor_B_Hall_Validity_Subsystem_Valid_Halls "mcb_pmsm_foc_hall_f28379d/Hall Sensor B/Hall Validity/Subsystem/Valid Halls"
 /begin REF_MEASUREMENT mcb_pmsm_foc_hall_f28379d_B.DataStoreRead1_kl mcb_pmsm_foc_hall_f28379d_B.DataTypeConversion1_n mcb_pmsm_foc_hall_f28379d_B.DataTypeConversion2_g mcb_pmsm_foc_hall_f28379d_B.Merge1_a mcb_pmsm_foc_hall_f28379d_B.Merge3_o mcb_pmsm_foc_hall_f28379d_B.Merge_j /end REF_MEASUREMENT
/end GROUP
/begin GROUP mcb_pmsm_foc_hall_f28379d_Hall_Sensor_B_eCAP "mcb_pmsm_foc_hall_f28379d/Hall Sensor B/eCAP"
 /begin SUB_GROUP mcb_pmsm_foc_hall_f28379d_Hall_Sensor_B_eCAP_Code_generation /end SUB_GROUP
/end GROUP
/begin GROUP mcb_pmsm_foc_hall_f28379d_Hall_Sensor_B_eCAP_Code_generation "mcb_pmsm_foc_hall_f28379d/Hall Sensor B/eCAP/Code generation" /begin REF_MEASUREMENT mcb_pmsm_foc_hall_f28379d_B.eCAP_c /end REF_MEASUREMENT /end GROUP
/begin GROUP mcb_pmsm_foc_hall_f28379d_Hall_Sensor_C "mcb_pmsm_foc_hall_f28379d/Hall Sensor C"
 /begin SUB_GROUP mcb_pmsm_foc_hall_f28379d_Hall_Sensor_C_Capture_Event_Selection mcb_pmsm_foc_hall_f28379d_Hall_Sensor_C_HallValidity mcb_pmsm_foc_hall_f28379d_Hall_Sensor_C_Hall_Validity mcb_pmsm_foc_hall_f28379d_Hall_Sensor_C_eCAP /end SUB_GROUP
 /begin REF_MEASUREMENT mcb_pmsm_foc_hall_f28379d_B.BitwiseOperator2 mcb_pmsm_foc_hall_f28379d_B.DataStoreRead mcb_pmsm_foc_hall_f28379d_B.DataStoreRead1_k mcb_pmsm_foc_hall_f28379d_B.DataTypeConversion_n mcb_pmsm_foc_hall_f28379d_B.Merge1_k mcb_pmsm_foc_hall_f28379d_B.Merge_pt mcb_pmsm_foc_hall_f28379d_B.Switch mcb_pmsm_foc_hall_f28379d_B.eCAP mcb_pmsm_foc_hall_f28379d_DWork.GlobalDirection mcb_pmsm_foc_hall_f28379d_DWork.GlobalHallState mcb_pmsm_foc_hall_f28379d_DWork.GlobalSpeedCount mcb_pmsm_foc_hall_f28379d_DWork.GlobalSpeedValidity mcb_pmsm_foc_hall_f28379d_DWork.HallStateChangeFlag /end REF_MEASUREMENT
/end GROUP
/begin GROUP mcb_pmsm_foc_hall_f28379d_Hall_Sensor_C_Capture_Event_Selection "mcb_pmsm_foc_hall_f28379d/Hall Sensor C/Capture Event Selection"
 /begin REF_MEASUREMENT mcb_pmsm_foc_hall_f28379d_B.BitwiseOperator2 mcb_pmsm_foc_hall_f28379d_B.Merge_pt /end REF_MEASUREMENT
/end GROUP
/begin GROUP mcb_pmsm_foc_hall_f28379d_Hall_Sensor_C_HallValidity "mcb_pmsm_foc_hall_f28379d/Hall Sensor C/HallValidity"
 /begin SUB_GROUP mcb_pmsm_foc_hall_f28379d_Hall_Sensor_C_HallValidity_CodeGen /end SUB_GROUP
/end GROUP
/begin GROUP mcb_pmsm_foc_hall_f28379d_Hall_Sensor_C_HallValidity_CodeGen "mcb_pmsm_foc_hall_f28379d/Hall Sensor C/HallValidity/CodeGen"
 /begin SUB_GROUP mcb_pmsm_foc_hall_f28379d_Hall_Sensor_C_HallValidity_CodeGen_Read_Halls /end SUB_GROUP
/end GROUP
/begin GROUP mcb_pmsm_foc_hall_f28379d_Hall_Sensor_C_HallValidity_CodeGen_Read_Halls "mcb_pmsm_foc_hall_f28379d/Hall Sensor C/HallValidity/CodeGen/Read Halls"
 /begin REF_MEASUREMENT mcb_pmsm_foc_hall_f28379d_B.BitwiseOperator2 mcb_pmsm_foc_hall_f28379d_B.Hall_A mcb_pmsm_foc_hall_f28379d_B.Hall_B mcb_pmsm_foc_hall_f28379d_B.Hall_C mcb_pmsm_foc_hall_f28379d_B.ReadGPIODATregister mcb_pmsm_foc_hall_f28379d_B.ShiftArithmetic mcb_pmsm_foc_hall_f28379d_B.ShiftArithmetic1 mcb_pmsm_foc_hall_f28379d_B.ShiftArithmetic2 /end REF_MEASUREMENT
/end GROUP
/begin GROUP mcb_pmsm_foc_hall_f28379d_Hall_Sensor_C_Hall_Validity "mcb_pmsm_foc_hall_f28379d/Hall Sensor C/Hall Validity"
 /begin SUB_GROUP mcb_pmsm_foc_hall_f28379d_Hall_Sensor_C_Hall_Validity_Subsystem /end SUB_GROUP
 /begin REF_MEASUREMENT mcb_pmsm_foc_hall_f28379d_B.BitwiseOperator2 mcb_pmsm_foc_hall_f28379d_B.DataStoreRead mcb_pmsm_foc_hall_f28379d_B.DataTypeConversion1_o mcb_pmsm_foc_hall_f28379d_B.DataTypeConversion2_p /end REF_MEASUREMENT
/end GROUP
/begin GROUP mcb_pmsm_foc_hall_f28379d_Hall_Sensor_C_Hall_Validity_Subsystem "mcb_pmsm_foc_hall_f28379d/Hall Sensor C/Hall Validity/Subsystem"
 /begin SUB_GROUP mcb_pmsm_foc_hall_f28379d_Hall_Sensor_C_Hall_Validity_Subsystem_Bad_hall__glitch_or_wrong_connection_ mcb_pmsm_foc_hall_f28379d_Hall_Sensor_C_Hall_Validity_Subsystem_Valid_Halls /end SUB_GROUP
 /begin REF_MEASUREMENT mcb_pmsm_foc_hall_f28379d_B.DataTypeConversion_n mcb_pmsm_foc_hall_f28379d_B.Merge1_k mcb_pmsm_foc_hall_f28379d_B.Merge3 mcb_pmsm_foc_hall_f28379d_B.Merge_pc /end REF_MEASUREMENT
/end GROUP
/begin GROUP mcb_pmsm_foc_hall_f28379d_Hall_Sensor_C_Hall_Validity_Subsystem_Bad_hall__glitch_or_wrong_connection_ "mcb_pmsm_foc_hall_f28379d/Hall Sensor C/Hall Validity/Subsystem/Bad hall\r\n(glitch or wrong connection)"
 /begin REF_MEASUREMENT mcb_pmsm_foc_hall_f28379d_B.DataStoreRead1_k mcb_pmsm_foc_hall_f28379d_B.Merge1_k /end REF_MEASUREMENT
/end GROUP
/begin GROUP mcb_pmsm_foc_hall_f28379d_Hall_Sensor_C_Hall_Validity_Subsystem_Valid_Halls "mcb_pmsm_foc_hall_f28379d/Hall Sensor C/Hall Validity/Subsystem/Valid Halls"
 /begin REF_MEASUREMENT mcb_pmsm_foc_hall_f28379d_B.DataStoreRead1_k mcb_pmsm_foc_hall_f28379d_B.DataTypeConversion1_o mcb_pmsm_foc_hall_f28379d_B.DataTypeConversion2_p mcb_pmsm_foc_hall_f28379d_B.Merge1_k mcb_pmsm_foc_hall_f28379d_B.Merge3 mcb_pmsm_foc_hall_f28379d_B.Merge_pc /end REF_MEASUREMENT
/end GROUP
/begin GROUP mcb_pmsm_foc_hall_f28379d_Hall_Sensor_C_eCAP "mcb_pmsm_foc_hall_f28379d/Hall Sensor C/eCAP"
 /begin SUB_GROUP mcb_pmsm_foc_hall_f28379d_Hall_Sensor_C_eCAP_Code_generation /end SUB_GROUP
/end GROUP
/begin GROUP mcb_pmsm_foc_hall_f28379d_Hall_Sensor_C_eCAP_Code_generation "mcb_pmsm_foc_hall_f28379d/Hall Sensor C/eCAP/Code generation" /begin REF_MEASUREMENT mcb_pmsm_foc_hall_f28379d_B.eCAP /end REF_MEASUREMENT /end GROUP
/begin GROUP mcb_pmsm_foc_hall_f28379d_Hardware_Init "mcb_pmsm_foc_hall_f28379d/Hardware Init" /begin SUB_GROUP mcb_pmsm_foc_hall_f28379d_Hardware_Init_Variant_Subsystem /end SUB_GROUP /end GROUP
/begin GROUP mcb_pmsm_foc_hall_f28379d_Hardware_Init_Variant_Subsystem "mcb_pmsm_foc_hall_f28379d/Hardware Init/Variant Subsystem"
 /begin SUB_GROUP mcb_pmsm_foc_hall_f28379d_Hardware_Init_Variant_Subsystem_Code_Generation /end SUB_GROUP
/end GROUP
/begin GROUP mcb_pmsm_foc_hall_f28379d_Hardware_Init_Variant_Subsystem_Code_Generation "mcb_pmsm_foc_hall_f28379d/Hardware Init/Variant Subsystem/Code Generation"
 /begin SUB_GROUP mcb_pmsm_foc_hall_f28379d_Hardware_Init_Variant_Subsystem_Code_Generation_Calculate_ADC_Offset_ mcb_pmsm_foc_hall_f28379d_Hardware_Init_Variant_Subsystem_Code_Generation_DRV_Enable mcb_pmsm_foc_hall_f28379d_Hardware_Init_Variant_Subsystem_Code_Generation_Default_ADC_Offset /end SUB_GROUP
 /begin REF_MEASUREMENT mcb_pmsm_foc_hall_f28379d_B.NOT /end REF_MEASUREMENT
/end GROUP
/begin GROUP mcb_pmsm_foc_hall_f28379d_Hardware_Init_Variant_Subsystem_Code_Generation_Calculate_ADC_Offset_ "mcb_pmsm_foc_hall_f28379d/Hardware Init/Variant Subsystem/Code Generation/Calculate ADC Offset\r\n"
 /begin SUB_GROUP mcb_pmsm_foc_hall_f28379d_Hardware_Init_Variant_Subsystem_Code_Generation_Calculate_ADC_Offset__For_Iterator_Subsystem mcb_pmsm_foc_hall_f28379d_Hardware_Init_Variant_Subsystem_Code_Generation_Calculate_ADC_Offset__If_Action_Subsystem mcb_pmsm_foc_hall_f28379d_Hardware_Init_Variant_Subsystem_Code_Generation_Calculate_ADC_Offset__If_Action_Subsystem1 mcb_pmsm_foc_hall_f28379d_Hardware_Init_Variant_Subsystem_Code_Generation_Calculate_ADC_Offset__If_Action_Subsystem2 mcb_pmsm_foc_hall_f28379d_Hardware_Init_Variant_Subsystem_Code_Generation_Calculate_ADC_Offset__If_Action_Subsystem3 /end SUB_GROUP
 /begin REF_MEASUREMENT mcb_pmsm_foc_hall_f28379d_B.Divide1_e mcb_pmsm_foc_hall_f28379d_B.Divide_ir mcb_pmsm_foc_hall_f28379d_B.Sum1_j mcb_pmsm_foc_hall_f28379d_B.Sum_i /end REF_MEASUREMENT
/end GROUP
/begin GROUP mcb_pmsm_foc_hall_f28379d_Hardware_Init_Variant_Subsystem_Code_Generation_Calculate_ADC_Offset__For_Iterator_Subsystem "mcb_pmsm_foc_hall_f28379d/Hardware Init/Variant Subsystem/Code Generation/Calculate ADC Offset\r\n/For Iterator\r\nSubsystem"
 /begin SUB_GROUP mcb_pmsm_foc_hall_f28379d_Hardware_Init_Variant_Subsystem_Code_Generation_Calculate_ADC_Offset__For_Iterator_Subsystem_If_Action_Subsystem /end SUB_GROUP
 /begin REF_MEASUREMENT mcb_pmsm_foc_hall_f28379d_B.ADC_A_IN0 mcb_pmsm_foc_hall_f28379d_B.ADC_B_IN0 mcb_pmsm_foc_hall_f28379d_B.ForIterator /end REF_MEASUREMENT
/end GROUP
/begin GROUP mcb_pmsm_foc_hall_f28379d_Hardware_Init_Variant_Subsystem_Code_Generation_Calculate_ADC_Offset__For_Iterator_Subsystem_If_Action_Subsystem "mcb_pmsm_foc_hall_f28379d/Hardware Init/Variant Subsystem/Code Generation/Calculate ADC Offset\r\n/For Iterator\r\nSubsystem/If Action\r\nSubsystem"
 /begin REF_MEASUREMENT mcb_pmsm_foc_hall_f28379d_B.ADC_A_IN0 mcb_pmsm_foc_hall_f28379d_B.ADC_B_IN0 mcb_pmsm_foc_hall_f28379d_B.Memory mcb_pmsm_foc_hall_f28379d_B.Memory1 mcb_pmsm_foc_hall_f28379d_B.Sum1_j mcb_pmsm_foc_hall_f28379d_B.Sum_i mcb_pmsm_foc_hall_f28379d_DWork.Memory1_PreviousInput mcb_pmsm_foc_hall_f28379d_DWork.Memory_PreviousInput /end REF_MEASUREMENT
/end GROUP
/begin GROUP mcb_pmsm_foc_hall_f28379d_Hardware_Init_Variant_Subsystem_Code_Generation_Calculate_ADC_Offset__If_Action_Subsystem "mcb_pmsm_foc_hall_f28379d/Hardware Init/Variant Subsystem/Code Generation/Calculate ADC Offset\r\n/If Action\r\nSubsystem"
 /begin REF_MEASUREMENT mcb_pmsm_foc_hall_f28379d_B.Divide_ir mcb_pmsm_foc_hall_f28379d_DWork.IaOffset /end REF_MEASUREMENT
/end GROUP
/begin GROUP mcb_pmsm_foc_hall_f28379d_Hardware_Init_Variant_Subsystem_Code_Generation_Calculate_ADC_Offset__If_Action_Subsystem1 "mcb_pmsm_foc_hall_f28379d/Hardware Init/Variant Subsystem/Code Generation/Calculate ADC Offset\r\n/If Action\r\nSubsystem1" /begin REF_MEASUREMENT mcb_pmsm_foc_hall_f28379d_DWork.IaOffset /end REF_MEASUREMENT /end GROUP
/begin GROUP mcb_pmsm_foc_hall_f28379d_Hardware_Init_Variant_Subsystem_Code_Generation_Calculate_ADC_Offset__If_Action_Subsystem2 "mcb_pmsm_foc_hall_f28379d/Hardware Init/Variant Subsystem/Code Generation/Calculate ADC Offset\r\n/If Action\r\nSubsystem2"
 /begin REF_MEASUREMENT mcb_pmsm_foc_hall_f28379d_B.Divide1_e mcb_pmsm_foc_hall_f28379d_DWork.IbOffset /end REF_MEASUREMENT
/end GROUP
/begin GROUP mcb_pmsm_foc_hall_f28379d_Hardware_Init_Variant_Subsystem_Code_Generation_Calculate_ADC_Offset__If_Action_Subsystem3 "mcb_pmsm_foc_hall_f28379d/Hardware Init/Variant Subsystem/Code Generation/Calculate ADC Offset\r\n/If Action\r\nSubsystem3" /begin REF_MEASUREMENT mcb_pmsm_foc_hall_f28379d_DWork.IbOffset /end REF_MEASUREMENT /end GROUP
/begin GROUP mcb_pmsm_foc_hall_f28379d_Hardware_Init_Variant_Subsystem_Code_Generation_DRV_Enable "mcb_pmsm_foc_hall_f28379d/Hardware Init/Variant Subsystem/Code Generation/DRV Enable"
 /begin REF_MEASUREMENT mcb_pmsm_foc_hall_f28379d_B.Switch_bt mcb_pmsm_foc_hall_f28379d_DWork.DRV830xEnable_FRAC_LEN /end REF_MEASUREMENT
/end GROUP
/begin GROUP mcb_pmsm_foc_hall_f28379d_Hardware_Init_Variant_Subsystem_Code_Generation_Default_ADC_Offset "mcb_pmsm_foc_hall_f28379d/Hardware Init/Variant Subsystem/Code Generation/Default ADC Offset"
 /begin REF_MEASUREMENT mcb_pmsm_foc_hall_f28379d_DWork.IaOffset mcb_pmsm_foc_hall_f28379d_DWork.IbOffset /end REF_MEASUREMENT
/end GROUP
/begin GROUP mcb_pmsm_foc_hall_f28379d_Heartbeat_LED "mcb_pmsm_foc_hall_f28379d/Heartbeat LED" /begin SUB_GROUP mcb_pmsm_foc_hall_f28379d_Heartbeat_LED_Heartbeat_LED /end SUB_GROUP /end GROUP
/begin GROUP mcb_pmsm_foc_hall_f28379d_Heartbeat_LED_Heartbeat_LED "mcb_pmsm_foc_hall_f28379d/Heartbeat LED/Heartbeat LED"
 /begin SUB_GROUP mcb_pmsm_foc_hall_f28379d_Heartbeat_LED_Heartbeat_LED_Code_generation /end SUB_GROUP
/end GROUP
/begin GROUP mcb_pmsm_foc_hall_f28379d_Heartbeat_LED_Heartbeat_LED_Code_generation "mcb_pmsm_foc_hall_f28379d/Heartbeat LED/Heartbeat LED/Code generation" /begin REF_MEASUREMENT mcb_pmsm_foc_hall_f28379d_DWork.DigitalOutput2_FRAC_LEN /end REF_MEASUREMENT /end GROUP
/begin GROUP mcb_pmsm_foc_hall_f28379d_Serial_Receive "mcb_pmsm_foc_hall_f28379d/Serial Receive"
 /begin SUB_GROUP mcb_pmsm_foc_hall_f28379d_Serial_Receive_Data_Conditioning_Rx mcb_pmsm_foc_hall_f28379d_Serial_Receive_SCI_Rx mcb_pmsm_foc_hall_f28379d_Serial_Receive_unParse /end SUB_GROUP
 /begin REF_MEASUREMENT mcb_pmsm_foc_hall_f28379d_B.DataTypeConversion3_h mcb_pmsm_foc_hall_f28379d_B.SCIReceive mcb_pmsm_foc_hall_f28379d_B.ShiftArithmetic1_d mcb_pmsm_foc_hall_f28379d_DWork.Debug_signals mcb_pmsm_foc_hall_f28379d_DWork.Enable mcb_pmsm_foc_hall_f28379d_DWork.Speed_ref /end REF_MEASUREMENT
/end GROUP
/begin GROUP mcb_pmsm_foc_hall_f28379d_Serial_Receive_Data_Conditioning_Rx "mcb_pmsm_foc_hall_f28379d/Serial Receive/Data_Conditioning_Rx"
 /begin SUB_GROUP mcb_pmsm_foc_hall_f28379d_Serial_Receive_Data_Conditioning_Rx_Data_Type_Float /end SUB_GROUP
/end GROUP
/begin GROUP mcb_pmsm_foc_hall_f28379d_Serial_Receive_Data_Conditioning_Rx_Data_Type_Float "mcb_pmsm_foc_hall_f28379d/Serial Receive/Data_Conditioning_Rx/Data_Type_Float"
 /begin REF_MEASUREMENT mcb_pmsm_foc_hall_f28379d_B.DataTypeConversion2_f mcb_pmsm_foc_hall_f28379d_B.SCIReceive /end REF_MEASUREMENT
/end GROUP
/begin GROUP mcb_pmsm_foc_hall_f28379d_Serial_Receive_SCI_Rx "mcb_pmsm_foc_hall_f28379d/Serial Receive/SCI_Rx"
 /begin SUB_GROUP mcb_pmsm_foc_hall_f28379d_Serial_Receive_SCI_Rx_Code_Generation /end SUB_GROUP
/end GROUP
/begin GROUP mcb_pmsm_foc_hall_f28379d_Serial_Receive_SCI_Rx_Code_Generation "mcb_pmsm_foc_hall_f28379d/Serial Receive/SCI_Rx/Code Generation"
 /begin SUB_GROUP mcb_pmsm_foc_hall_f28379d_Serial_Receive_SCI_Rx_Code_Generation_Data_Type_Float /end SUB_GROUP
/end GROUP
/begin GROUP mcb_pmsm_foc_hall_f28379d_Serial_Receive_SCI_Rx_Code_Generation_Data_Type_Float "mcb_pmsm_foc_hall_f28379d/Serial Receive/SCI_Rx/Code Generation/Data_Type_Float" /begin REF_MEASUREMENT mcb_pmsm_foc_hall_f28379d_B.SCIReceive /end REF_MEASUREMENT /end GROUP
/begin GROUP mcb_pmsm_foc_hall_f28379d_Serial_Receive_unParse "mcb_pmsm_foc_hall_f28379d/Serial Receive/unParse"
 /begin REF_MEASUREMENT mcb_pmsm_foc_hall_f28379d_B.BitwiseOperator mcb_pmsm_foc_hall_f28379d_B.BitwiseOperator1 mcb_pmsm_foc_hall_f28379d_B.DataTypeConversion2_f mcb_pmsm_foc_hall_f28379d_B.DataTypeConversion3_h mcb_pmsm_foc_hall_f28379d_B.ShiftArithmetic1_d /end REF_MEASUREMENT
/end GROUP
/begin GROUP mcb_pmsm_foc_hall_f28379d_Speed_Control "mcb_pmsm_foc_hall_f28379d/Speed Control"
 /begin SUB_GROUP mcb_pmsm_foc_hall_f28379d_Speed_Control_PI_Controller_Speed mcb_pmsm_foc_hall_f28379d_Speed_Control_Speed_Ref_Selector /end SUB_GROUP
/end GROUP
/begin GROUP mcb_pmsm_foc_hall_f28379d_Speed_Control_PI_Controller_Speed "mcb_pmsm_foc_hall_f28379d/Speed Control/PI_Controller_Speed"
 /begin REF_MEASUREMENT mcb_pmsm_foc_hall_f28379d_B.RT7 mcb_pmsm_foc_hall_f28379d_DWork.Enable /end REF_MEASUREMENT
/end GROUP
/begin GROUP mcb_pmsm_foc_hall_f28379d_Speed_Control_Speed_Ref_Selector "mcb_pmsm_foc_hall_f28379d/Speed Control/Speed_Ref_Selector"
 /begin REF_MEASUREMENT mcb_pmsm_foc_hall_f28379d_B.RT6 mcb_pmsm_foc_hall_f28379d_B.RT7 mcb_pmsm_foc_hall_f28379d_DWork.Enable /end REF_MEASUREMENT
/end GROUP
/begin GROUP mcb_pmsm_foc_hall_f28379d_Subsystem4 "mcb_pmsm_foc_hall_f28379d/Subsystem4"
 /begin SUB_GROUP mcb_pmsm_foc_hall_f28379d_Subsystem4_CAN_Tx mcb_pmsm_foc_hall_f28379d_Subsystem4_DataLog /end SUB_GROUP
 /begin REF_MEASUREMENT mcb_pmsm_foc_hall_f28379d_B.Gain1_n mcb_pmsm_foc_hall_f28379d_B.Gain2 mcb_pmsm_foc_hall_f28379d_B.Gain3 mcb_pmsm_foc_hall_f28379d_B.Gain_g mcb_pmsm_foc_hall_f28379d_B.RT10 mcb_pmsm_foc_hall_f28379d_B.RT11 /end REF_MEASUREMENT
/end GROUP
/begin GROUP mcb_pmsm_foc_hall_f28379d_Subsystem4_CAN_Tx "mcb_pmsm_foc_hall_f28379d/Subsystem4/CAN_Tx"
 /begin REF_MEASUREMENT mcb_pmsm_foc_hall_f28379d_B.DataTypeConversion2 mcb_pmsm_foc_hall_f28379d_B.DataTypeConversion3 mcb_pmsm_foc_hall_f28379d_B.DataTypeConversion4 mcb_pmsm_foc_hall_f28379d_DWork.CANPack_ModeSignalID /end REF_MEASUREMENT
/end GROUP
/begin GROUP mcb_pmsm_foc_hall_f28379d_Subsystem4_DataLog "mcb_pmsm_foc_hall_f28379d/Subsystem4/DataLog"
 /begin REF_MEASUREMENT mcb_pmsm_foc_hall_f28379d_B.Bias mcb_pmsm_foc_hall_f28379d_B.Bias1 mcb_pmsm_foc_hall_f28379d_B.DataTypeConversion2 mcb_pmsm_foc_hall_f28379d_B.DataTypeConversion3 mcb_pmsm_foc_hall_f28379d_B.DataTypeConversion4 mcb_pmsm_foc_hall_f28379d_B.Gain mcb_pmsm_foc_hall_f28379d_B.Gain1 mcb_pmsm_foc_hall_f28379d_B.Gain2_f mcb_pmsm_foc_hall_f28379d_B.Gain3_o mcb_pmsm_foc_hall_f28379d_B.Loss mcb_pmsm_foc_hall_f28379d_B.RT8 mcb_pmsm_foc_hall_f28379d_B.RT9 mcb_pmsm_foc_hall_f28379d_B.T /end REF_MEASUREMENT
/end GROUP
/end MODULE
/end PROJECT
/* (add any file trailer comments here) */
/* EOF mcb_pmsm_foc_hall_f28379d.a2l*/
